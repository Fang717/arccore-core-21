AUTOSAR XML (schema 4-2-2)
package /ArcCore/EcucDefs/Generic
  module definition EthTSyn [0..1]: refined-module-def=EthTSyn, variants pre-compile  # Configuration of the Synchronized Time-base Manager (StbM) module with respect to global time handling on Ethernet.
    container EthTSynGeneral  # This container holds the general parameters of the Ethernet-specific Synchronized Time-base Manager
      boolean EthTSynDevErrorDetect  # Switches the Default Error Tracer (Det) detection and notification ON or OFF. | * true: enabled (ON). * false: disabled (OFF).
      boolean EthTSynHardwareTimestampSupport  # Activate/Deactivate the hardware time stamping functionality of the Ethernet hardware. | True: Timestamp is retrieved from the Ethernet hardware False: Timestamp is retrieved from the StbM
      float EthTSynMainFunctionPeriod: 0..Inf  # Schedule period of the main function EthTSyn_MainFunction. Unit: [s].
      boolean EthTSynVersionInfo  # Activate/Deactivate the version information API (EthTSyn_GetVersionInfo). True: version information API activated False: version information API deactivated.
    container EthTSynGlobalTimeDomain [1..*]  # This represents the existence of a global time domain on Ethernet. The EthTSyn module can administrate several global time domains at the same time that in itself form a hierarchy of domains and sub-domains. | If the EthTSyn exists it is assumed that at least one global time domain exists.
      integer EthTSynGlobalTimeDomainId [0..1]: 0..31  # This Parameter is deprecated and will be removed in future. Tags: atp.Status=obsolete, atp.StatusRevisionBegin=4.2.2 | Old description: The global time domain ID. This element is obsolete and will be removed in a future revision.
      float EthTSynGlobalTimeFollowUpTimeout: 0..Inf
      symbolic name reference EthTSynSynchronizedTimeBaseRef: destination=StbMSynchronizedTimeBase  # Mandatory reference to the required synchronized time-base.
      container EthTSynGlobalTimeMaster [0..1]  # Configuration of the global time master. Each global time domain is required to have exactly one global time master. This master may or may not exist on the configured ECU.
        float EthTSynGlobalTimeTxFollowUpOffset: 0..Inf  # This represents configuration of the TX offset for Follow_Up / Pdelay_Resp_Follow_Up messages. Unit: seconds
        float EthTSynGlobalTimeTxPdelayReqPeriod: 0..Inf  # This represents configuration of the TX period for Pdelay_Req messages. Unit: seconds
        float EthTSynGlobalTimeTxPeriod: 0..Inf  # This represents configuration of the TX period. Unit: seconds
        reference EthTSynGlobalTimeEthIfRef: destination=EthIfController  # This represents the reference to the Ethernet interface taken to fetch the global time information.
      container EthTSynGlobalTimeSlave [0..1]  # Configuration of a time slave. Each global time domain is required to have at least one time slave. The configured ECU may or may not represent a time slave.
        float EthTSynGlobalTimeTxFollowUpOffset: 0..Inf  # This represents configuration of the TX offset for Follow_Up / Pdelay_Resp_Follow_Up messages. Unit: seconds
        float EthTSynGlobalTimeTxPdelayReqPeriod: 0..Inf  # This represents configuration of the TX period for Pdelay_Req messages. Unit: seconds
        float EthTSynTimeHardwareCorrectionThreshold [0..1]: 0..  # This parameter can be taken to define the maximum deviation between the local time and the time obtained from SYNC message that triggers a correction of the time drift caused by the hardware on the local node.
        reference EthTSynGlobalTimeEthIfRef: destination=EthIfController  # This represents the reference to the Ethernet interface taken to fetch the global time information.
package /ArcCore/EcucDefs/Generic/Implementations
  bsw implementation EthTSyn: programming-language=C, sw-version=1.1.0, used-code-generator=communication::EthTSyn::gen::EthTSyn::main, vendor-id=60, ar-release-version=4.2.2, vendor-specific-module-def=EthTSyn
