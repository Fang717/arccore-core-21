AUTOSAR XML (schema 4-0-1)
# The material contained in this specification is protected by copyright and
# other types of Intellectual Property Rights. The commercial exploitation of the
# material contained in this specification requires a license to such
# Intellectual Property Rights.
# This specification may be utilized or reproduced without any modification, in
# any form or by any means, for informational purposes only. For any other
# purpose, no part of the specification may be utilized or reproduced, in any
# form or by any means, without permission in writing from the publisher.
# licensed under the same rules as applicable to the AUTOSAR Standard.
package /ArcCore/EcucDefs/Generic
  module definition LinTp [0..1]: variants link-time/post-build/pre-compile  # Configuration of the LIN Transport Protocol.
    container LinTpGeneral  # Container that holds all LIN transport protocol general parameters.
      boolean LinTpChangeParameterApi  # This parameter, if set to true, enables the LinTp_ChangeParameterRequest Api for this Module.
      boolean LinTpVersionInfoApi: default-value=false  # Switches the LinTp_GetVersionInfo function ON or OFF.
    container LinTpGlobalConfig  # This container contains the global configuration parameters of the LinTp.
      integer LinTpMaxNumberOfRespPendingFrames: 0..65535  # Configures the maximum number of allowed response pending frames.
      integer LinTpMaxRxNSduCnt [0..1]: 0..65535  # Maximum number of NSdus. This parameter is needed only in case of post-build loadable implementation using static memory allocation.
      integer LinTpMaxTxNSduCnt [0..1]: 0..65535  # Maximum number of NSdus. This parameter is needed only in case of post-build loadable implementation using static memory allocation.
      float LinTpP2Max: 0.05..2  # P2*max timeout when a response pending frame is expected in seconds. | Note that the minimum value of LinTpP2Max shall be more than or equal to the value of LinTpP2Timing.
      float LinTpP2Timing: 0.05..0.5  # Definition of the P2max timeout observation parameter in seconds.
      container LinTpChannelConfig [0..*]  # This container contains the channel specific configuration parameters of LinTp.
        boolean LinTpDropNotRequestedNad: default-value=true  # Configures if TP Frames of not requested LIN-Slaves are dropped or not. | TRUE: Drop TP Frames of not requested LIN-Slaves FALSE: Keep TP Frames of not requested LIN-Slaves
        boolean LinTpScheduleChangeDiag: default-value=false  # Enables or disables the call of BswM_LinTp_RequestMode() to diagnostic request/response schedule. | false: BswM is not called true: BswM is called
        symbolic name reference LinTpChannelRef: destination=ComMChannel  # Index of the channel this LinTp channel belongs to.
      container LinTpRxNSdu [0..*]  # This container exists once for each received N-SDU on any channel the node is connected to. This N-SDU produces meta data items of type LIN_NAD_8.
        float LinTpNcr [0..1]: 0..1  # Value in seconds of the N_Cr timeout. N_Cr is the time until reception of the next Consecutive Frame N_PDU.
        integer LinTpRxNSduId: 0..65535, symbolic-name-value=true  # The identifier of the Transport Protocol message. This ID will be used by upper layers to call LinTp_ChangeParameter and LinTp_CancelReceive.
        integer LinTpRxNSduNad: 0..255  # A N-SDU transported on LIN is identified using the NAD for the specific slave.
        symbolic name reference LinTpRxNSduChannelRef: destination=ComMChannel  # Index of the channel this N-SDU belongs to.
        reference LinTpRxNSduPduRef: destination=Pdu  # Reference to the global PDU
      container LinTpTxNSdu [0..*]  # This container exists once for each transmitted N-SDU on any channel the node is connected to. This N-SDU consumes meta data items of type LIN_NAD_8.
        integer LinTpMaxBufReq: 0..255  # This parameter defines the maximum number of times the LinTp should request upper layer for the Tx Buffer. It is also used to limit the number of retries for PduR_LinTpCopyTxData when no timer is active.
        float LinTpNas: 0..1  # Value in seconds of the N_As timeout. N_As is the time for transmission of a LIN frame (any N_PDU) on the part of the sender.
        float LinTpNcs [0..1]: 0..Inf  # Value in seconds of the performance requirement of N_Cs. N_Cs is the time which elapses between the transmit request of a CF N-PDU until the transmit request of the next CF N-PDU.
        integer LinTpTxNSduId: 0..65535, symbolic-name-value=true  # The identifier of the Transport Protocol message. This ID will be the one that is communicated with upper layers.
        integer LinTpTxNSduNad: 0..255  # A N-SDU transported on LIN is identified using the NAD for the specific slave.
        symbolic name reference LinTpTxNSduChannelRef: destination=ComMChannel  # Index of the channel this N-SDU belongs to.
        reference LinTpTxNSduPduRef: destination=Pdu  # Reference to the global PDU
package /ArcCore/EcucDefs/Generic/Implementation
  bsw implementation LinTp: programming-language=C, sw-version=1.0.0, used-code-generator=communication::LinIf::gen::LinTp::main, vendor-id=60, ar-release-version=4.3.0, vendor-specific-module-def=LinTp
