AUTOSAR XML (schema 4-2-2)
package /ArcCore/EcucDefs/Generic
  module definition SecOC [0..1]: variants link-time/post-build/pre-compile  # Configuration of the SecOC (SecureOnboardCommunication) module.
    container SecOCGeneral  # Contains the general configuration parameters of the SecOC module.
      boolean SecOCDevErrorDetect  # Pre-processor switch for enabling development error detection support.
      float SecOCMainFunctionPeriod: 0..0.255  # Allows to configure the time for the MainFunction (as float in seconds).
      string SecOCMaxAlignScalarType  # The scalar type which has the maximum alignment restrictions on the given platform. This type can be e.g. uint8, uint16 or uint32.
      function name SecOCVerificationStatusCallout [0..*]  # Entry address of the customer specific call out routine which shall be invoked in case of a verification attempt.
      boolean SecOCVersionInfoApi  # If true the SecOC_GetVersionInfo API is available.
      symbolic name reference SecOCNvMBlockDescriptor: destination=NvMBlockDescriptor  # Reference to NVRAM block containing the none volatile data. If this parameter is not configured it means that no NVRAM is used at all.
    container SecOCRxPduProcessing [0..*]  # Contains the parameters to configure the RxPdus to be verified by the SecOC module.
      integer SecOCAuthInfoTxLength: 0..65535  # This parameter defines the length in bits of the authentication code to be included in the payload of the Secured I-PDU.
      integer SecOCDataId: 0..65535  # This parameter defines a unique numerical identifier for the Secured I-PDU.
      integer SecOCFreshnessCounterSyncAttempts [0..1]: 0..65535  # This parameter defines the number of Freshness Counter re-synchronization attempts when a verification failed for a Secured I-PDU. If the value is zero, there will be no additional verification attempt to synchronize with a potentially better fitting Freshness Counter value. This parameter is only applicable if SecOCUseFreshnessTimestamp is FALSE.
      integer SecOCFreshnessTimestampTimePeriodFactor: 0..4294967295  # This parameter defines a factor that specifies the time period for the Freshness Timestamp. It holds a multiplication factor that specifies the concrete meaning of a Freshness Timestamp increment by one on basis of microseconds.
      integer SecOCFreshnessValueId: 0..65535  # This parameter defines the Id of the Freshness Value. | The Freshness Value might be a normal counter or a time value.
      integer SecOCFreshnessValueLength: 0..64  # This parameter defines the complete length in bits of the Freshness Value. As long as the key doesn't change the counter shall not overflow. The length of the counter shall be determined based on the expected life time of the corresponding key and frequency of usage of the counter.
      integer SecOCFreshnessValueTxLength: 0..64  # This parameter defines the length in bits of the Freshness Value to be included in the payload of the Secured I-PDU. This length is specific to the least significant bits of the complete Freshness Counter. If the parameter is 0 no Freshness Value is included in the Secured I-PDU.
      integer SecOCKeyId: 0..65535  # This parameter specifies the local Key identifier of the stored Key used to generate or verify a MAC.
      float SecOCRxAcceptanceWindow [0..1]: 0..Inf  # This parameter defines the maximum allowed deviation in seconds from the expected timestamp for which a Secured I-PDU is still deemed authentic. | This parameter is only applicable if SecOCUseFreshnessTimestamp is TRUE.
      integer SecOCSecondaryFreshnessValueId [0..1]: 0..65535  # This parameter defines the Id of the Secondary Freshness Value. | The Secondary Freshness Value might be a normal counter or a time value.
      boolean SecOCUseFreshnessTimestamp  # This parameter specifies whether the Freshness Value is generated through individual Freshness Counters or by a Timestamps. The value is set to TRUE when Timestamps are used.
      enumeration SecOCVerificationStatusPropagationMode: {BOTH, FAILURE_ONLY, NONE}  # This parameter is used to describe the propagation of the status of each verification attempt from the SecOC module to SWCs.
      choice reference SecOCRxAuthServiceConfigRef: destination=[CalMacVerifyConfig, CalSignatureVerifyConfig, CsmMacVerifyConfig, CsmSignatureVerifyConfig, CalMacVerifyConfig]  # This choice container is used to define which module and which service is used for verification.
      reference SecOCSameBufferPduRef [0..1]: destination=SecOCSameBufferPduCollection  # This reference is used to collect Pdus that are using the same SecOC buffer.
      container SecOCRxAuthenticPduLayer  # This container specifies the Pdu that is transmitted by the SecOC module to the PduR after the Mac was verified.
        reference SecOCRxAuthenticLayerPduRef: destination=Pdu  # Reference to the global Pdu.
      container SecOCRxSecuredPduLayer  # This container specifies the Pdu that is received by the SecOC module from the PduR. For this Pdu the Mac verification is provided.
        integer SecOCRxSecuredLayerPduId: 0..65535, symbolic-name-value=true  # PDU identifier assigned by SecOC module. Used by PduR for SecOC_PduRRxIndication.
        reference SecOCRxSecuredLayerPduRef: destination=Pdu  # Reference to the global Pdu.
    container SecOCSameBufferPduCollection [0..*]  # SecOCBuffer configuration that may be used by a collection of Pdus.
      integer SecOCBufferLength: 0..4294967295  # This parameter defines the Buffer in bytes that is used by the SecOC module.
    container SecOCTxPduProcessing [0..*]  # Contains the parameters to configure the TxPdus to be secured by the SecOC module.
      integer SecOCAuthInfoTxLength: 0..65535  # This parameter defines the length in bits of the authentication code to be included in the payload of the Secured I-PDU.
      integer SecOCAuthenticationRetries: 0..65535  # This parameter defines the additional number of authentication attempts that are to be carried out when the generation of the authentication information failed for a given Secured I-PDU. If zero is set than only one authentication attempt is done.
      integer SecOCDataId: 0..65535  # This parameter defines a unique numerical identifier for the Secured I-PDU.
      integer SecOCFreshnessTimestampTimePeriodFactor: 0..4294967295  # This parameter defines a factor that specifies the time period for the Freshness Timestamp. It holds a multiplication factor that specifies the concrete meaning of a Freshness Timestamp increment by one on basis of microseconds.
      integer SecOCFreshnessValueId: 0..65535  # This parameter defines the Id of the Freshness Value. | The Freshness Value might be a normal counter or a time value.
      integer SecOCFreshnessValueLength: 0..64  # This parameter defines the complete length in bits of the Freshness Value. As long as the key doesn't change the counter shall not overflow. The length of the counter shall be determined based on the expected life time of the corresponding key and frequency of usage of the counter.
      integer SecOCFreshnessValueTxLength: 0..64  # This parameter defines the length in bits of the Freshness Value to be included in the payload of the Secured I-PDU. This length is specific to the least significant bits of the complete Freshness Counter. If the parameter is 0 no Freshness Value is included in the Secured I-PDU.
      integer SecOCKeyId: 0..65535  # This parameter specifies the local Key identifier of the stored Key used to generate or verify a MAC.
      boolean SecOCUseFreshnessTimestamp  # This parameter specifies whether the Freshness Value is generated through individual Freshness Counters or by a Timestamps. The value is set to TRUE when Timestamps are used.
      choice reference SecOCTxAuthServiceConfigRef: destination=[CalMacGenerateConfig, CalSignatureGenerateConfig, CsmMacGenerateConfig, CsmSignatureGenerateConfig, CalMacGenerateConfig]  # This choice container is used to define which module and which service is used for authentication.
      reference SecOCSameBufferPduRef [0..1]: destination=SecOCSameBufferPduCollection  # This reference is used to collect Pdus that are using the same SecOC buffer.
      container SecOCTxAuthenticPduLayer  # This container specifies the Pdu that is received by the SecOC module from the PduR. For this Pdu the Mac generation is provided.
        integer SecOCTxAuthenticLayerPduId: 0..65535, symbolic-name-value=true  # PDU identifier assigned by SecOC module. Used by PduR for SecOC_PduRTransmit.
        reference SecOCTxAuthenticLayerPduRef: destination=Pdu  # Reference to the global Pdu.
      container SecOCTxSecuredPduLayer  # This container specifies the Pdu that is transmitted by the SecOC module to the PduR after the Mac was generated.
        integer SecOCTxSecuredLayerPduId: 0..65535, symbolic-name-value=true  # PDU identifier assigned by SecOC module. Used by PduR for confirmation (SecOC_PduRTxConfirmation) and for TriggerTransmit.
        reference SecOCTxSecuredLayerPduRef: destination=Pdu  # Reference to the global Pdu.
package /ArcCore/EcucDefs/Generic/Implementations
  bsw implementation SecOC: programming-language=C, sw-version=1.0.0, used-code-generator=communication::SecOC::gen::SecOC::main, vendor-id=60, ar-release-version=4.2.1, vendor-specific-module-def=SecOC
