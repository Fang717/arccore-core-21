AUTOSAR XML (schema 4-2-2)
package /ArcCore/EcucDefs/Generic
  module definition EthIf [0..1]: refined-module-def=EthIf, variants link-time/post-build/pre-compile  # Configuration of the EthIf (Ethernet Interface) module.
    container EthIfConfigSet  # Collecting container for all parameters with post-build configuration classes.
      container EthIfController [1..*]  # This container contains the configuration of EthIfController.
        integer EthIfCtrlIdx: 0..255, symbolic-name-value=true  # This parameter provides a zero-based consecutive index of the Ethernet Communication Controllers. Upper layer BSW modules and the EthIf itself use this index to identify a Ethernet CC.
        integer EthIfCtrlMtu: 42..1500  # Specifies the maximum transmission unit (MTU) of the EthIfCtrl in [bytes]. 42 bytes minimum applies when VLAN tag(802.1Q) is present. When absent, 46 bytes minimum applies | Note: in case a VLAN tag is used for the EthIfCtrl, the MTU is 4 bytes smaller than the maximum payload size of an Ethernet frame which can be transmitted on the network.
        integer EthIfMaxTxBufsTotal: 1..255  # Limits the total number of transmit buffers.
        integer EthIfVlanId [0..1]: 0..4095  # A virtual-LAN is identified by this attribute according to IEEE 802.1Q.
        symbolic name reference EthIfEthCtrlRef: destination=EthCtrlConfig  # Reference to a Controller, which is handled by a specific Driver. This reference is unique for the ECU.
        symbolic name reference EthIfEthTrcvRef [0..1]: destination=EthTrcvConfig  # Reference to a Ethernet Transceiver.
      container EthIfFrameOwnerConfig [1..*]  # Configuration of Ethernet frame owner
        integer EthIfFrameType: 0..65535  # Selects the Ethernet frame type.
        integer EthIfOwner: 0..255  # Selects the owner of an Ethernet frame type. The owner is a zero based index into the callback function configuration 'EthIfRxIndicationConfig'. I.e. an Ethernet frame of type IPv4 (0x800) at index 0 will call the first callback function configured in 'EthIfRxIndicationConfig'.
        reference ArcEthIfRxIndication: origin=ARCCORE_ECUC, destination=EthIfRxIndicationConfig  # Reference to EthIfRxIndicationConfig container parameter
        reference ArcEthIfTxConfirmationConfigRef [0..1]: origin=ARCCORE_ECUC, destination=EthIfTxConfirmationConfig  # Reference to EthIfTxConfirmationConfig container
      container EthIfRxIndicationConfig [1..*]  # Configuration of receive callback functions.
        function name EthIfRxIndicationFunction  # Specifies receive indication callback function.
      container EthIfSwitch [0..*]  # This container contains the configuration of EthIfSwitches.
        integer EthIfSwitchIdx: 0..255, symbolic-name-value=true  # This parameter provides a zero-based consecutive index of the Ethernet Interface Switches. Upper layer BSW modules and the EthIf itself use this index to identify a Ethernet Switch.
        symbolic name reference EthIfSwitchRef: destination=EthSwtConfig  # Reference to a Ethernet Switch, which is handled by a specific Ethernet Switch driver.
      container EthIfTrcvLinkStateChgConfig [1..*]  # Specifies link state change callback function
        function name EthIfTrcvLinkStateChgFunction  # Specifies link state change callback function
      container EthIfTxConfirmationConfig [0..*]  # Configuration of transmit indication callback functions.
        function name EthIfTxConfirmationFunction  # Specifies transmit indication callback function
    container EthIfGeneral  # This container contains the general configuration parameters of the Ethernet Interface.
      boolean EthIfDevErrorDetect  # Switches the Default Error Tracer (Det) detection and notification ON or OFF. | * true: enabled (ON). * false: disabled (OFF).
      boolean EthIfEnableRxInterrupt  # Enables / Disables receive interrupt.
      boolean EthIfEnableTxInterrupt  # Enables / Disables the transmit interrupt.
      boolean EthIfGetBaudRate  # Enables / Disables GetBaudRate API.
      boolean EthIfGetCounterState  # Enables / Disables GetCounterState API.
      boolean EthIfGetTransceiverWakeupModeApi [0..1]: default-value=false  # Enables / Disables EthIf_GetTransceiverWakeupMode API
      boolean EthIfGlobalTimeSupport  # Enables/Disables the Global Time APIs used amongst others by Global Time Synchronization over Ethernet.
      float EthIfMainFunctionPeriod: 0..Inf  # Specifies the period of main function EthIf_MainFunctionRx and EthIf_MainFunctionTx in seconds. Ethernet Interface does not require this information but the BSW scheduler.
      float EthIfMainFunctionRxTimeout [0..1]: 0..Inf  # This parameter is deprecated and will be removed in future. Tags: atp.Status=obsolete, atp.StatusRevisionBegin=4.2.2 | Old description: Timeout in seconds after which the EthIf stops to receive frames in an EthIfMainFunctionRx period. This element is obsolete and will be removed in a future revision.
      integer EthIfMaxTrcvsTotal: 1..255  # Limits the total number of transceivers.
      string EthIfPublicCddHeaderFile [0..*]: max-length=32, min-length=1  # Defines header files for callback functions which shall be included in case of CDDs. Range of characters is 1.. 32.
      integer EthIfRxIndicationIterations [0..1]: 0..65535  # Maximum number of Ethernet frames per Ethernet controller polled from the Ethernet driver within EthIf_MainFunctionRx.
      boolean EthIfStartAutoNegotiation  # Enables / Disables StartAutoNegotiation API.
      integer EthIfTrcvLinkStateChgMainReload: 1..255  # Specifies the frequency of transceiver link state change checks in each | period of main function EthIf_MainFunctionTx.
      boolean EthIfVersionInfoApi  # Enables / Disables version info API
      boolean EthIfVersionInfoApiMacro  # Enables / Disables version info API macro implementation.
      boolean EthIfWakeUpSupport: default-value=false  # Configures if wakeup is supported or not.
      integer ArcEthIfMaxFrameOwnerConfig: 1..255, origin=ARCCORE_ECUC, default-value=5  # Precompile parameter to provide an estimate to EthIf source code to provide a maximum number of EthIfFrameOwnerConfig containers. | Maximum EthIfFrameOwnerConfig containers permitted.
package /ArcCore/EcucDefs/Generic/Implementations
  bsw implementation EthIf: programming-language=C, sw-version=1.1.0, used-code-generator=communication::EthIf::gen::EthIf::main, vendor-id=60, ar-release-version=4.2.2, vendor-specific-module-def=EthIf
