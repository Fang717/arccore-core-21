AUTOSAR XML (schema 4-2-2)
package /ArcCore/Implementations/tms570ls12x
  bsw implementation Can_dcan: programming-language=C, sw-version=6.0.0, used-code-generator=mcal::Can_dcan::gen::Can_dcan_tms570::main, ar-release-version=4.3.0, vendor-specific-module-def=Can
