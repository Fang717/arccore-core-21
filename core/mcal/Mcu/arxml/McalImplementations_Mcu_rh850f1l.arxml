AUTOSAR XML (schema 4-2-2)
package /ArcCore/Implementations/rh850f1l
  bsw implementation Mcu: programming-language=C, sw-version=2.0.0, used-code-generator=mcal::Mcu::gen::Mcu_f1l::main, vendor-id=60, ar-release-version=4.1.2, vendor-specific-module-def=Mcu
