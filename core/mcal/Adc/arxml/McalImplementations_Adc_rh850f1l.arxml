AUTOSAR XML (schema 4-2-2)
package /ArcCore/Implementations/rh850f1l
  bsw implementation Adc: programming-language=C, sw-version=2.0.0, used-code-generator=mcal::Adc::gen::Adc_rh850::main, vendor-id=60, ar-release-version=4.1.3, vendor-specific-module-def=Adc
