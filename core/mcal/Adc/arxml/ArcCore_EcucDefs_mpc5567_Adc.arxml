AUTOSAR XML (schema 4-2-2)
package /ArcCore/EcucDefs/mpc5567
  module definition Adc [0..1]: refined-module-def=Adc, variants post-build/pre-compile  # Configuration of the Adc (Analog Digital Conversion) module.
    container AdcConfigSet: multiple-configuration-container=true  # This is the base container that contains the post-build selectable configuration parameters
      container AdcHwUnit [1..*]  # This container contains the Driver configuration (parameters) depending on grouping of channels | This container could contain HW specific parameters which are not defined in the Standardized Module Definition. They must be added in the Vendor Specific Module Definition.
        enumeration AdcClockSource [0..1]: set at post-build in variant post-build / pre-compile in variant pre-compile  # The ADC module specific clock input for the conversion unit can | statically be configured to select different clock sources if provided by hardware. Enumeration literals are defined vendor specific.
        enumeration AdcHwUnitId: {eQADC_CTRL_A, eQADC_CTRL_B}, set at post-build in variant post-build / pre-compile in variant pre-compile  # Description: Numeric ID of the HW Unit. This symbolic name allows accessing Hw Unit data. Enumeration literals are defined vendor specific.
        integer AdcPrescale [0..1]: 0..65535, set at post-build in variant post-build / pre-compile in variant pre-compile  # Optional ADC module specific clock prescale factor, if supported by hardware. | ImplementationType: Adc_PrescaleType
        enumeration ArcAdcPrescaleDivideFactor [0..1]: {ADC_SYSTEM_CLOCK_DIVIDE_FACTOR_2, ADC_SYSTEM_CLOCK_DIVIDE_FACTOR_34, ADC_SYSTEM_CLOCK_DIVIDE_FACTOR_36, ADC_SYSTEM_CLOCK_DIVIDE_FACTOR_38, ADC_SYSTEM_CLOCK_DIVIDE_FACTOR_10, ADC_SYSTEM_CLOCK_DIVIDE_FACTOR_12, ADC_SYSTEM_CLOCK_DIVIDE_FACTOR_4, ADC_SYSTEM_CLOCK_DIVIDE_FACTOR_6, ADC_SYSTEM_CLOCK_DIVIDE_FACTOR_8, ADC_SYSTEM_CLOCK_DIVIDE_FACTOR_20, ADC_SYSTEM_CLOCK_DIVIDE_FACTOR_22, ADC_SYSTEM_CLOCK_DIVIDE_FACTOR_24, ADC_SYSTEM_CLOCK_DIVIDE_FACTOR_26, ADC_SYSTEM_CLOCK_DIVIDE_FACTOR_28, ADC_SYSTEM_CLOCK_DIVIDE_FACTOR_30, ADC_SYSTEM_CLOCK_DIVIDE_FACTOR_32, ADC_SYSTEM_CLOCK_DIVIDE_FACTOR_14, ADC_SYSTEM_CLOCK_DIVIDE_FACTOR_16, ADC_SYSTEM_CLOCK_DIVIDE_FACTOR_18, ADC_SYSTEM_CLOCK_DIVIDE_FACTOR_40, ADC_SYSTEM_CLOCK_DIVIDE_FACTOR_42, ADC_SYSTEM_CLOCK_DIVIDE_FACTOR_44, ADC_SYSTEM_CLOCK_DIVIDE_FACTOR_46, ADC_SYSTEM_CLOCK_DIVIDE_FACTOR_48, ADC_SYSTEM_CLOCK_DIVIDE_FACTOR_50, ADC_SYSTEM_CLOCK_DIVIDE_FACTOR_52, ADC_SYSTEM_CLOCK_DIVIDE_FACTOR_54, ADC_SYSTEM_CLOCK_DIVIDE_FACTOR_56, ADC_SYSTEM_CLOCK_DIVIDE_FACTOR_58, ADC_SYSTEM_CLOCK_DIVIDE_FACTOR_60, ADC_SYSTEM_CLOCK_DIVIDE_FACTOR_62, ADC_SYSTEM_CLOCK_DIVIDE_FACTOR_64}, set at post-build in variant post-build / pre-compile in variant pre-compile, origin=ARCCORE  # Description: ArcAdcPrescaleDivideFactor describes the clock divide factor. Half bus clock (Value 2) and Same bus clock (Value 1)
        container AdcChannel [1..*]  # This container contains the channel configuration (parameters) depending on the hardware capability. | The organization of this data structure could contain dependencies to the microcontroller so this is left up to the implementer and its location is left up to the configuration. Note: Since a AdcChannel can be part of several AdcGroups, this container is not realized as a subcontainer of AdcGroup but instead as a subcontainer of AdcHwUnit.
          integer AdcChannelConvTime [0..1]: 0..18446744073709551615, set at post-build in variant post-build / pre-compile in variant pre-compile  # Configuration of conversion time, i.e. the time during which the analogue value is converted into digital representation, (in clock cycles) for each channel, if supported by hardware. | ImplementationType: Adc_ConversionTimeType
          integer AdcChannelHighLimit [0..1]: 0..18446744073709551615, set at pre-compile  # High limit - used for limit checking.
          integer AdcChannelId: 0..1024, set at post-build in variant post-build / pre-compile in variant pre-compile  # This parameter defines the assignment of the channel to the physical ADC hardware channel. | ImplementationType: Adc_ChannelType
          boolean AdcChannelLimitCheck [0..1]: set at pre-compile  # Enables or disables limit checking for an ADC channel.
          integer AdcChannelLowLimit [0..1]: 0..18446744073709551615, set at pre-compile  # Low limit - used for limit checking.
          enumeration AdcChannelRangeSelect [0..1]: {ADC_RANGE_ALWAYS, ADC_RANGE_BETWEEN, ADC_RANGE_NOT_BETWEEN, ADC_RANGE_NOT_OVER_HIGH, ADC_RANGE_NOT_UNDER_LOW, ADC_RANGE_OVER_HIGH, ADC_RANGE_UNDER_LOW}, set at pre-compile  # In case of active limit checking: defines which conversion values are taken into account related to the boarders defined with AdcChannelLowLimit and AdcChannelHighLimit. | Implementation Type: Adc_ChannelRangeSelectType
          enumeration AdcChannelRefVoltsrcHigh [0..1]: set at post-build in variant post-build / pre-compile in variant pre-compile  # Upper reference voltage source for each channel. | Enumeration literals are defined vendor specific.
          enumeration AdcChannelRefVoltsrcLow [0..1]: set at post-build in variant post-build / pre-compile in variant pre-compile  # Lower reference voltage source for each channel. | Enumeration literals are defined vendor specific.
          integer AdcChannelResolution [0..1]: 1..63, set at post-build in variant post-build / pre-compile in variant pre-compile  # Channel resolution in bits. | ImplementationType: Adc_ResolutionType
          integer AdcChannelSampTime [0..1]: 0..18446744073709551615, set at post-build in variant post-build / pre-compile in variant pre-compile  # Configuration of sampling time, i.e. the time during which the value is sampled, (in clock cycles) for each channel, if supported by hardware. | ImplementationType: Adc_SamplingTimeType
          enumeration ArcAdcChannelId: {ADC_CH0, ADC_CH1, ADC_CH2, ADC_CH3, ADC_CH4, ADC_CH5, ADC_CH6, ADC_CH7, ADC_CH8, ADC_CH9, ADC_CH10, ADC_CH11, ADC_CH12, ADC_CH13, ADC_CH14, ADC_CH15, ADC_CH32, ADC_CH33, ADC_CH34, ADC_CH35, ADC_CH36, ADC_CH37, ADC_CH38, ADC_CH39, ADC_CH16, ADC_CH17, ADC_CH18, ADC_CH19, ADC_CH20, ADC_CH21, ADC_CH22, ADC_CH23, ADC_CH24, ADC_CH25, ADC_CH26, ADC_CH27, ADC_CH28, ADC_CH29, ADC_CH30, ADC_CH31}, set at post-build in variant post-build / pre-compile in variant pre-compile, origin=ARCCORE  # This parameter defines the assignment of the channel to the physical ADC hardware channel. | ImplementationType: Adc_ChannelType
          enumeration ArcAdcChannelConvTime: {ADC_CONVERSION_TIME_2_CLOCKS, ADC_CONVERSION_TIME_8_CLOCKS, ADC_CONVERSION_TIME_64_CLOCKS, ADC_CONVERSION_TIME_128_CLOCKS}, set at post-build in variant post-build / pre-compile in variant pre-compile, origin=ARCCORE  # This parameter defines the assignment of the channel to the physical ADC hardware channel. | ImplementationType: Adc_ChannelType
          boolean ArcAdcChannelCalibrationEnable: set at pre-compile
        container AdcGroup [1..*]  # This container contains the Group configuration (parameters).
          enumeration AdcGroupAccessMode: {ADC_ACCESS_MODE_SINGLE, ADC_ACCESS_MODE_STREAMING}, set at post-build in variant post-build / pre-compile in variant pre-compile  # Type of access mode to group conversion results. | ImplementationType: Adc_GroupAccessModeType
          enumeration AdcGroupConversionMode: {ADC_CONV_MODE_CONTINUOUS, ADC_CONV_MODE_ONESHOT}, set at post-build in variant post-build / pre-compile in variant pre-compile  # Type of conversion mode supported by the driver. | ImplementationType: Adc_GroupConvModeType
          integer AdcGroupId: 0..1023, set at post-build in variant post-build / pre-compile in variant pre-compile, symbolic-name-value=true  # Numeric ID of the group. This parameter is the symbolic name to be used on the API. This symbolic name allows accessing Channel Group data. This value will be assigned to the symbolic name derived of the AdcGroup container shortName. | ImplementationType: Adc_GroupType
          integer AdcGroupPriority [0..1]: 0..255, set at post-build in variant post-build / pre-compile in variant pre-compile  # Priority level of the AdcGroup. | ImplementationType: Adc_GroupPriorityType
          enumeration AdcGroupReplacement [0..1]: {ADC_GROUP_REPL_ABORT_RESTART, ADC_GROUP_REPL_SUSPEND_RESUME}, set at post-build in variant post-build / pre-compile in variant pre-compile  # Replacement mechanism, which is used on ADC group level, if a group conversion is interrupted by a group which has a higher priority. | ImplementationType: Adc_GroupReplacementType
          enumeration AdcGroupTriggSrc: {ADC_TRIGG_SRC_HW, ADC_TRIGG_SRC_SW}, set at post-build in variant post-build / pre-compile in variant pre-compile  # Type of source event that starts a group conversion. | ImplementationType: Adc_TriggerSourceType
          enumeration AdcHwTrigSignal [0..1]: {ADC_HW_TRIG_BOTH_EDGES, ADC_HW_TRIG_FALLING_EDGE, ADC_HW_TRIG_RISING_EDGE}, set at post-build in variant post-build / pre-compile in variant pre-compile  # Configures on which edge of the hardware trigger signal the driver should react, i.e. start the conversion (only if supported by the ADC hardware). | ImplementationType: Adc_HwTriggerSignalType
          integer AdcHwTrigTimer [0..1]: 0..18446744073709551615, set at post-build in variant post-build / pre-compile in variant pre-compile  # Reload value of the ADC module embedded timer (only if supported by ADC hardware). | ImplementationType: Adc_HwTriggerTimerType
          function name AdcNotification [0..1]: set at post-build in variant post-build / pre-compile in variant pre-compile  # Callback function for each group
          enumeration AdcStreamingBufferMode: {ADC_STREAM_BUFFER_CIRCULAR, ADC_STREAM_BUFFER_LINEAR}, set at post-build in variant post-build / pre-compile in variant pre-compile  # Configure streaming buffer as "linear buffer" (i.e. the ADC Driver stops the conversion as soon as the stream buffer is full) or as "ring buffer" (wraps around if the end of the stream buffer is reached). | ImplementationType: Adc_StreamBufferModeType
          integer AdcStreamingNumSamples: 1..255, set at post-build in variant post-build / pre-compile in variant pre-compile, default-value=1  # Number of ADC values to be acquired per channel in streaming access mode. | Note: in single access mode this parameter assumes value 1, since only one sample per channel is processed. ImplementationType: Adc_StreamNumSampleType
          reference AdcGroupDefinition [1..*]: set at post-build in variant post-build / pre-compile in variant pre-compile, destination=AdcChannel  # Assignment of AdcChannels to a AdcGroups. | ImplementationType: Adc_GroupDefType
    container AdcGeneral  # General configuration (parameters) of the ADC Driver software module.
      boolean AdcDeInitApi: set at pre-compile, default-value=0  # Adds / removes the service Adc_DeInit() from the code. | true: Adc_DeInit() can be used. false: Adc_DeInit() can not be used.
      boolean AdcDevErrorDetect: set at pre-compile, default-value=1  # Switches the Development Error Detection and Notification ON or OFF. | true: Enabled. false: Disabled.
      boolean AdcEnableLimitCheck: set at pre-compile  # Enables or disables limit checking feature in the ADC driver.
      boolean AdcEnableQueuing: set at pre-compile  # Determines, if the queuing mechanism is active in case of priority mechanism disabled. | Note: If priority mechanism is enabled, queuing mechanism is always active and the parameter ADC_ENABLE_QUEUING is not evaluated. true: Enabled. false: Disabled.
      boolean AdcEnableStartStopGroupApi: set at pre-compile, default-value=0  # Adds / removes the services Adc_StartGroupConversion() and Adc_StopGroupConversion() from the code. | true: Adc_StartGroupConversion() and Adc_StopGroupConversion() can be used. false: Adc_StartGroupConversion() and Adc_StopGroupConversion() can not be used.
      boolean AdcGrpNotifCapability: set at pre-compile, default-value=0  # Determines, if the group notification mechanism (the functions to enable and disable the notifications) is available at runtime. | true: Enabled. false: Disabled.
      boolean AdcHwTriggerApi: set at pre-compile  # Adds / removes the services Adc_EnableHardwareTrigger() and Adc_DisableHardwareTrigger() from the code. | true: Adc_EnableHardwareTrigger() and Adc_DisableHardwareTrigger() can be used. false: Adc_EnableHardwareTrigger() and Adc_DisableHardwareTrigger() can not be used.
      enumeration AdcPriorityImplementation: {ADC_PRIORITY_HW, ADC_PRIORITY_HW_SW, ADC_PRIORITY_NONE}, set at pre-compile  # Determines whether a priority mechanism is available for prioritization of the conversion requests and if available, the type of prioritization mechanism. The selection applies for groups with trigger source software and trigger source hardware. Two | types of prioritization mechanism can be selected. The hardware prioritization mechanism (AdcPriorityHw) uses the ADC hardware features for prioritization of the software conversion requests and hardware trigger signals for groups with trigger source hardware. The mixed hardware and software prioritization mechanism (AdcPriorityHwSw) uses the ADC hardware features for prioritization of ADC hardware trigger for groups with trigger source hardware and a software implemented prioritization mechanism for groups with trigger source software. The group priorities for software triggered groups are typically configured with lower priority levels than the group priorities for hardware triggered groups. ImplementationType: Adc_PriorityImplementationType
      boolean AdcReadGroupApi: set at pre-compile, default-value=1  # Adds / removes the service Adc_ReadGroup() and from the code. | true: Adc_ReadGroup() can be used. false: Adc_ReadGroup() can not be used.
      enumeration AdcResultAlignment: {ADC_ALIGN_LEFT, ADC_ALIGN_RIGHT}, set at pre-compile  # Alignment of ADC raw results in ADC result buffer (left/right alignment). | Implementation Type: Adc_ResultAlignmentType
      boolean AdcVersionInfoApi: set at pre-compile  # Adds / removes the service Adc_GetVersionInfo() from the code. | true: Adc_GetVersionInfo() can be used. false: Adc_GetVersionInfor() can not be used.
      boolean AdcLowPowerStatesSupport [0..1]: set at pre-compile, default-value=false  # Adds / removes all power state management related APIs (ADC_SetPowerState, ADC_GetCurrentPowerState, ADC_GetTargetPowerState, ADC_PreparePowerState, ADC_Main_PowerTransitionManager), indicating if the HW offers low power state management.
      boolean AdcPowerStateAsynchTransitionMode [0..1]: set at pre-compile, default-value=false  # Enables / disables support of the ADCDriver to the asynchronous power state transition.
      container AdcPowerStateConfig [0..*]  # Each instance of this parameter defines a power state and the callback to be called when this power state is reached.
        integer AdcPowerState: 0..18446744073709551615, set at pre-compile, symbolic-name-value=true  # Each instance of this parameter describes a different power state supported by the ADC HW. It should be defined by the HW supplier and used by the ADCDriver to reference specific HW configurations which set the ADC HW module in the referenced power state. | At least the power mode corresponding to full power state shall be always configured.
        function name AdcPowerStateReadyCbkRef: set at pre-compile  # Each instance of this parameter contains a reference to a power mode callback defined in a CDD or IoHwAbs component.
    container AdcPublishedInformation  # Additional published parameters not covered by CommonPublishedInformation container. | Note that these parameters do not have any configuration class setting, since they are published information.
      boolean AdcChannelValueSigned: set at published-information  # Information whether the result value of the ADC driver has sign information (true) or not (false). If the result shall be interpreted as signed value it shall apply to C-language rules.
      boolean AdcGroupFirstChannelFixed: set at published-information  # Information whether the first channel of an ADC Channel group can be configured (false) or is fixed (true) to a value determined by the ADC HW Unit.
      integer AdcMaxChannelResolution: 1..63, set at published-information  # Maximum Channel resolution in bits (does not specify accuracy).
