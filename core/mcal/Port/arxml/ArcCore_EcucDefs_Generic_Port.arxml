AUTOSAR XML (schema 4-2-2)
package /ArcCore/EcucDefs/Generic
  module definition Port [0..1]: variants post-build/pre-compile  # Configuration of the Port module.
    container PortConfigSet: multiple-configuration-container=true  # This container is the base of a multiple configuration set
      container PortContainer [1..*]  # Container collecting the PortPins.
        integer PortNumberOfPortPins: 1..65535, set at pre-compile  # The number of specified PortPins in this PortContainer.
        container PortPin [1..*]  # Configuration of the individual port pins.
          enumeration PortPinDirection: {PORT_PIN_IN, PORT_PIN_OUT}, set at post-build in variant post-build / pre-compile in variant pre-compile  # The initial direction of the pin (IN or OUT). If the direction is not changeable, the value configured here is fixed. | The direction must match the pin mode. E.g. a pin used for an ADC must be configured to be an in port. Implementation Type: Port_PinDirectionType
          boolean PortPinDirectionChangeable: set at post-build in variant post-build / pre-compile in variant pre-compile  # Parameter to indicate if the direction is changeable on a port pin during runtime. | true: Port Pin direction changeable enabled. false: Port Pin direction changeable disabled.
          integer PortPinId: 1..65535, set at pre-compile, symbolic-name-value=true  # Pin Id of the port pin. This value will be assigned to the symbolic name derived from the port pin container short name.
          enumeration PortPinInitialMode: {PORT_PIN_MODE_ADC, PORT_PIN_MODE_CAN, PORT_PIN_MODE_DIO, PORT_PIN_MODE_DIO_GPT, PORT_PIN_MODE_DIO_WDG, PORT_PIN_MODE_FLEXRAY, PORT_PIN_MODE_ICU, PORT_PIN_MODE_LIN, PORT_PIN_MODE_MEM, PORT_PIN_MODE_PWM, PORT_PIN_MODE_SPI, PORT_PIN_MODE_OTHER, PORT_PIN_MODE_OTHER0, PORT_PIN_MODE_OTHER1, PORT_PIN_MODE_OTHER2, PORT_PIN_MODE_OTHER3, PORT_PIN_MODE_ETH, PORT_PIN_MODE_SPI0, PORT_PIN_MODE_SPI_A, PORT_PIN_MODE_SPI_B, PORT_PIN_MODE_SPI_C, PORT_PIN_MODE_SPI_D, PORT_PIN_MODE_CAN0, PORT_PIN_MODE_OTHER_A, PORT_PIN_MODE_OTHER8, PORT_PIN_MODE_OTHER67, PORT_PIN_MODE_OTHER_P, PORT_PIN_MODE_LCD, PORT_PIN_MODE_DCU, PORT_PIN_MODE_I2C, PORT_PIN_MODE_PDI, PORT_PIN_MODE_SSD, PORT_PIN_MODE_CONTROL, PORT_PIN_MODE_SGL, PORT_PIN_MODE_SMC, PORT_PIN_MODE_NMI, PORT_PIN_MODE_JTAG, PORT_PIN_MODE_NEXUS, PORT_PIN_MODE_SOUND, PORT_PIN_MODE_ETH0, PORT_PIN_MODE_GPT}, set at post-build in variant post-build / pre-compile in variant pre-compile  # Port pin mode from mode list for use with Port_Init() function.
          enumeration PortPinLevelValue: {PORT_PIN_LEVEL_HIGH, PORT_PIN_LEVEL_LOW}, set at post-build in variant post-build / pre-compile in variant pre-compile  # Port Pin Level value from Port pin list.
          enumeration PortPinMode [1..*]: {PORT_PIN_MODE_ADC, PORT_PIN_MODE_CAN, PORT_PIN_MODE_DIO, PORT_PIN_MODE_DIO_GPT, PORT_PIN_MODE_DIO_WDG, PORT_PIN_MODE_FLEXRAY, PORT_PIN_MODE_ICU, PORT_PIN_MODE_LIN, PORT_PIN_MODE_MEM, PORT_PIN_MODE_PWM, PORT_PIN_MODE_SPI, PORT_PIN_MODE_ETH, PORT_PIN_MODE_OTHER, PORT_PIN_MODE_SPI0, PORT_PIN_MODE_CAN0, PORT_PIN_MODE_OTHER0, PORT_PIN_MODE_OTHER1, PORT_PIN_MODE_OTHER2, PORT_PIN_MODE_OTHER3, PORT_PIN_MODE_ETH0}, set at post-build in variant post-build / pre-compile in variant pre-compile  # Port pin mode from mode list. | Note that more than one mode is allowed by default. That way it is e.g. possible to combine DIO with another mode such as ICU.
          boolean PortPinModeChangeable: set at post-build in variant post-build / pre-compile in variant pre-compile  # Parameter to indicate if the mode is changeable on a port pin during runtime. True: Port Pin mode changeable allowed. False: Port Pin mode changeable not permitted.
          enumeration ArcPortPinPull: {PORT_PIN_PULL_NONE, PORT_PIN_PULL_UP, PORT_PIN_PULL_DOWN}, set at post-build in variant post-build / pre-compile in variant pre-compile, origin=ARCCORE_ECUC  # Sets internal pull up or pull down for this pin.
          enumeration ArcPortPinSlewRate: {PORT_PIN_SLEW_RATE_MIN, PORT_PIN_SLEW_RATE_MED, PORT_PIN_SLEW_RATE_MAX}, set at post-build in variant post-build / pre-compile in variant pre-compile, origin=ARCCORE_ECUC  # Sets the slew rate for this pin.
          boolean ArcPortPinOpenDrainEnable: set at post-build in variant post-build / pre-compile in variant pre-compile, origin=ARCCORE_ECUC, default-value=0  # Parameter to indicate if this pin has Open drain output enabled.
    container PortGeneral  # Module wide configuration parameters of the PORT driver.
      boolean PortDevErrorDetect: set at pre-compile, default-value=1  # Switches the Development Error Detection and Notification on or off. | true: Enabled. false: Disabled.
      boolean PortSetPinDirectionApi: set at pre-compile, default-value=0  # Pre-processor switch to enable / disable the use of the function Port_SetPinDirection(). | TRUE: Enabled - Function Port_SetPinDirection() is available. FALSE: Disabled - Function Port_SetPinDirection() is not available.
      boolean PortSetPinModeApi: set at pre-compile, default-value=0  # Pre-processor switch to enable / disable the use of the function Port_SetPinMode(). | true: Enabled - Function Port_SetPinMode() is available. false: Disabled - Function Port_SetPinMode() is not available.
      boolean PortVersionInfoApi: set at pre-compile, default-value=0  # Pre-processor switch to enable / disable the API to read out the modules version information. | true: Version info API enabled. false: Version info API disabled.
package /ArcCore/EcucDefs/Generic/Implementations
  bsw implementation Port: sw-version=7.0.0, used-code-generator=mcal::Port::gen::Port::main, vendor-id=60, ar-release-version=4.3.0, vendor-specific-module-def=Port
