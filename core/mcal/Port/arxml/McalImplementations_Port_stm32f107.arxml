AUTOSAR XML (schema 4-2-2)
package /ArcCore/Implementations/stm32f107
  bsw implementation Port: sw-version=5.0.1, used-code-generator=mcal::Port::gen::Port_stm32f10x::main, vendor-id=60, ar-release-version=4.1.2, vendor-specific-module-def=Port
