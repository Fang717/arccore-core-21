AUTOSAR XML (schema 4-2-2)
package /ArcCore/Implementations/mpc5747c
  bsw implementation Eth: sw-version=1.0.0, used-code-generator=mcal::Eth::gen::Eth::main, vendor-id=60, ar-release-version=4.2.2, vendor-specific-module-def=Eth
