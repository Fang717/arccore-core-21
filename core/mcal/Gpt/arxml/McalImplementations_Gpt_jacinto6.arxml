AUTOSAR XML (schema 4-2-2)
package /ArcCore/Implementations/jacinto6
  bsw implementation Gpt: programming-language=C, sw-version=3.0.0, used-code-generator=mcal::Gpt::gen::Gpt_jacinto::main, vendor-id=60, ar-release-version=4.1.2, vendor-specific-module-def=Gpt
