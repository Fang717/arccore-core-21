AUTOSAR XML (schema 4-2-2)
package /ArcCore/Implementations/rh850f1l
  bsw implementation Fr: programming-language=C, sw-version=1.0.0, used-code-generator=mcal::Fr::gen::Fr_rh850::main, vendor-id=60, ar-release-version=4.0.3, vendor-specific-module-def=Fr
