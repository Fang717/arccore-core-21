AUTOSAR XML (schema 4-2-2)
package /ArcCore/Implementations/mpc5746c
  bsw implementation Fr: programming-language=C, sw-version=1.0.0, used-code-generator=mcal::Fr::gen::Fr_mpc560x::main, vendor-id=60, ar-release-version=4.0.3, vendor-specific-module-def=Fr
