AUTOSAR XML (schema 4-2-2)
package /ArcCore/EcucDefs/Implementations/spc560b54
  bsw implementation Spi: programming-language=C, sw-version=2.0.0, used-code-generator=mcal::Spi::gen::Spi_mpc560x::main, vendor-id=60, ar-release-version=4.1.2, vendor-specific-module-def=Spi
