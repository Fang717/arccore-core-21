AUTOSAR XML (schema 4-2-2)
package /ArcCore/EcucDefs/mpc5567/Implementations
  bsw implementation Dio: programming-language=C, sw-version=6.0.0, used-code-generator=mcal::Dio::gen::Dio_mpc5567::main, vendor-id=60, ar-release-version=4.3.0, vendor-api-infix=NOT_USED, vendor-specific-module-def=Dio
