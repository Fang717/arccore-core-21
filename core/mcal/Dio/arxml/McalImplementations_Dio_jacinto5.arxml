AUTOSAR XML (schema 4-2-2)
package /ArcCore/Implementations/jacinto5
  bsw implementation Dio: programming-language=C, sw-version=5.0.0, used-code-generator=mcal::Dio::gen::Dio_jacinto::main, ar-release-version=4.1.2, vendor-specific-module-def=Dio
