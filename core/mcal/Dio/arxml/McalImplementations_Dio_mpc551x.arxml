AUTOSAR XML (schema 4-2-2)
package /ArcCore/EcucDefs/mpc551x/Implementations
  bsw implementation Dio: sw-version=6.0.0, used-code-generator=mcal::Dio::gen::Dio_mpc551x::main, vendor-id=60, ar-release-version=4.3.0, vendor-specific-module-def=Dio
