AUTOSAR XML (schema 4-2-2)
package /ArcCore/Implementations/rh850f1l
  bsw implementation Dio: programming-language=C, sw-version=5.0.0, used-code-generator=mcal::Dio::gen::Dio_rh850::main, vendor-id=60, ar-release-version=4.1.2, vendor-specific-module-def=Dio
