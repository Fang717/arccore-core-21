AUTOSAR XML (schema 4-2-2)
package /ArcCore/Implementations/mpc5746c
  bsw implementation Wdg: programming-language=C, sw-version=2.0.0, used-code-generator=mcal::Wdg::gen::Wdg_mpc560x::main, ar-release-version=4.1.2, vendor-specific-module-def=Wdg
