AUTOSAR XML (schema 4-2-2)
package /ArcCore/EcucDefs/mpc5567/Implementations
  bsw implementation Pwm: programming-language=C, sw-version=2.1.0, used-code-generator=mcal::Pwm::gen::Pwm_mpc5567::main, ar-release-version=4.1.2, vendor-specific-module-def=Pwm
