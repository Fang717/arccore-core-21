AUTOSAR XML (schema 4-2-2)
package /ArcCore/Implementations/stm32f107
  bsw implementation Pwm: programming-language=C, sw-version=2.1.0, used-code-generator=mcal::Pwm::gen::Pwm_stm32f10x::main, ar-release-version=4.1.2, vendor-specific-module-def=Pwm
