AUTOSAR XML (schema 4-2-2)
package /ArcCore/Implementations/mpc5748g
  bsw implementation Pwm: programming-language=C, sw-version=2.1.0, used-code-generator=mcal::Pwm::gen::Pwm_mpc560x::main, vendor-id=60, ar-release-version=4.1.2, vendor-specific-module-def=Pwm
