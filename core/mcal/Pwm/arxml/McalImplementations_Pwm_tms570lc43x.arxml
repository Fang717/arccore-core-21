AUTOSAR XML (schema 4-2-2)
package /ArcCore/Implementations/tms570lc43x
  bsw implementation Pwm: programming-language=C, sw-version=2.1.0, used-code-generator=mcal::Pwm::gen::Pwm_tms570::main, ar-release-version=4.1.2, vendor-specific-module-def=Pwm
