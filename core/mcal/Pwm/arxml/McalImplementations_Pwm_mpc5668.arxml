AUTOSAR XML (schema 4-2-2)
package /ArcCore/Implementations/mpc5668
  bsw implementation Pwm: programming-language=CPP, sw-version=2.1.0, used-code-generator=mcal::Pwm::gen::Pwm_mpc560x::main, vendor-id=60, ar-release-version=4.1.2, vendor-specific-module-def=Pwm
