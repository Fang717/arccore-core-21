AUTOSAR XML (schema 4-2-2)
package /ArcCore/Implementations/jacinto6
  bsw implementation Lin: programming-language=C, sw-version=2.1.0, used-code-generator=mcal::Lin::gen::Lin_jacinto::main, ar-release-version=4.1.2, vendor-specific-module-def=Lin
