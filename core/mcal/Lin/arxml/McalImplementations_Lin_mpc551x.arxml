AUTOSAR XML (schema 4-2-2)
package /ArcCore/EcucDefs/mpc551x/Implementations
  bsw implementation Lin: programming-language=C, sw-version=2.1.1, used-code-generator=mcal::Lin::gen::Lin_mpc551x::main, vendor-id=60, ar-release-version=4.1.2, vendor-specific-module-def=Lin
