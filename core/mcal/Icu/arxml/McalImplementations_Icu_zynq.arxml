AUTOSAR XML (schema 4-2-2)
package /ArcCore/Implementations/zynq
  bsw implementation Icu: programming-language=C, sw-version=3.0.0, used-code-generator=mcal::Icu::gen::Icu_zynq::main, vendor-id=60, ar-release-version=4.1.2, vendor-specific-module-def=Icu
