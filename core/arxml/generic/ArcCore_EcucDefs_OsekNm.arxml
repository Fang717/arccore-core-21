AUTOSAR XML (schema 4-2-2)
package /ArcCore/EcucDefs/Generic
  module definition OsekNm [0..1]: variants pre-compile  # Configuration of the OsekNm module.
    container OsekNmGeneral  # General configuration of OsekNm module.
      boolean OsekNmDevErrorDetect: set at pre-compile, origin=ARCCORE_ECUC  # Switch to enable development error tracer (DET) error reporting.
      boolean OsekNmVersionInfoApi: set at pre-compile, origin=ARCCORE_ECUC  # true: OsekNm_GetVersionInfor() can be used. false: OsekNm_GetVersionInfor() can not be used.
      integer OsekNmNmMainFunctionPeriod: set at pre-compile, origin=ARCCORE_ECUC  # Main function period in milli seconds at which OsekNm node states are processed.
      integer OsekNmRxRetryCount [0..1]: set at pre-compile, origin=ARCCORE_ECUC, default-value=4  # NMrxcount: Maximum counter value used to detect failure at the receive functionality of direct Nm.
      integer OsekNmTxRetryCount [0..1]: set at pre-compile, origin=ARCCORE_ECUC, default-value=8  # NMtxcount: Maximum counter value used to detect failure at the transmit functionality of direct Nm.
      function name OsekNmDirectStateChangeNotification [0..1]: set at pre-compile  # configuration for callback function for state change notification for direct Node | Call back function to upperlayer about state change in directNm Node
      function name OsekNmInDirectStateChangeNotification [0..1]: set at pre-compile  # configuration for callback function for state change notification for Indirect Node | Call back function to upperlayer about state change in IndirectNm Node
    container OsekNmIndirectNmNode [0..255]  # Configuration of node in Indirect NM.
      integer OsekNmNodeId: 0..255, set at pre-compile, origin=ARCCORE_ECUC  # Node identifier used by this communication channel.
      integer OsekNmNetId: 0..255, set at pre-compile, origin=ARCCORE_ECUC  # Network identifier value.
      enumeration OsekNmNodeType: {MASTER, SLAVE}, set at pre-compile, origin=ARCCORE_ECUC  # Node type.
      enumeration OsekNmConfigKindName: {NORMAL, NORMAL_EXTENDED}, set at pre-compile, origin=ARCCORE_ECUC  # Unique name defining the requested kind of configuration supported by Indirect Nm.
      enumeration OsekNmTimeoutType: {GLOBAL_TIMEOUT, TIMEOUT_PER_MESSAGE}, set at pre-compile, origin=ARCCORE_ECUC  # Timeout calculation option.
      integer OsekNmGlobalTimeout [0..1]: set at pre-compile, origin=ARCCORE_ECUC  # TOB: Time in milli seconds to monitor a subset of nodes.
      integer OsekNmErrorCycleTime: set at pre-compile, origin=ARCCORE_ECUC  # TError: Cycle time in milli seconds in which a node signals that an error has occurred.
      integer OsekNmWaitBusSleepTime: set at pre-compile, origin=ARCCORE_ECUC  # Time in milli seconds NM waits before transmission in NMBusSleep.
      integer OsekNmDeltaIncrementCount [0..1]: set at pre-compile, origin=ARCCORE_ECUC  # DeltaInc: Value to increment the node status counter when a message is not received during a given time.
      integer OsekNmDeltaDecrementCount [0..1]: set at pre-compile, origin=ARCCORE_ECUC  # DeltaDec: Value to decrement the node status counter when a message is received.
      reference OsekNmTransmitComSignalRef: set at pre-compile, origin=ARCCORE_ECUC, destination=ComSignal  # Reference to Com signal which is used for transmission NM PDU.
      reference OsekNmComMNetworkHandleRef: set at pre-compile, origin=ARCCORE_ECUC, destination=ComMChannel  # This reference points to the unique channel defined by the ComMChannel and provides access to the unique channel index value in ComMChannelId.
      container OsekNmIndirectNmSlaveNode [0..1]  # Configuration details of slave nodes, this container is applicable only for a master node.
        integer OsekNmSlaveNodeId: 0..255, set at pre-compile, origin=ARCCORE_ECUC  # Node identifier of the slave.
        integer OsekNmDeltaDecrementCount [0..1]: set at pre-compile, origin=ARCCORE_ECUC  # DeltaDec: Value to decrement the node status counter when a message is received.
        integer OsekNmDeltaIncrementCount [0..1]: set at pre-compile, origin=ARCCORE_ECUC  # DeltaInc: Value to increment the node status counter when a message is not received during a given time.
        reference OsekNmComSignalRef: set at pre-compile, origin=ARCCORE_ECUC, destination=ComSignal  # Reference to receive Com signal sent by the slave.
      container OsekNmIndirectNmMasterNode [0..1]  # Configuration details of master node, this container is applicable only for a slave node.
        integer OsekNmMasterNodeId: 0..255, set at pre-compile, origin=ARCCORE_ECUC  # Node identifier of the master.
        integer OsekNmDeltaDecrementCount [0..1]: set at pre-compile, origin=ARCCORE_ECUC  # DeltaDec: Value to decrement the node status counter when a message is received.
        integer OsekNmDeltaIncrementCount [0..1]: set at pre-compile, origin=ARCCORE_ECUC  # DeltaInc: Value to increment the node status counter when a message is not received during a given time.
        reference OsekNmComSignalRef: set at pre-compile, origin=ARCCORE_ECUC, destination=ComSignal  # Reference to receive Com signal which is sent by master node.
    container OsekNmDirectNmNode [0..255]  # Configuration of node in Direct NM.
      integer OsekNmNodeId: 0..255, set at pre-compile, origin=ARCCORE_ECUC  # Node identifier used by this communication channel.
      integer OsekNmNetId: 0..255, set at pre-compile, origin=ARCCORE_ECUC  # Network identifier value.
      integer OsekNmErrorCycleTime: set at pre-compile, origin=ARCCORE_ECUC  # TError: Cycle time in milli seconds in which a node signals that an error has occurred.
      integer OsekNmWaitBusSleepTime: set at pre-compile, origin=ARCCORE_ECUC  # Time in milli seconds NM waits before transmission in NMBusSleep.
      integer OsekNmMaximumTimeInterval: set at pre-compile, origin=ARCCORE_ECUC  # TMax: Maximum admissible interval in milli seconds between two ring messages on the bus.
      integer OsekNmTimeInterval: set at pre-compile, origin=ARCCORE_ECUC  # TTyp: Typical interval in milli seconds between two ring messages on the bus.
      integer OsekNmMaximumNodes: 0..255, set at pre-compile, origin=ARCCORE_ECUC  # Maximum number of nodes possible in the participating network.
      integer OsekNmRepeatRequestDelay: set at pre-compile, origin=ARCCORE_ECUC  # TTx: Delay in milli seconds to repeat the transmission request of a NM message if the preceding request was rejected.
      reference OsekNmTransmitLPduRef: set at pre-compile, origin=ARCCORE_ECUC, destination=CanIfTxPduCfg  # Reference to CanIfTxPduCfg which is used for transmission NM PDU.
      reference OsekNmComMNetworkHandleRef: set at pre-compile, origin=ARCCORE_ECUC, destination=ComMChannel  # This reference points to the unique channel defined by the ComMChannel and provides access to the unique channel index value in ComMChannelId.
package /ArcCore/EcucDefs/Generic/Implementations
  bsw implementation OsekNm: sw-version=1.0.0, used-code-generator=communication::OsekNm::gen::OsekNm::main, vendor-id=60, ar-release-version=4.0.3, vendor-specific-module-def=OsekNm
