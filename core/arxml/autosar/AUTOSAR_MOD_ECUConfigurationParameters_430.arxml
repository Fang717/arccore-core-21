AUTOSAR XML (schema 4-0-1)
# The material contained in this specification is protected by copyright and
# other types of Intellectual Property Rights. The commercial exploitation of the
# material contained in this specification requires a license to such
# Intellectual Property Rights.
# This specification may be utilized or reproduced without any modification, in
# any form or by any means, for informational purposes only. For any other
# purpose, no part of the specification may be utilized or reproduced, in any
# form or by any means, without permission in writing from the publisher.
# licensed under the same rules as applicable to the AUTOSAR Standard.
package /AUTOSAR/EcucDefs
  ecuc definition collection AUTOSARParameterDefinition: module=FiM
  module definition FiM [0..1]: variants post-build/pre-compile  # Configuration of the FiM (Function Inhibition Manager) module.
    container FiMConfigSet  # This container contains the configuration parameters and sub containers of the FiM module supporting multiple configuration sets.
      container FiMFID [1..*]  # This container includes symbolic names of all FIDs.
        integer FiMFunctionId: 0..65535, symbolic-name-value=true  # Unique identifier of a FimFunctionId. This parameter should not be changeable by user, because the Id should be generated by Fim itself to prevent gaps and multiple use of an Id. | Note: The implementer can add the attribute 'withAuto' to the parameter definition which indicates that the value can be calculated by the generator automatically. When 'withAuto' is set to 'true' for this parameter definition the 'isAutoValue' can be set to 'true'. If 'isAutoValue' is set to 'true' the actual value will not be considered during ECU Configuration but will be (re-)calculated by the code generator and stored in the value attribute afterwards.
      container FiMInhibitionConfiguration [1..*]  # This container includes all configuration parameters concerning the relationship between event and FID.
        enumeration FiMInhInhibitionMask: {FIM_LAST_FAILED, FIM_NOT_TESTED, FIM_TESTED, FIM_TESTED_AND_FAILED}  # The configuration parameter is used to specify the inhibition mask for an event - FID relation.
        reference FiMInhComponentRef [0..*]: destination=DemComponent  # Reference to a DemComponent which is necessary for function permission. | At least one FiMInhSumRef or FiMInhEventRef or FiMInhComponentRef needs to be configured.
        symbolic name reference FiMInhEventRef [0..*]: destination=DemEventParameter  # Selection of an single DEM Event. | At least one FiMInhSumRef or FiMInhEventRef or FiMInhComponentRef needs to be configured.
        reference FiMInhFunctionIdRef: destination=FiMFID
        reference FiMInhSumRef [0..*]: destination=FiMSummaryEvent  # Selection of a summarized Event. | At least one FiMInhSumRef or FiMInhEventRef or FiMInhComponentRef needs to be configured.
      container FiMSummaryEvent [0..*]  # The summarized EventId definition record consists of a summarized event ID and specific Dem Events. | This record means that a particular FID that has to be disabled in case of summarized event (defined above) is to be disabled in any of the specific events. A possible solution could be assigning events as summarized events along with a list of specific events. During the configuration process the summarized event substitutes the referenced single events. However, it is not outlined how this requirement is solved - whether by configuration process or by implementation within the FiM. The FiM configuration tool could also build up a suitable data structure for summarized events and deal with it in the FiM implementation.
        symbolic name reference FiMInputEventRef [1..*]: destination=DemEventParameter  # Reference to DemEventParameters combined to this summarized event.
    container FiMGeneral
      boolean FiMAvailabilitySupport: default-value=false  # This configuration parameter specifies, if the Fim shall support the service to set the Availabity of a Funtionality. | true: Service is supported. false: Service is not supported
      boolean FiMDevErrorDetect: default-value=false  # Switches the development error detection and notification on or off. | * true: detection and notification is enabled. * false: detection and notification is disabled.
      boolean FiMEventUpdateTriggeredByDem  # This configuration parameter specifies the way FIM obtains status of EventIds. | TRUE: the DEM informs FIM about changes of monitor status, FALSE: the FIM polls monitor status from the DEM module either cyclically or on demand.
      float FiMMainFunctionPeriod: 0..Inf  # Allow to configure the time for the periodic cyclic task. | Please note: This configuration value shall be equal to the value in the Basic Software Scheduler configuration of the RTE module. The AUTOSAR configuration standard is to use SI units, so this parameter is defined as float value in seconds. FiM configuration tools shall convert this float value to the appropriate value format for the use in the software implementation of FiM.
      integer FiMMaxEventsPerFidInhibitionConfiguration [0..1]: 1..65535  # This configuration parameter specifies the total maximum number of inhibiting events in a FiMInhibitionConfiguration. | Its applicable for post build configuration versions only and may be used to allocate the maximum size of memory to store and execute the configuration.
      integer FiMMaxFiMInhibitionConfigurations [0..1]: 1..65535  # This configuration parameter specifies the total maximum number of FiMInhibitionConfigurations. | Its applicable for post build configuration versions only and may be used to allocate the maximum size of memory to store and execute the configuration.
      integer FiMMaxInputEventsPerSummaryEvents [0..1]: 1..65535  # This configuration parameter specifies the total maximum number of input events per summary event. | Its applicable for post build configuration versions only and may be used to allocate the maximum size of memory to store and execute the configuration.
      integer FiMMaxSumEventsPerFidInhibitionConfiguration [0..1]: 1..65535  # This configuration parameter specifies the total maximum number of inhibiting summary events in a FiMInhibitionConfiguration. | Its applicable for post build configuration versions only and may be used to allocate the maximum size of memory to store and execute the configuration.
      integer FiMMaxSummaryEvents: 0..65535  # This configuration parameter specifies the maximum number of summarized events that can be configured.
      boolean FiMVersionInfoApi: default-value=false  # This configuration parameter is used to switch on or to switch off the API to get the version information.
  module definition WdgM [0..1]: variants post-build/pre-compile  # Configuration of the WdgM (Watchdog Manager) module.
    container WdgMConfigSet  # This container describes one of multiple configuration sets of WdgM.
      symbolic name reference WdgMInitialMode: destination=WdgMMode  # The mode that the Watchdog Manager is in after it has been initialized.
      container WdgMDemEventParameterRefs [0..1]  # Container for the references to DemEventParameter elements which shall be invoked using the API Dem_SetEventStatus in case the corresponding error occurs. The EventId is taken from the referenced DemEventParameter's DemEventId symbolic value. The standardized errors are provided in this container and can be extended by vendor-specific error references.
        symbolic name reference WDGM_E_SET_MODE [0..1]: destination=DemEventParameter  # Reference to the DemEventParameter which shall be issued when the error "Watchdog drivers' mode switch has failed" has occurred.
        symbolic name reference WDGM_E_SUPERVISION [0..1]: destination=DemEventParameter  # Reference to the DemEventParameter which shall be issued when the error "Supervision has failed (Global Supervision Status has reached WDGM_GLOBAL_STATUS_STOPPED) and a watchdog reset will occur" has occurred.
      container WdgMMode [1..255]  # The container describes one of several modes of the Watchdog Manager.
        integer WdgMExpiredSupervisionCycleTol: 0..65535  # This parameter shall be used to define a value that fixes the amount of expired supervision cycles for how long the blocking of watchdog triggering shall be postponed, AFTER THE GLOBAL SUPERVISION STATUS HAS REACHED THE STATE EXPIRED.
        integer WdgMModeId: 0..255, symbolic-name-value=true  # This parameter fixes the identifier for the mode. This identifier is for instance passed as a parameter to the WdgM_SetMode service.
        float WdgMSupervisionCycle: 0..Inf  # This parameter defines the schedule period of the main function WdgM_MainFunction. | Unit: [s]
        container WdgMAliveSupervision [0..65535]  # This container collects all configuration parameters of Alive-Supervision of one Checkpoint. Note that each Checkpoint may have different parameters. For example, it may have different min and max margin.
          integer WdgMExpectedAliveIndications: 0..65535  # This parameter contains the amount of expected alive indications of the Checkpoint within the referenced amount of defined supervision cycles according to corresponding SE.
          integer WdgMMaxMargin: 0..255  # This parameter contains the amount of alive indications of the Checkpoint that are acceptable to be additional to the expected alive indications within the corresponding supervision reference cycle.
          integer WdgMMinMargin: 0..255  # This parameter contains the amount of alive indications of the Checkpoint that are acceptable to be missed from the expected alive indications within the corresponding supervision reference cycle.
          integer WdgMSupervisionReferenceCycle: 1..65535  # This parameter shall contain the amount of supervision cycles to be used as reference by the alive-supervision mechanism to perform the checkup with counted alive indications according to corresponding SE.
          symbolic name reference WdgMAliveSupervisionCheckpointRef: destination=WdgMCheckpoint  # Reference to Checkpoint within a Supervised Entity that shall be supervised.
        container WdgMDeadlineSupervision [0..65535]  # This container collects all configuration parameters for Deadline Supervision for a Supervised Entity.
          float WdgMDeadlineMax: 0..Inf  # This parameter contains the longest time span after which the deadline is considered to be met. | Unit: [s]
          float WdgMDeadlineMin: 0..Inf  # This parameter contains the shortest time span after which the deadline is considered to be met. | Unit: [s]
          symbolic name reference WdgMDeadlineStartRef: destination=WdgMCheckpoint  # This is the reference to the start Checkpoint for Deadline Supervision.
          symbolic name reference WdgMDeadlineStopRef: destination=WdgMCheckpoint  # This is the reference to the stop Checkpoint for Deadline Supervision.
        container WdgMExternalLogicalSupervision [0..65535]  # This container collects all configuration parameters for Logical Supervision for one external graph.
          symbolic name reference WdgMExternalCheckpointFinalRef [1..65535]: destination=WdgMCheckpoint  # This is the reference to the final Checkpoint(s) for this External Graph.
          symbolic name reference WdgMExternalCheckpointInitialRef [1..65535]: destination=WdgMCheckpoint  # This is the reference to the initial Checkpoint(s) for this External Graph.
          container WdgMExternalTransition [0..65535]  # This container collects the Checkpoints for an External Transition across Supervised Entities.
            symbolic name reference WdgMExternalTransitionDestRef: destination=WdgMCheckpoint  # This is the reference to the destination Checkpoint of an External Transition.
            symbolic name reference WdgMExternalTransitionSourceRef: destination=WdgMCheckpoint  # This is the reference to the source Checkpoint of an External Transition.
        container WdgMLocalStatusParams [0..65535]  # This container collects all configuration parameters for the Local Status of a Supervised Entity.
          integer WdgMFailedAliveSupervisionRefCycleTol: 0..255  # This parameter shall contain the acceptable amount of reference cycles with incorrect/failed alive supervisions for this Supervised Entity.
          symbolic name reference WdgMLocalStatusSupervisedEntityRef: destination=WdgMSupervisedEntity  # This is the reference to the Supervised Entity for which the Local Status parameters are specified.
        container WdgMTrigger [0..255]  # This container collects all configuration parameters for the triggering of hardware watchdogs.
          integer WdgMTriggerConditionValue: 1..65535  # This parameter shall contain the value that is passed to WdgIf_SetTriggerCondition for this watchdog.
          enumeration WdgMWatchdogMode: {WDGIF_FAST_MODE, WDGIF_OFF_MODE, WDGIF_SLOW_MODE}  # This parameter contains the watchdog mode that shall be used for the referenced watchdog in this Watchdog Manager mode. | Implementation Type: WdgIf_ModeType
          reference WdgMTriggerWatchdogRef: destination=WdgMWatchdog  # This parameter is a reference to the configured watchdog.
    container WdgMGeneral  # Container defines all general configuration parameters of the Watchdog Manager.
      boolean WdgMDemStoppedSupervisionReport  # Parameter to enable/disable the error reporting to DEM. | true: A notification to DEM is sent if the Watchdog Manager reaches the state WDGM_GLOBAL_STATUS_STOPPED. false: The notification is disabled.
      boolean WdgMDevErrorDetect: default-value=false  # Switches the development error detection and notification on or off. | * true: detection and notification is enabled. * false: detection and notification is disabled.
      boolean WdgMImmediateReset  # This parameter enables/disablse the immediate reset feature in case of alive-supervision failure. | true: Immediate reset is enabled false: Immediate reset is disabled
      boolean WdgMOffModeEnabled  # This parameter enables/disables the selection of the "OffMode" of the watchdog driver. | true: "OffMode" selection is allowed false: "OffMode" selection is disallowed
      boolean WdgMVersionInfoApi: default-value=false  # Preprocessor switch to enable/disable the existence of the API WdgM_GetVersionInfo. Shall be used to remove unneeded code segments. | true: API is enabled false: API is disabled
      container WdgMSupervisedEntity [0..65535]  # This container collects all common (mode-independent) parameters of a Supervised Entity to be supervised by the Watchdog Manager.
        integer WdgMSupervisedEntityId: 0..65535, symbolic-name-value=true  # This parameter shall contain the unique identifier of the supervised entity.
        reference WdgMEcucPartitionRef [0..1]: destination=EcucPartition  # Denotes in which "EcucPartition" the supervised entity is executed. When the partition is stopped, the supervised entity shall be de-activated in the WdgM to avoid an ECU reset.
        symbolic name reference WdgMInternalCheckpointInitialRef [1..65535]: destination=WdgMCheckpoint  # This is the reference to the initial Checkpoint for this Supervised Entity.
        symbolic name reference WdgMInternallCheckpointFinalRef [1..65535]: destination=WdgMCheckpoint  # This is the reference to the final Checkpoint(s) for this Supervised Entity.
        reference WdgMOsApplicationRef [0..1]: destination=OsApplication  # Optional reference to an OS Application. Beware, the Watchdog Manager module will trigger a partition restart of this OS Application when the corresponding Supervised Entity reaches WDGM_LOCAL_STATUS_FAILED.
        reference WdgMOSCounter [0..1]: destination=OsCounter  # OS counter used by Watchdog Manager to perform the deadline supervision of the Supervised Entity.
        container WdgMCheckpoint [1..65535]  # This container collects all Checkpoints of this Supervised Entity. Each Supervised Entity has at least one Checkpoint.
          integer WdgMCheckpointId: 0..65535, symbolic-name-value=true  # This parameter shall contain the unique identifier of Checkpoint.
        container WdgMInternalTransition [0..65535]  # This container defines the graph of Internal Transitions within this Supervised Entity.
          symbolic name reference WdgMInternalTransitionDestRef: destination=WdgMCheckpoint  # This is the reference to the destination Checkpoint of a Internal Transition within this Supervised Entity.
          symbolic name reference WdgMInternalTransitionSourceRef: destination=WdgMCheckpoint  # This is the reference to the source Checkpoint of a Internal Transition within this Supervised Entity.
      container WdgMWatchdog [0..255]  # This container collects all common (mode-independent) parameters of a Watchdog to be triggered by the Watchdog Manager.
        string WdgMWatchdogName  # This parameter shall contain the name of the watchdog instance.
        symbolic name reference WdgMWatchdogDeviceRef: destination=WdgIfDevice  # Reference to one device container of Watchdog Interface. In the referenced container WdgIfDevice, the parameter WdgIfDeviceIndex contains the Index parameter that WdgM has to use for WdgIf_SetTriggerCondition calls for that watchdog instance.
