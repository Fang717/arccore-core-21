AUTOSAR XML (schema 4-2-2)
package /AUTOSAR/Services/Det
  client server interface DETService: is-service=true
    operation ReportError: possible-error=DETService/E_OK
      arg ApiId: type=uint8, direction=IN
      arg ErrorId: type=uint8, direction=IN
    error E_OK: error-code=0
package /AUTOSAR/Services/EcuM
  impl type EcuM_UserType: implementation-data-type=uint8
  impl type EcuM_StateType:
    compu {16=ECUM_STATE_STARTUP, 17=ECUM_STATE_STARTUP_ONE, 18=ECUM_STATE_STARTUP_TWO, 32=ECUM_STATE_WAKEUP, 33=ECUM_STATE_WAKEUP_ONE, 34=ECUM_STATE_WAKEUP_VALIDATION, 35=ECUM_STATE_WAKEUP_REACTION, 36=ECUM_STATE_WAKEUP_TWO, 37=ECUM_STATE_WAKEUP_WAKESLEEP, 38=ECUM_STATE_WAKEUP_TTII, 48=ECUM_STATE_RUN, 50=ECUM_STATE_APP_RUN, 51=ECUM_STATE_APP_POST_RUN, 64=ECUM_STATE_SHUTDOWN, 68=ECUM_STATE_PREP_SHUTDOWN, 73=ECUM_STATE_GO_SLEEP, 77=ECUM_STATE_GO_OFF_ONE, 78=ECUM_STATE_GO_OFF_TWO, 80=ECUM_STATE_SLEEP, 128=ECUM_STATE_OFF, 144=ECUM_STATE_RESET}
    range phys 16..144, raw 16..144
    implementation-data-type=uint8
  impl type EcuM_BootTargetType: compu {0=ECUM_BOOT_TARGET_APP, 1=ECUM_BOOT_TARGET_OEM_BOOTLOADER, 2=ECUM_BOOT_TARGET_SYS_BOOTLOADER}, range phys 0..2, raw 0..2, implementation-data-type=uint8
  mode declaration group EcuM_Mode: initial-mode=STARTUP
    6 x mode:
      STARTUP
      RUN
      POST_RUN
      SLEEP
      WAKE_SLEEP
      SHUTDOWN
  data type mapping set EcuMFixedTypeMappings: mode-request-type-map{implementation-data-type=uint8, mode-group=EcuM_Mode}
  client server interface EcuM_StateRequest: is-service=true
    4 x operation, all with possible-error=[EcuM_StateRequest/E_OK, EcuM_StateRequest/E_NOT_OK]:
      RequestRUN
      ReleaseRUN
      RequestPOSTRUN
      ReleasePOSTRUN
    error E_OK: error-code=0
    error E_NOT_OK: error-code=1
  client server interface EcuM_ShutdownTarget: is-service=true
    operation SelectShutdownTarget: possible-error=[EcuM_ShutdownTarget/E_OK, EcuM_ShutdownTarget/E_NOT_OK]
      arg target: type=EcuM_StateType, direction=IN
      arg mode: type=uint8, direction=IN
    operation GetShutdownTarget: possible-error=[EcuM_ShutdownTarget/E_OK, EcuM_ShutdownTarget/E_NOT_OK]
      arg target: type=EcuM_StateType, direction=OUT
      arg mode: type=uint8, direction=OUT
    operation GetLastShutdownTarget: possible-error=[EcuM_ShutdownTarget/E_OK, EcuM_ShutdownTarget/E_NOT_OK]
      arg target: type=EcuM_StateType, direction=OUT
      arg mode: type=uint8, direction=OUT
    error E_OK: error-code=0
    error E_NOT_OK: error-code=1
  client server interface EcuM_BootTarget: is-service=true
    operation SelectBootTarget: possible-error=[EcuM_BootTarget/E_OK, EcuM_BootTarget/E_NOT_OK]
      arg target: type=EcuM_BootTargetType, direction=IN
    operation GetBootTarget: possible-error=[EcuM_BootTarget/E_OK, EcuM_BootTarget/E_NOT_OK]
      arg target: type=EcuM_BootTargetType, direction=OUT
    error E_OK: error-code=0
    error E_NOT_OK: error-code=1
  mode switch interface EcuM_CurrentMode: is-service=true
    mode group currentMode: type=EcuM_Mode
package /AUTOSAR/Services/Dcm
  impl type Dcm_OpStatusType: compu {0=DCM_INITIAL, 1=DCM_PENDING, 2=DCM_CANCEL, 3=DCM_FORCE_RCRRP_OK}, implementation-data-type=uint8
  impl type Dcm_NegativeResponseCodeType:
    compu {0=DCM_E_POSITIVERESPONSE, 16=DCM_E_GENERALREJECT, 17=DCM_E_SERVICENOTSUPPORTED, 18=DCM_E_SUBFUNCTIONNOTSUPPORTED, 19=DCM_E_INCORRECTMESSAGELENGTHORINVALIDFORMAT, 20=DCM_E_RESPONSETOOLONG, 33=DCM_E_BUSYREPEATREQUEST, 34=DCM_E_CONDITIONSNOTCORRECT, 36=DCM_E_REQUESTSEQUENCEERROR, 37=DCM_E_NORESPONSEFROMSUBNETCOMPONENT, 38=DCM_E_FAILUREPREVENTSEXECUTIONOFREQUESTEDACTION, 49=DCM_E_REQUESTOUTOFRANGE, 51=DCM_E_SECURITYACCESSDENIED, 53=DCM_E_INVALIDKEY, 54=DCM_E_EXCEEDNUMBEROFATTEMPTS, 55=DCM_E_REQUIREDTIMEDELAYNOTEXPIRED, 112=DCM_E_UPLOADDOWNLOADNOTACCEPTED, 113=DCM_E_TRANSFERDATASUSPENDED, 114=DCM_E_GENERALPROGRAMMINGFAILURE, 115=DCM_E_WRONGBLOCKSEQUENCECOUNTER, 126=DCM_E_SUBFUNCTIONNOTSUPPORTEDINACTIVESESSION, 127=DCM_E_SERVICENOTSUPPORTEDINACTIVESESSION, 129=DCM_E_RPMTOOHIGH, 130=DCM_E_RPMTOOLOW, 131=DCM_E_ENGINEISRUNNING, 132=DCM_E_ENGINEISNOTRUNNING, 133=DCM_E_ENGINERUNTIMETOOLOW, 134=DCM_E_TEMPERATURETOOHIGH, 135=DCM_E_TEMPERATURETOOLOW, 136=DCM_E_VEHICLESPEEDTOOHIGH, 137=DCM_E_VEHICLESPEEDTOOLOW, 138=DCM_E_THROTTLE_PEDALTOOHIGH, 139=DCM_E_THROTTLE_PEDALTOOLOW, 140=DCM_E_TRANSMISSIONRANGENOTINNEUTRAL, 141=DCM_E_TRANSMISSIONRANGENOTINGEAR, 143=DCM_E_BRAKESWITCH_NOTCLOSED, 144=DCM_E_SHIFTERLEVERNOTINPARK, 145=DCM_E_TORQUECONVERTERCLUTCHLOCKED, 146=DCM_E_VOLTAGETOOHIGH, 147=DCM_E_VOLTAGETOOLOW}
    range phys 0..255, raw 0..255
    implementation-data-type=uint8
  impl type Dcm_ConfirmationStatusType: compu {0=DCM_RES_POS_OK, 1=DCM_RES_POS_NOT_OK, 2=DCM_RES_NEG_OK, 3=DCM_RES_NEG_NOT_OK}, range phys 0..255, raw 0..255, implementation-data-type=uint8
  impl type Dcm_ProtocolType: compu {0=DCM_OBD_ON_CAN, 1=DCM_OBD_ON_FLEXRAY, 2=DCM_OBD_ON_IP, 3=DCM_UDS_ON_CAN, 4=DCM_UDS_ON_FLEXRAY, 5=DCM_UDS_ON_IP, 6=DCM_ROE_ON_CAN, 7=DCM_ROE_ON_FLEXRAY, 8=DCM_ROE_ON_IP, 9=DCM_PERIODICTRANS_ON_CAN, 10=DCM_PERIODICTRANS_ON_FLEXRAY, 11=DCM_PERIODICTRANS_ON_IP, 12=DCM_NO_ACTIVE_PROTOCOL, 240..254=DCM_SUPPLIER_1..DCM_SUPPLIER_15}, range phys 0..255, raw 0..255, implementation-data-type=uint8
  impl type Dcm_RoeStateType: compu {0=DCM_ROE_ACTIVE, 1=DCM_ROE_UNACTIVE}, range phys 0..255, raw 0..255, implementation-data-type=uint8
  impl type Dcm_SecLevelType: compu {0=DCM_SEC_LEV_LOCKED, 1=DCM_SEC_LEV_L1, 255=DCM_SEC_LEV_ALL}, range phys 0..255, raw 0..255, implementation-data-type=uint8
  impl type Dcm_SesCtrlType: compu {1=DCM_DEFAULT_SESSION, 2=DCM_PROGRAMMING_SESSION, 3=DCM_EXTENDED_DIAGNOSTIC_SESSION, 4=DCM_SAFETY_SYSTEM_DIAGNOSTIC_SESSION, 255=DCM_ALL_SESSION}, range phys 0..255, raw 0..255, implementation-data-type=uint8
  4 x mode declaration group:
    DcmEcuReset: initial-mode=NONE
      7 x mode:
        NONE
        HARD
        KEYONOFF
        SOFT
        JUMPTOBOOTLOADER
        JUMPTOSYSSUPPLIERBOOTLOADER
        EXECUTE
    DcmModeRapidPowerShutDown: initial-mode=ENABLE_RAPIDPOWERSHUTDOWN
      mode ENABLE_RAPIDPOWERSHUTDOWN
      mode DISABLE_RAPIDPOWERSHUTDOWN
    DcmCommunicationControl: initial-mode=DCM_ENABLE_RX_TX_NORM
      12 x mode:
        DCM_ENABLE_RX_TX_NORM
        DCM_ENABLE_RX_DISABLE_TX_NORM
        DCM_DISABLE_RX_ENABLE_TX_NORM
        DCM_DISABLE_RX_TX_NORMAL
        DCM_ENABLE_RX_TX_NM
        DCM_ENABLE_RX_DISABLE_TX_NM
        DCM_DISABLE_RX_ENABLE_TX_NM
        DCM_DISABLE_RX_TX_NM
        DCM_ENABLE_RX_TX_NORM_NM
        DCM_ENABLE_RX_DISABLE_TX_NORM_NM
        DCM_DISABLE_RX_ENABLE_TX_NORM_NM
        DCM_DISABLE_RX_TX_NORM_NM
    DcmControlDTCSetting: initial-mode=ENABLEDTCSETTING
      mode ENABLEDTCSETTING
      mode DISABLEDTCSETTING
  client server interface CallbackDCMRequestServices: is-service=true
    operation StartProtocol: possible-error=[CallbackDCMRequestServices/E_OK, CallbackDCMRequestServices/E_NOT_OK, E_PROTOCOL_NOT_ALLOWED]
      arg ProtocolID: type=Dcm_ProtocolType, direction=IN
    operation StopProtocol: possible-error=[CallbackDCMRequestServices/E_OK, CallbackDCMRequestServices/E_NOT_OK]
      arg ProtocolID: type=Dcm_ProtocolType, direction=IN
    error E_OK: error-code=0
    error E_NOT_OK: error-code=1
    error E_PROTOCOL_NOT_ALLOWED: error-code=5
package /AUTOSAR/Services/Dlt
  impl type Dlt_SessionIDType: implementation-data-type=uint32
  impl type Dlt_ReturnType: compu {0=DLT_E_OK, 1=DLT_E_MSG_TOO_LARGE, 2=DLT_E_CONTEXT_ALREADY_REG, 3=DLT_E_UNKNOWN_SESSION_ID, 4=DLT_E_IF_NOT_AVAILABLE, 5=DLT_E_IF_BUSY, 6=DLT_E_ERROR_UNKNOWN, 7=DLT_E_PENDING, 8=DLT_E_NOT_IN_VERBOSE_MOD}, range phys 0..8, raw 0..8, implementation-data-type=uint8
  impl type Dlt_MessageLogLevelType: compu {0=DLT_LOG_OFF, 1=DLT_LOG_FATAL, 2=DLT_LOG_ERROR, 3=DLT_LOG_WARN, 4=DLT_LOG_INFO, 5=DLT_LOG_DEBUG, 6=DLT_LOG_VERBOSE}, range phys 0..6, raw 0..6, implementation-data-type=uint8
  impl type Dlt_MessageTraceType: compu {1=DLT_TRACE_VARIABLE, 2=DLT_TRACE_FUNCTION_IN, 3=DLT_TRACE_FUNCTION_OUT, 4=DLT_TRACE_STATE, 5=DLT_TRACE_VFB}, range phys 1..5, raw 1..5, implementation-data-type=uint8
  7 x impl type:
    Dlt_MessageIDType: implementation-data-type=uint32
    Dlt_MessageOptionsType: implementation-data-type=uint8
    Dlt_MessageArgumentCount: implementation-data-type=uint16
    Dlt_ApplicationIDType: category=ARRAY
      element Dlt_ApplicationIDType_elementsImpl: array-size=4, array-size-semantics=FIXED-SIZE, implementation-data-type=uint8
    Dlt_ContextIDType: category=ARRAY
      element Dlt_ContextIDType_elementsImpl: array-size=4, array-size-semantics=FIXED-SIZE, implementation-data-type=uint8
    Dlt_MessageLogInfoType: category=STRUCTURE
      5 x element, all with category=TYPE_REFERENCE:
        arg_count: implementation-data-type=Dlt_MessageArgumentCount
        log_level: implementation-data-type=Dlt_MessageLogLevelType
        options: implementation-data-type=Dlt_MessageOptionsType
        context_id: implementation-data-type=Dlt_ContextIDType
        app_id: implementation-data-type=Dlt_ApplicationIDType
    Dlt_MessageTraceInfoType: category=STRUCTURE
      4 x element, all with category=TYPE_REFERENCE:
        trace_info: implementation-data-type=Dlt_MessageTraceType
        options: implementation-data-type=Dlt_MessageOptionsType
        context: implementation-data-type=Dlt_ContextIDType
        app_id: implementation-data-type=Dlt_ApplicationIDType
  4 x client server interface, all with is-service=true:
    DLTService
      operation SendLogMessage: possible-error=[DLTService/E_OK, DLTService/E_NOT_OK]
        arg log_info: type=Dlt_MessageLogInfoType, direction=IN
        arg log_data: type=constUint8Ptr, direction=IN
        arg log_data_length: type=uint16, direction=IN
      operation RegisterContext: possible-error=[DLTService/E_OK, DLTService/E_NOT_OK]
        6 x arg, all with direction=IN:
          app_id: type=Dlt_ApplicationIDType
          context_id: type=Dlt_ContextIDType
          app_description: type=constUint8Ptr
          len_app_description: type=uint8
          context_description: type=constUint8Ptr
          len_context_description: type=uint8
      operation SendTraceMessage: possible-error=[DLTService/E_OK, DLTService/E_NOT_OK]
        arg trace_info: type=Dlt_MessageTraceInfoType, direction=IN
        arg trace_data: type=constUint8Ptr, direction=IN
        arg trace_data_length: type=uint16, direction=IN
      error E_OK: error-code=0
      error E_NOT_OK: error-code=1
    InjectionCallback
      operation InjectCall: possible-error=[InjectionCallback/E_OK, InjectionCallback/E_NOT_OK]
        5 x arg, all with direction=IN:
          app_id: type=Dlt_ApplicationIDType
          context_id: type=Dlt_ContextIDType
          service_id: type=uint32
          inj_data_length: type=uint32
          inj_data: type=constUint8Ptr
      error E_OK: error-code=0
      error E_NOT_OK: error-code=1
    LogTraceSessionControl
      operation SetLogLevel: possible-error=[LogTraceSessionControl/E_OK, LogTraceSessionControl/E_NOT_OK]
        arg app_id: type=Dlt_ApplicationIDType, direction=IN
        arg context_id: type=Dlt_ContextIDType, direction=IN
        arg loglevel: type=Dlt_MessageLogLevelType, direction=IN
      operation SetTraceStatus: possible-error=[LogTraceSessionControl/E_OK, LogTraceSessionControl/E_NOT_OK]
        arg app_id: type=Dlt_ApplicationIDType, direction=IN
        arg context_id: type=Dlt_ContextIDType, direction=IN
        arg new_trace_status: type=boolean, direction=IN
      error E_OK: error-code=0
      error E_NOT_OK: error-code=1
    VerboseModeControl
      operation SetVerboseMode: possible-error=[VerboseModeControl/E_OK, VerboseModeControl/E_NOT_OK]
        arg app_id: type=Dlt_ApplicationIDType, direction=IN
        arg context_id: type=Dlt_ContextIDType, direction=IN
        arg is_verbose_mode: type=boolean, direction=IN
      error E_OK: error-code=0
      error E_NOT_OK: error-code=1
package /AUTOSAR/Services/NvM
  impl type NvM_RequestResultType: compu {0=NVM_REQ_OK, 1=NVM_REQ_NOT_OK, 2=NVM_REQ_PENDING, 3=NVM_REQ_INTEGRITY_FAILED, 4=NVM_REQ_BLOCK_SKIPPED, 5=NVM_REQ_NV_INVALIDATED, 6=NVM_REQ_CANCELED, 7=NVM_REQ_REDUNDANCY_FAILED, 8=NVM_REQ_RESTORED_FROM_ROM}, implementation-data-type=uint8
  impl type NvM_BlockIdType: implementation-data-type=uint16
package /AUTOSAR/Services/Dem
  impl type Dem_EventStatusType: compu {0=DEM_EVENT_STATUS_PASSED, 1=DEM_EVENT_STATUS_FAILED, 2=DEM_EVENT_STATUS_PREPASSED, 3=DEM_EVENT_STATUS_PREFAILED}, range phys 0..3, raw 0..3, implementation-data-type=uint8
  impl type Dem_EventStatusExtendedType: compu {1=DEM_TEST_FAILED, 2=DEM_TEST_FAILED_THIS_OPERATION_CYCLE, 4=DEM_PENDING_DTC, 8=DEM_CONFIRMED_DTC, 16=DEM_TEST_NOT_COMPLETED_SINCE_LAST_CLEAR, 32=DEM_TEST_FAILED_SINCE_LAST_CLEAR, 64=DEM_TEST_NOT_COMPLETED_THIS_OPERATION_CYCLE, 128=DEM_WARNING_INDICATOR_REQUESTED}, range phys 0..255, raw 0..255, implementation-data-type=uint8
  impl type Dem_DTCFormatType: compu {0=DEM_DTC_FORMAT_OBD, 1=DEM_DTC_FORMAT_UDS}, range phys 0..1, raw 0..1, implementation-data-type=uint8
  impl type Dem_OperationCycleStateType: compu {0=DEM_CYCLE_STATE_START, 1=DEM_CYCLE_STATE_END}, range phys 0..1, raw 0..1, implementation-data-type=uint8
  impl type Dem_DTCOriginType: compu {1=DEM_DTC_ORIGIN_PRIMARY_MEMORY, 2=DEM_DTC_ORIGIN_MIRROR_MEMORY, 3=DEM_DTC_ORIGIN_PERMANENT_MEMORY, 4=DEM_DTC_ORIGIN_SECONDARY_MEMORY}, implementation-data-type=uint8
  impl type Dem_ReturnClearDTCType: compu {0=DEM_CLEAR_OK, 1=DEM_CLEAR_WRONG_DTC, 2=DEM_CLEAR_WRONG_DTCORIGIN, 3=DEM_CLEAR_FAILED, 4=DEM_CLEAR_PENDING}, implementation-data-type=uint8
  impl type Dem_IndicatorStatusType: compu {0=DEM_INDICATOR_OFF, 1=DEM_INDICATOR_CONTINUOUS, 2=DEM_INDICATOR_BLINKING, 3=DEM_INDICATOR_BLINK_CONT}, range phys 0..3, raw 0..3, implementation-data-type=uint8
  impl type Dem_InitMonitorReasonType: compu {1=DEM_INIT_MONITOR_CLEAR, 2=DEM_INIT_MONITOR_RESTART}, range phys 1..2, raw 1..2, implementation-data-type=uint8
  impl type Dem_EventIdType: implementation-data-type=uint16
  impl type Dem_OperationCycleIdType: implementation-data-type=uint8
  impl type Dem_DTCStatusMaskType: implementation-data-type=uint8
  10 x client server interface, all with is-service=true:
    DiagnosticMonitor
      5 x operation, all with possible-error=[DiagnosticMonitor/E_OK, DiagnosticMonitor/E_NOT_OK]:
        SetEventStatus
          arg EventStatus: type=Dem_EventStatusType, direction=IN
        ResetEventStatus
        PrestoreFreezeFrame
        ClearPrestoredFreezeFrame
        SetEventDisabled
      error E_OK: error-code=0
      error E_NOT_OK: error-code=1
    EnableCondition
      operation SetEnableCondition: possible-error=[EnableCondition/E_OK, EnableCondition/E_NOT_OK]
        arg ConditionFulfilled: type=boolean, direction=IN
      error E_OK: error-code=0
      error E_NOT_OK: error-code=1
    DcmIf
      operation ClearDTC: possible-error=[DEM_CLEAR_OK, DEM_CLEAR_WRONG_DTC, DEM_CLEAR_WRONG_DTCORIGIN, DEM_CLEAR_WRONG_DTCKIND, DEM_CLEAR_FAILED, DEM_CLEAR_PENDING]
        arg DTC: type=uint32, direction=IN
        arg DTCFormat: type=Dem_DTCFormatType, direction=IN
        arg DTCOrigin: type=Dem_DTCOriginType, direction=IN
      6 x error:
        DEM_CLEAR_OK: error-code=0
        DEM_CLEAR_WRONG_DTC: error-code=1
        DEM_CLEAR_WRONG_DTCORIGIN: error-code=2
        DEM_CLEAR_WRONG_DTCKIND: error-code=3
        DEM_CLEAR_FAILED: error-code=4
        DEM_CLEAR_PENDING: error-code=5
    CallbackClearEventAllowed
      operation ClearEventAllowed: possible-error=CallbackClearEventAllowed/E_NOT_OK
        arg Allowed: type=boolean, direction=OUT
      error E_NOT_OK: error-code=1
    CallbackEventDataChanged
      operation EventDataChanged: possible-error=CallbackEventDataChanged/E_NOT_OK
      error E_NOT_OK: error-code=1
    GeneralCallbackEventDataChanged
      operation EventDataChanged: possible-error=GeneralCallbackEventDataChanged/E_NOT_OK
        arg EventId: type=Dem_EventIdType, direction=IN
      error E_NOT_OK: error-code=1
    GeneralCallbackEventStatusChange
      operation EventStatusChanged: possible-error=GeneralCallbackEventStatusChange/E_NOT_OK
        arg EventId: type=Dem_EventIdType, direction=IN
        arg EventStatusOld: type=Dem_EventStatusExtendedType, direction=IN
        arg EventStatusNew: type=Dem_EventStatusExtendedType, direction=IN
      error E_NOT_OK: error-code=1
    CallbackEventStatusChange
      operation EventStatusChanged: possible-error=CallbackEventStatusChange/E_NOT_OK
        arg EventStatusOld: type=Dem_EventStatusExtendedType, direction=IN
        arg EventStatusNew: type=Dem_EventStatusExtendedType, direction=IN
      error E_NOT_OK: error-code=1
    IndicatorStatus
      operation GetIndicatorStatus: possible-error=IndicatorStatus/E_NOT_OK
        arg IndicatorStatus: type=Dem_IndicatorStatusType, direction=OUT
      error E_NOT_OK: error-code=1
    CallbackInitMonitorForEvent
      operation InitMonitorForEvent: possible-error=CallbackInitMonitorForEvent/E_NOT_OK
        arg InitMonitorReason: type=Dem_InitMonitorReasonType, direction=IN
      error E_NOT_OK: error-code=1
package /AUTOSAR/Services/ComM
  impl type ComM_UserHandleType: compu {255=COMM_NOT_USED_USER_ID}, range phys 0..255, raw 0..255, implementation-data-type=uint8
  impl type ComM_InhibitionStatusType: implementation-data-type=uint8
  impl type ComM_ModeType: compu {0=COMM_NO_COMMUNICATION, 1=COMM_SILENT_COMMUNICATION, 2=COMM_FULL_COMMUNICATION}, range phys 0..2, raw 0..2, implementation-data-type=uint8
  mode declaration group ComMMode: initial-mode=COMM_NO_COMMUNICATION
    mode COMM_NO_COMMUNICATION
    mode COMM_SILENT_COMMUNICATION
    mode COMM_FULL_COMMUNICATION
  data type mapping set ComMTypeMappings: mode-request-type-map{implementation-data-type=uint8, mode-group=ComMMode}
  client server interface ComM_UserRequest: is-service=true
    4 x operation:
      RequestComMode: possible-error=[ComM_UserRequest/E_OK, ComM_UserRequest/E_NOT_OK, E_MODE_LIMITATION]
        arg ComMode: type=ComM_ModeType, direction=IN
      GetCurrentComMode: possible-error=[ComM_UserRequest/E_OK, ComM_UserRequest/E_NOT_OK]
        arg ComMode: type=ComM_ModeType, direction=OUT
      GetMaxComMode: possible-error=[ComM_UserRequest/E_OK, ComM_UserRequest/E_NOT_OK]
        arg ComMode: type=ComM_ModeType, direction=OUT
      GetRequestedComMode: possible-error=[ComM_UserRequest/E_OK, ComM_UserRequest/E_NOT_OK]
        arg ComMode: type=ComM_ModeType, direction=OUT
    error E_OK: error-code=0
    error E_NOT_OK: error-code=1
    error E_MODE_LIMITATION: error-code=2
  mode switch interface ComM_CurrentMode: is-service=true
    mode group currentMode: type=ComMMode
  client server interface ComM_ECUModeLimitation: is-service=true
    4 x operation, all with possible-error=ComM_ECUModeLimitation/E_NOT_OK:
      LimitECUToNoComMode
        arg Status: type=boolean, direction=IN
      ReadInhibitCounter
        arg CounterValue: type=uint16, direction=OUT
      ResetInhibitCounter
      SetECUGroupClassification
        arg Status: type=ComM_InhibitionStatusType, direction=IN
    error E_NOT_OK: error-code=1
  client server interface ComM_ChannelWakeup: is-service=true
    operation PreventWakeUp: possible-error=ComM_ChannelWakeup/E_NOT_OK
      arg Status: type=boolean, direction=IN
    operation GetInhibitionStatus: possible-error=ComM_ChannelWakeup/E_NOT_OK
      arg Status: type=ComM_InhibitionStatusType, direction=OUT
    error E_NOT_OK: error-code=1
  client server interface ComM_ChannelLimitation
    operation LimitChannelToNoComMode: possible-error=ComM_ChannelLimitation/E_NOT_OK
      arg Status: type=boolean, direction=IN
    operation GetInhibitionStatus: possible-error=ComM_ChannelLimitation/E_NOT_OK
      arg Status: type=ComM_InhibitionStatusType, direction=OUT
    error E_NOT_OK: error-code=1
package /AUTOSAR/Services/StbM
  impl type StbM_TimeBaseStatusType: compu {mask 1: 0=NO (TIMEOUT_NO), mask 1: 1=YES (TIMEOUT_YES), mask 2: 0=No (TIMELEAP_NO), mask 2: 2=YES (TIMELEAP_YES), mask 4: 0=MASTER (SYNC_TO_GATEWAY_MASTER), mask 4: 4=GATEWAY (SYNC_TO_GATEWAY_GATEWAY), mask 8: 0=NEVER (GLOBAL_TIME_BASE_NEVER), mask 8: 8=AT_LEAST_ONCE (GLOBAL_TIME_BASE_AT_LEAST_ONCE)}, implementation-data-type=uint8
  4 x impl type:
    StbM_TimeStampType: category=STRUCTURE
      4 x element, all with category=TYPE_REFERENCE:
        timeBaseStatus: implementation-data-type=StbM_TimeBaseStatusType
        nanoseconds: implementation-data-type=uint32
        seconds: implementation-data-type=uint32
        secondsHi: implementation-data-type=uint16
    StbM_UserDataType: category=STRUCTURE
      4 x element, all with category=TYPE_REFERENCE, implementation-data-type=uint8:
        userDataLength
        userByte{0..2}
    StbM_TimeStampExtendedType: category=STRUCTURE
      element timeBaseStatus: implementation-data-type=StbM_TimeBaseStatusType
      element nanoseconds: implementation-data-type=uint32
      element seconds: implementation-data-type=uint64
    StbM_SynchronizedTimeBaseType: implementation-data-type=uint16
package /AUTOSAR/Services/Os
  impl type TickType: implementation-data-type=uint32
  impl type TickRefType: implementation-data-type=uint32Ptr
  impl type CounterType: implementation-data-type=uint32
  client server interface OsService: is-service=true
    operation GetCounterValue: possible-error=[OsService/E_OK, E_OS_ID]
      arg value: type=TickType, direction=OUT
    operation GetElapsedValue: possible-error=[OsService/E_OK, E_OS_ID, E_OS_VALUE]
      arg value: type=TickType, direction=INOUT
      arg elapsedValue: type=TickType, direction=OUT
    5 x error:
      E_OK: error-code=0
      E_OS_ACCESS: error-code=1
      E_OS_ID: error-code=3
      E_OS_STATE: error-code=7
      E_OS_VALUE: error-code=8
package /AUTOSAR/Services/WdgM
  impl type WdgM_CheckpointIdType: implementation-data-type=uint16
  impl type WdgM_SupervisedEntityIdType: implementation-data-type=uint16
  impl type WdgM_LocalStatusType: compu {0=WDGM_LOCAL_STATUS_OK, 1=WDGM_LOCAL_STATUS_FAILED, 2=WDGM_LOCAL_STATUS_EXPIRED, 4=WDGM_LOCAL_STATUS_DEACTIVATED}, range phys 0..4, raw 0..4, implementation-data-type=uint8
  impl type WdgM_GlobalStatusType: compu {0=WDGM_GLOBAL_STATUS_OK, 1=WDGM_GLOBAL_STATUS_FAILED, 2=WDGM_GLOBAL_STATUS_EXPIRED, 3=WDGM_GLOBAL_STATUS_STOPPED, 4=WDGM_GLOBAL_STATUS_DEACTIVATED}, range phys 0..4, raw 0..4, implementation-data-type=uint8
  impl type WdgM_ModeType: compu {0=SUPERVISION_DEACTIVATED, 2=SUPERVISION_EXPIRED, 1=SUPERVISION_FAILED, 4=SUPERVISION_OK, 3=SUPERVISION_STOPPED}, range phys 0..4, raw 0..4, implementation-data-type=uint8
  mode declaration group WdgMMode: category=EXPLICIT_ORDER, initial-mode=SUPERVISION_STOPPED, on-transition-value=255
    5 x mode:
      SUPERVISION_OK: value=4
      SUPERVISION_FAILED: value=1
      SUPERVISION_EXPIRED: value=2
      SUPERVISION_STOPPED: value=3
      SUPERVISION_DEACTIVATED: value=0
  data type mapping set WdgMTypeMappings: mode-request-type-map{implementation-data-type=uint8, mode-group=WdgMMode}
  mode switch interface WdgM_LocalMode: is-service=true
    mode group currentMode: type=WdgMMode
  mode switch interface WdgM_GlobalMode: is-service=true
    mode group currentMode: type=WdgMMode
  client server interface WdgM_LocalSupervision: is-service=true
    operation CheckpointReached: possible-error=[WdgM_LocalSupervision/E_OK, WdgM_LocalSupervision/E_NOT_OK]
      arg CheckpointID: type=WdgM_CheckpointIdType, direction=IN
    error E_OK: error-code=0
    error E_NOT_OK: error-code=1
  client server interface WdgM_LocalSuperVisionStatus: is-service=true
    operation GetLocalStatus: possible-error=[WdgM_LocalSuperVisionStatus/E_OK, WdgM_LocalSuperVisionStatus/E_NOT_OK]
      arg Status: type=WdgM_LocalStatusType, direction=OUT
    error E_OK: error-code=0
    error E_NOT_OK: error-code=1
  client server interface WdgM_GlobalSuperVision: is-service=true
    5 x operation:
      GetFirstExpiredSEID: possible-error=[WdgM_GlobalSuperVision/E_OK, WdgM_GlobalSuperVision/E_NOT_OK]
        arg SEID: type=WdgM_SupervisedEntityIdType, direction=OUT
      GetGlobalStatus: possible-error=[WdgM_GlobalSuperVision/E_OK, WdgM_GlobalSuperVision/E_NOT_OK]
        arg Status: type=WdgM_GlobalStatusType, direction=OUT
      GetMode: possible-error=[WdgM_GlobalSuperVision/E_OK, WdgM_GlobalSuperVision/E_NOT_OK]
        arg Mode: type=WdgM_ModeType, direction=OUT
      PerformReset
      SetMode: possible-error=[WdgM_GlobalSuperVision/E_OK, WdgM_GlobalSuperVision/E_NOT_OK]
        arg Mode: type=WdgM_ModeType, direction=IN
    error E_OK: error-code=0
    error E_NOT_OK: error-code=1
package /AUTOSAR/Services/HTMSS
  impl type HTMSS_TestGroupType: compu {0=HTMSS_STARTUP, 1=HTMSS_SHUTDOWN, 2=HTMSS_STARTUP_SHUTDOWN}, range phys 0..3, raw 0..3, implementation-data-type=uint8
  client server interface HTMSS_GetTestStatus: is-service=true
    operation GetTestStatus: possible-error=[HTMSS_STATUS_OK, HTMSS_STATUS_NOK, HTMSS_STATUS_INVALID, HTMSS_STATUS_UNINIT]
      arg GrpId: type=HTMSS_TestGroupType, direction=IN
      arg TestResultPtr: type=HTMSS_TestResultType, direction=OUT
    4 x error:
      HTMSS_STATUS_OK: error-code=0
      HTMSS_STATUS_NOK: error-code=1
      HTMSS_STATUS_INVALID: error-code=2
      HTMSS_STATUS_UNINIT: error-code=3
  impl type HTMSS_TestResultType: category=STRUCTURE
    element TestResult: implementation-data-type=uint8
    element TestSignature: implementation-data-type=uint8
