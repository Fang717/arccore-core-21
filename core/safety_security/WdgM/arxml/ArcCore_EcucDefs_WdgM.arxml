AUTOSAR XML (schema 4-2-2)
package /ArcCore/EcucDefs/Generic
  module definition WdgM [0..1]: post-build-variant-support=true, variants post-build/pre-compile  # Configuration of the WdgM (Watchdog Manager) module.
    container WdgMConfigSet  # This container describes one of multiple configuration sets of WdgM.
      symbolic name reference WdgMInitialMode: post-build-variant-value=true, set at post-build in variant post-build / pre-compile in variant pre-compile, destination=WdgMMode  # The mode that the Watchdog Manager is in after it has been initialized.
      container WdgMDemEventParameterRefs [0..1]  # Container for the references to DemEventParameter elements which shall be invoked using the API Dem_SetEventStatus in case the corresponding error occurs. The EventId is taken from the referenced DemEventParameter's DemEventId symbolic value. The standardized errors are provided in this container and can be extended by vendor-specific error references.
        symbolic name reference WDGM_E_SET_MODE [0..1]: multiplicity set at post-build in variant post-build / pre-compile in variant pre-compile, post-build-variant-multiplicity=true, post-build-variant-value=true, set at post-build in variant post-build / pre-compile in variant pre-compile, destination=DemEventParameter  # Reference to the DemEventParameter which shall be issued when the error "Watchdog drivers' mode switch has failed" has occurred.
        symbolic name reference WDGM_E_SUPERVISION [0..1]: multiplicity set at post-build in variant post-build / pre-compile in variant pre-compile, post-build-variant-multiplicity=true, post-build-variant-value=true, set at post-build in variant post-build / pre-compile in variant pre-compile, destination=DemEventParameter  # Reference to the DemEventParameter which shall be issued when the error "Supervision has failed (Global Supervision Status has reached WDGM_GLOBAL_STATUS_STOPPED) and a watchdog reset will occur" has occurred.
      container WdgMMode [1..255]  # The container describes one of several modes of the Watchdog Manager.
        integer WdgMExpiredSupervisionCycleTol: 0..65535, scope=ECU, post-build-variant-value=true, set at post-build in variant post-build / pre-compile in variant pre-compile  # This parameter shall be used to define a value that fixes the amount of expired supervision cycles for how long the blocking of watchdog triggering shall be postponed, AFTER THE GLOBAL SUPERVISION STATUS HAS REACHED THE STATE EXPIRED.
        integer WdgMModeId: 0..255, set at pre-compile, symbolic-name-value=true  # This parameter fixes the identifier for the mode. This identifier is for instance passed as a parameter to the WdgM_SetMode service.
        float WdgMSupervisionCycle: 0..Inf, scope=ECU, set at pre-compile  # This parameter defines the schedule period of the main function WdgM_MainFunction. | Unit: [s]
        container WdgMAliveSupervision [0..65535]  # This container collects all configuration parameters of Alive-Supervision of one Checkpoint. Note that each Checkpoint may have different parameters. For example, it may have different min and max margin.
          integer WdgMExpectedAliveIndications: 0..65535, post-build-variant-value=true, set at post-build in variant post-build / pre-compile in variant pre-compile  # This parameter contains the amount of expected alive indications of the Checkpoint within the referenced amount of defined supervision cycles according to corresponding SE.
          integer WdgMMaxMargin: 0..255, post-build-variant-value=true, set at post-build in variant post-build / pre-compile in variant pre-compile  # This parameter contains the amount of alive indications of the Checkpoint that are acceptable to be additional to the expected alive indications within the corresponding supervision reference cycle.
          integer WdgMMinMargin: 0..255, post-build-variant-value=true, set at post-build in variant post-build / pre-compile in variant pre-compile  # This parameter contains the amount of alive indications of the Checkpoint that are acceptable to be missed from the expected alive indications within the corresponding supervision reference cycle.
          integer WdgMSupervisionReferenceCycle: 1..65535, post-build-variant-value=true, set at post-build in variant post-build / pre-compile in variant pre-compile  # This parameter shall contain the amount of supervision cycles to be used as reference by the alive-supervision mechanism to perform the checkup with counted alive indications according to corresponding SE.
          symbolic name reference WdgMAliveSupervisionCheckpointRef: post-build-variant-value=true, set at post-build in variant post-build / pre-compile in variant pre-compile, destination=WdgMCheckpoint  # Reference to Checkpoint within a Supervised Entity that shall be supervised.
        container WdgMDeadlineSupervision [0..65535]  # This container collects all configuration parameters for Deadline Supervision for a Supervised Entity.
          float WdgMDeadlineMax: 0..Inf, post-build-variant-value=true, set at post-build in variant post-build / pre-compile in variant pre-compile  # This parameter contains the longest time span after which the deadline is considered to be met. | Unit: [s]
          float WdgMDeadlineMin: 0..Inf, post-build-variant-value=true, set at post-build in variant post-build / pre-compile in variant pre-compile  # This parameter contains the shortest time span after which the deadline is considered to be met. | Unit: [s]
          symbolic name reference WdgMDeadlineStartRef: post-build-variant-value=true, set at post-build in variant post-build / pre-compile in variant pre-compile, destination=WdgMCheckpoint  # This is the reference to the start Checkpoint for Deadline Supervision.
          symbolic name reference WdgMDeadlineStopRef: post-build-variant-value=true, set at post-build in variant post-build / pre-compile in variant pre-compile, destination=WdgMCheckpoint  # This is the reference to the stop Checkpoint for Deadline Supervision.
        container WdgMExternalLogicalSupervision [0..65535]  # This container collects all configuration parameters for Logical Supervision for one external graph.
          symbolic name reference WdgMExternalCheckpointFinalRef [1..65535]: multiplicity set at post-build in variant post-build / pre-compile in variant pre-compile, post-build-variant-multiplicity=true, post-build-variant-value=true, set at post-build in variant post-build / pre-compile in variant pre-compile, destination=WdgMCheckpoint  # This is the reference to the final Checkpoint(s) for this External Graph.
          symbolic name reference WdgMExternalCheckpointInitialRef [1..65535]: multiplicity set at post-build in variant post-build / pre-compile in variant pre-compile, post-build-variant-multiplicity=true, post-build-variant-value=true, set at post-build in variant post-build / pre-compile in variant pre-compile, destination=WdgMCheckpoint  # This is the reference to the initial Checkpoint(s) for this External Graph.
          container WdgMExternalTransition [0..65535]  # This container collects the Checkpoints for an External Transition across Supervised Entities.
            symbolic name reference WdgMExternalTransitionDestRef: post-build-variant-value=true, set at post-build in variant post-build / pre-compile in variant pre-compile, destination=WdgMCheckpoint  # This is the reference to the destination Checkpoint of an External Transition.
            symbolic name reference WdgMExternalTransitionSourceRef: post-build-variant-value=true, set at post-build in variant post-build / pre-compile in variant pre-compile, destination=WdgMCheckpoint  # This is the reference to the source Checkpoint of an External Transition.
        container WdgMLocalStatusParams [0..65535]  # This container collects all configuration parameters for the Local Status of a Supervised Entity.
          integer WdgMFailedAliveSupervisionRefCycleTol: 0..255, post-build-variant-value=true, set at post-build in variant post-build / pre-compile in variant pre-compile  # This parameter shall contain the acceptable amount of reference cycles with incorrect/failed alive supervisions for this Supervised Entity.
          symbolic name reference WdgMLocalStatusSupervisedEntityRef: post-build-variant-value=true, set at post-build in variant post-build / pre-compile in variant pre-compile, destination=WdgMSupervisedEntity  # This is the reference to the Supervised Entity for which the Local Status parameters are specified.
        container WdgMTrigger [0..255]  # This container collects all configuration parameters for the triggering of hardware watchdogs.
          integer WdgMTriggerConditionValue: 1..65535, post-build-variant-value=true, set at post-build in variant post-build / pre-compile in variant pre-compile  # This parameter shall contain the value that is passed to WdgIf_SetTriggerCondition for this watchdog.
          enumeration WdgMWatchdogMode: {WDGIF_FAST_MODE, WDGIF_OFF_MODE, WDGIF_SLOW_MODE}, post-build-variant-value=true, set at post-build in variant post-build / pre-compile in variant pre-compile  # This parameter contains the watchdog mode that shall be used for the referenced watchdog in this Watchdog Manager mode. | Implementation Type: WdgIf_ModeType
          reference WdgMTriggerWatchdogRef: post-build-variant-value=true, set at post-build in variant post-build / pre-compile in variant pre-compile, destination=WdgMWatchdog  # This parameter is a reference to the configured watchdog.
    container WdgMGeneral  # Container defines all general configuration parameters of the Watchdog Manager.
      boolean WdgMDemStoppedSupervisionReport: set at pre-compile  # Parameter to enable/disable the error reporting to DEM. | true: A notification to DEM is sent if the Watchdog Manager reaches the state WDGM_GLOBAL_STATUS_STOPPED. false: The notification is disabled.
      boolean WdgMDevErrorDetect: set at pre-compile, default-value=false  # Switches the development error detection and notification on or off. | * true: detection and notification is enabled. * false: detection and notification is disabled.
      boolean WdgMImmediateReset: set at pre-compile  # This parameter enables/disablse the immediate reset feature in case of alive-supervision failure. | true: Immediate reset is enabled false: Immediate reset is disabled
      boolean WdgMOffModeEnabled: set at pre-compile  # This parameter enables/disables the selection of the "OffMode" of the watchdog driver. | true: "OffMode" selection is allowed false: "OffMode" selection is disallowed
      boolean WdgMVersionInfoApi: set at pre-compile, default-value=false  # Preprocessor switch to enable/disable the existence of the API WdgM_GetVersionInfo. Shall be used to remove unneeded code segments. | true: API is enabled false: API is disabled
      container WdgMSupervisedEntity [0..65535]  # This container collects all common (mode-independent) parameters of a Supervised Entity to be supervised by the Watchdog Manager.
        integer WdgMSupervisedEntityId: 0..65535, set at pre-compile, symbolic-name-value=true  # This parameter shall contain the unique identifier of the supervised entity.
        reference WdgMEcucPartitionRef [0..1]: multiplicity set at pre-compile, set at pre-compile, destination=EcucPartition  # Denotes in which "EcucPartition" the supervised entity is executed. When the partition is stopped, the supervised entity shall be de-activated in the WdgM to avoid an ECU reset.
        symbolic name reference WdgMInternalCheckpointInitialRef: set at pre-compile, destination=WdgMCheckpoint  # This is the reference to the initial Checkpoint for this Supervised Entity.
        symbolic name reference WdgMInternallCheckpointFinalRef [1..65535]: multiplicity set at pre-compile, set at pre-compile, destination=WdgMCheckpoint  # This is the reference to the final Checkpoint(s) for this Supervised Entity.
        reference WdgMOsApplicationRef [0..1]: multiplicity set at pre-compile, set at pre-compile, destination=OsApplication  # Optional reference to an OS Application. Beware, the Watchdog Manager module will trigger a partition restart of this OS Application when the corresponding Supervised Entity reaches WDGM_LOCAL_STATUS_FAILED.
        reference WdgMOSCounter [0..1]: multiplicity set at pre-compile, set at pre-compile, destination=OsCounter  # OS counter used by Watchdog Manager to perform the deadline supervision of the Supervised Entity.
        container WdgMCheckpoint [1..65535]  # This container collects all Checkpoints of this Supervised Entity. Each Supervised Entity has at least one Checkpoint.
          integer WdgMCheckpointId: 0..65535, set at pre-compile, symbolic-name-value=true  # This parameter shall contain the unique identifier of Checkpoint.
        container WdgMInternalTransition [0..65535]  # This container defines the graph of Internal Transitions within this Supervised Entity.
          symbolic name reference WdgMInternalTransitionDestRef: set at pre-compile, destination=WdgMCheckpoint  # This is the reference to the destination Checkpoint of a Internal Transition within this Supervised Entity.
          symbolic name reference WdgMInternalTransitionSourceRef: set at pre-compile, destination=WdgMCheckpoint  # This is the reference to the source Checkpoint of a Internal Transition within this Supervised Entity.
      container WdgMWatchdog [0..255]  # This container collects all common (mode-independent) parameters of a Watchdog to be triggered by the Watchdog Manager.
        string WdgMWatchdogName: set at pre-compile  # This parameter shall contain the name of the watchdog instance.
        symbolic name reference WdgMWatchdogDeviceRef: set at pre-compile, destination=WdgIfDevice  # Reference to one device container of Watchdog Interface. In the referenced container WdgIfDevice, the parameter WdgIfDeviceIndex contains the Index parameter that WdgM has to use for WdgIf_SetTriggerCondition calls for that watchdog instance.
package /ArcCore/EcucDefs/Generic/Implementations
  bsw implementation WdgM: programming-language=C, sw-version=3.0.0, used-code-generator=safety_security::WdgM::gen::WdgM::main, vendor-id=60, ar-release-version=4.3.0, vendor-specific-module-def=WdgM
