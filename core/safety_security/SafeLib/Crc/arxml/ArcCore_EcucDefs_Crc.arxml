AUTOSAR XML (schema 4-2-2)
package /ArcCore/EcucDefs/Generic
  module definition Crc [0..1]: variants pre-compile  # Configuration of the Crc (Crc routines) module.
    container CrcGeneral  # General configuration of CRC module
      enumeration Crc16Mode [0..1]: {CRC_16_HARDWARE, CRC_16_RUNTIME, CRC_16_TABLE}, multiplicity set at pre-compile, set at pre-compile  # Switch to select one of the available CRC 16-bit (CCITT) calculation methods
      enumeration Crc32Mode [0..1]: {CRC_32_HARDWARE, CRC_32_RUNTIME, CRC_32_TABLE}, multiplicity set at pre-compile, set at pre-compile  # Switch to select one of the available CRC 32-bit (IEEE-802.3 CRC32 Ethernet Standard) calculation methods
      enumeration Crc32P4Mode [0..1]: {CRC_32P4_HARDWARE, CRC_32P4_RUNTIME, CRC_32P4_TABLE}, multiplicity set at pre-compile, set at pre-compile  # Switch to select one of the available CRC 32-bit E2E Profile 4 calculation methods.
      enumeration Crc8H2FMode [0..1]: {CRC_8H2F_HARDWARE, CRC_8H2F_RUNTIME, CRC_8H2F_TABLE}, multiplicity set at pre-compile, set at pre-compile  # Switch to select one of the available CRC 8-bit (2Fh polynomial) calculation methods
      enumeration Crc8Mode [0..1]: {CRC_8_HARDWARE, CRC_8_RUNTIME, CRC_8_TABLE}, multiplicity set at pre-compile, set at pre-compile  # Switch to select one of the available CRC 8-bit (SAE J1850) calculation methods
package /ArcCore/EcucDefs/Generic/Implementations
  bsw implementation Crc: programming-language=C, sw-version=2.0.0, used-code-generator=safety_security::SafeLib::Crc::gen::Crc::main, vendor-id=60, ar-release-version=4.3.0, vendor-specific-module-def=Crc
