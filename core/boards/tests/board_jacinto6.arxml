AUTOSAR XML (schema 4-2-1)
package /Tests/Boards/jacinto6
  ecuc value collection jacinto6: ecuc-values=[EcuM, Mcu]
  module config EcuM: implementation-config-variant=VARIANT-PRE-COMPILE, module-description=EcuM
    EcuMConfiguration
      EcuMCommonConfiguration: EcuMConfigConsistencyHash=(unset), EcuMDefaultAppMode=(unset), EcuMOSResource=(unset)
        EcuMDefaultShutdownTarget: EcuMDefaultState=EcuMStateReset
        EcuMSleepMode: EcuMSleepModeId=(unset), EcuMSleepModeSuspend=(unset), EcuMSleepModeMcuModeRef=SLEEP, EcuMWakeupSourceMask=EcuMWakeupSource
        EcuMWakeupSource: EcuMWakeupSourceId=(unset), EcuMWakeupSourcePolling=0, EcuMResetReasonRef=(unset)
      EcuMFixedConfiguration: EcuMNvramReadallTimeout=10.0, EcuMNvramWriteallTimeout=10.0, EcuMRunMinimumDuration=10.0, EcuMNormalMcuModeRef=NORMAL
        User_1 (EcuMFixedUserConfig): EcuMFixedUser=(unset)
    EcuMGeneral: EcuMDevErrorDetect=1, EcuMIncludeDem=0, EcuMIncludeDet=0, EcuMMainFunctionPeriod=0.2, EcuMVersionInfoApi=0
    EcuMFixedGeneral: EcuMIncludeComM=(unset), EcuMIncludeNvM=(unset), EcuMIncludeNvramMgr=(unset), EcuMTTIIEnabled=(unset), EcuMTTIIWakeupSourceRef=(unset)
  module config Mcu: implementation-config-variant=VARIANT-PRE-COMPILE, module-description=Mcu
    McuGeneralConfiguration: McuDevErrorDetect=1, McuGetRamStateApi=(unset), McuInitClock=true, McuNoPll=true, McuPerformResetApi=0, McuVersionInfoApi=1
    McuModuleConfiguration: McuClockSrcFailureNotification=, McuNumberOfMcuModes=(unset), McuRamSectors=(unset), ArcDefaultClockRef=McuClockSettingConfig
      McuClockSettingConfig: McuClockSettingId=(unset)
        McuClockReferencePoint: McuClockReferencePointFrequency=212800000
        ArcClockSettings:
          Enable_Timer_1 = true
          Enable_Timer_2 = false
          Enable_Timer_3 = true
          Enable_Timer_4 = true
          Enable_Timer_5 = 1
          Enable_Timer_6 = true
          Enable_Timer_{7..12} = false
          Enable_Timer_13 = true
          Enable_Timer_{14..16} = false
          Enable_CAN0 = true
          Enable_CAN1 = true
      3 x McuModeSettingConf, all with McuMode=(unset):
        NORMAL
        SLEEP
        RUN
    McuPublishedInformation
      McuResetReasonConf: McuResetReason=(unset)
