AUTOSAR XML (schema 4-1-1)
package /Tests/Boards/mpc5516it
  ecuc value collection mpc5516_board: ecuc-values=[Dio, Mcu, Port, EcuM]
  module config Dio: implementation-config-variant=VARIANT-PRE-COMPILE, module-description=Dio
    DioConfig
      4 x DioPort:
        LED_PORT: DioPortId=3
          LEDS_LED4 (DioChannel): DioChannelId=52
          LEDS_LED5 (DioChannel): DioChannelId=53
          LED_GRP_PTR (DioChannelGroup): DioChannelGroupIdentification=, DioPortMask=48, DioPortOffset=(unset)
        MISC_PORT: DioPortId=4
          S1 (DioChannel): DioChannelId=95
        PLAY: DioPortId=5
          OUTIN_0 (DioChannel): DioChannelId=80
          OUTIN_1 (DioChannel): DioChannelId=81
        SPI_HOLD: DioPortId=6
          3 x DioChannel:
            SPI_A_HOLD_M95256: DioChannelId=97
            SPI_B_HOLD_M95256: DioChannelId=102
            SPI_A_HOLD_S25FL016: DioChannelId=101
    DioGeneral: DioDevErrorDetect=1, DioFlipChannelApi=(unset), DioVersionInfoApi=1
  module config Mcu: implementation-config-variant=VARIANT-PRE-COMPILE, module-description=Mcu
    McuGeneralConfiguration: McuDevErrorDetect=0, McuGetRamStateApi=0, McuInitClock=1, McuNoPll=0, McuPerformResetApi=0, McuVersionInfoApi=0
    McuModuleConfiguration: McuClockSrcFailureNotification=DISABLED, McuNumberOfMcuModes=(unset), McuRamSectors=(unset), ArcDefaultClockRef=McuClockSettingConfig
      McuClockSettingConfig: McuClockSettingId=(unset)
        McuClockReferencePoint: McuClockReferencePointFrequency=8000000
        EXT_REF_80MHZ (PLLSettings): EPREDIV=1, EMFD=104, ERFD=5
      3 x McuModeSettingConf, all with McuMode=(unset):
        RUN
        SLEEP
        NORMAL
    McuPublishedInformation
      McuResetReasonConf: McuResetReason=(unset)
  module config Port: implementation-config-variant=VARIANT-PRE-COMPILE, module-description=Port
    PortConfigSet
      7 x PortContainer, all with PortNumberOfPortPins=(unset):
        CAN_A
          CNTX_A (PortPin):
            PortPinDirection = PORT_PIN_OUT
            PortPinDirectionChangeable = 0
            PortPinId = 48
            PortPinInitialMode = PORT_PIN_MODE_CAN
            PortPinLevelValue = PORT_PIN_LEVEL_LOW
            PortPinMode = PORT_PIN_MODE_CAN
            PortPinModeChangeable = 0
            ArcPortPinPull = PORT_PIN_PULL_NONE
            ArcPortPinSlewRate = PORT_PIN_SLEW_RATE_MIN
            ArcPortPinOpenDrainEnable = false
          CNRX_A (PortPin):
            PortPinDirection = PORT_PIN_IN
            PortPinDirectionChangeable = 0
            PortPinId = 49
            PortPinInitialMode = PORT_PIN_MODE_CAN
            PortPinLevelValue = PORT_PIN_LEVEL_LOW
            PortPinMode = PORT_PIN_MODE_CAN
            PortPinModeChangeable = 0
            ArcPortPinPull = PORT_PIN_PULL_NONE
            ArcPortPinSlewRate = PORT_PIN_SLEW_RATE_MIN
            ArcPortPinOpenDrainEnable = false
        LED
          PD4 (PortPin):
            PortPinDirection = PORT_PIN_OUT
            PortPinDirectionChangeable = 0
            PortPinId = 52
            PortPinInitialMode = PORT_PIN_MODE_DIO
            PortPinLevelValue = PORT_PIN_LEVEL_LOW
            PortPinMode = PORT_PIN_MODE_DIO
            PortPinModeChangeable = 0
            ArcPortPinPull = PORT_PIN_PULL_NONE
            ArcPortPinSlewRate = PORT_PIN_SLEW_RATE_MIN
            ArcPortPinOpenDrainEnable = false
          PD[5] (PortPin):
            PortPinDirection = PORT_PIN_OUT
            PortPinDirectionChangeable = 0
            PortPinId = 53
            PortPinInitialMode = PORT_PIN_MODE_DIO
            PortPinLevelValue = PORT_PIN_LEVEL_LOW
            PortPinMode = PORT_PIN_MODE_DIO
            PortPinModeChangeable = 0
            ArcPortPinPull = PORT_PIN_PULL_NONE
            ArcPortPinSlewRate = PORT_PIN_SLEW_RATE_MIN
            ArcPortPinOpenDrainEnable = false
        LIN_B
          TXD_B (PortPin):
            PortPinDirection = PORT_PIN_OUT
            PortPinDirectionChangeable = 0
            PortPinId = 56
            PortPinInitialMode = PORT_PIN_MODE_OTHER_1
            PortPinLevelValue = PORT_PIN_LEVEL_LOW
            PortPinMode = PORT_PIN_MODE_OTHER_1
            PortPinModeChangeable = 0
            ArcPortPinPull = PORT_PIN_PULL_NONE
            ArcPortPinSlewRate = PORT_PIN_SLEW_RATE_MAX
            ArcPortPinOpenDrainEnable = false
          RXD_B (PortPin):
            PortPinDirection = PORT_PIN_IN
            PortPinDirectionChangeable = 0
            PortPinId = 57
            PortPinInitialMode = PORT_PIN_MODE_OTHER_1
            PortPinLevelValue = PORT_PIN_LEVEL_LOW
            PortPinMode = PORT_PIN_MODE_OTHER_1
            PortPinModeChangeable = 0
            ArcPortPinPull = PORT_PIN_PULL_NONE
            ArcPortPinSlewRate = PORT_PIN_SLEW_RATE_MAX
            ArcPortPinOpenDrainEnable = false
        Misc
          3 x PortPin, all with PortPinDirectionChangeable=0, PortPinLevelValue=PORT_PIN_LEVEL_LOW, PortPinModeChangeable=0, ArcPortPinPull=PORT_PIN_PULL_NONE, ArcPortPinOpenDrainEnable=false:
            BOOTCFG: PortPinDirection=PORT_PIN_IN, PortPinId=50, PortPinInitialMode=PORT_PIN_MODE_OTHER_3, PortPinMode=PORT_PIN_MODE_OTHER_3, ArcPortPinSlewRate=PORT_PIN_SLEW_RATE_MAX
            PF[0]: PortPinDirection=PORT_PIN_OUT, PortPinId=80, PortPinInitialMode=PORT_PIN_MODE_DIO, PortPinMode=PORT_PIN_MODE_DIO, ArcPortPinSlewRate=PORT_PIN_SLEW_RATE_MIN
            PF[15]: PortPinDirection=PORT_PIN_IN, PortPinId=95, PortPinInitialMode=PORT_PIN_MODE_DIO, PortPinMode=PORT_PIN_MODE_DIO, ArcPortPinSlewRate=PORT_PIN_SLEW_RATE_MIN
        SerialPort
          TXD_D (PortPin):
            PortPinDirection = PORT_PIN_OUT
            PortPinDirectionChangeable = 0
            PortPinId = 92
            PortPinInitialMode = PORT_PIN_MODE_OTHER_2
            PortPinLevelValue = PORT_PIN_LEVEL_LOW
            PortPinMode = PORT_PIN_MODE_OTHER_2
            PortPinModeChangeable = 0
            ArcPortPinPull = PORT_PIN_PULL_NONE
            ArcPortPinSlewRate = PORT_PIN_SLEW_RATE_MIN
            ArcPortPinOpenDrainEnable = false
          RXD_D (PortPin):
            PortPinDirection = PORT_PIN_IN
            PortPinDirectionChangeable = 0
            PortPinId = 93
            PortPinInitialMode = PORT_PIN_MODE_OTHER_2
            PortPinLevelValue = PORT_PIN_LEVEL_LOW
            PortPinMode = PORT_PIN_MODE_OTHER_2
            PortPinModeChangeable = 0
            ArcPortPinPull = PORT_PIN_PULL_NONE
            ArcPortPinSlewRate = PORT_PIN_SLEW_RATE_MIN
            ArcPortPinOpenDrainEnable = false
        SPI_A
          7 x PortPin, all with PortPinDirectionChangeable=0, PortPinLevelValue=PORT_PIN_LEVEL_LOW, PortPinModeChangeable=0, ArcPortPinPull=PORT_PIN_PULL_NONE, ArcPortPinSlewRate=PORT_PIN_SLEW_RATE_MAX, ArcPortPinOpenDrainEnable=false:
            PCS_A[2]: PortPinDirection=PORT_PIN_OUT, PortPinId=64, PortPinInitialMode=PORT_PIN_MODE_SPI, PortPinMode=PORT_PIN_MODE_SPI
            PCS_A[1]: PortPinDirection=PORT_PIN_OUT, PortPinId=65, PortPinInitialMode=PORT_PIN_MODE_SPI, PortPinMode=PORT_PIN_MODE_SPI
            SCK_A: PortPinDirection=PORT_PIN_OUT, PortPinId=67, PortPinInitialMode=PORT_PIN_MODE_SPI, PortPinMode=PORT_PIN_MODE_SPI
            SOUT_A: PortPinDirection=PORT_PIN_OUT, PortPinId=68, PortPinInitialMode=PORT_PIN_MODE_SPI, PortPinMode=PORT_PIN_MODE_SPI
            SIN_A: PortPinDirection=PORT_PIN_IN, PortPinId=69, PortPinInitialMode=PORT_PIN_MODE_SPI, PortPinMode=PORT_PIN_MODE_SPI
            PG[1]: PortPinDirection=PORT_PIN_OUT, PortPinId=97, PortPinInitialMode=PORT_PIN_MODE_DIO, PortPinMode=PORT_PIN_MODE_DIO
            PG[5]: PortPinDirection=PORT_PIN_OUT, PortPinId=101, PortPinInitialMode=PORT_PIN_MODE_DIO, PortPinMode=PORT_PIN_MODE_DIO
        SPI_B
          5 x PortPin, all with PortPinDirectionChangeable=0, PortPinLevelValue=PORT_PIN_LEVEL_LOW, PortPinModeChangeable=0, ArcPortPinPull=PORT_PIN_PULL_NONE, ArcPortPinOpenDrainEnable=false:
            PCS_B[0]: PortPinDirection=PORT_PIN_OUT, PortPinId=60, PortPinInitialMode=PORT_PIN_MODE_SPI, PortPinMode=PORT_PIN_MODE_SPI, ArcPortPinSlewRate=PORT_PIN_SLEW_RATE_MAX
            SCK_B: PortPinDirection=PORT_PIN_OUT, PortPinId=61, PortPinInitialMode=PORT_PIN_MODE_SPI, PortPinMode=PORT_PIN_MODE_SPI, ArcPortPinSlewRate=PORT_PIN_SLEW_RATE_MIN
            SOUT_B: PortPinDirection=PORT_PIN_OUT, PortPinId=62, PortPinInitialMode=PORT_PIN_MODE_SPI, PortPinMode=PORT_PIN_MODE_SPI, ArcPortPinSlewRate=PORT_PIN_SLEW_RATE_MIN
            SIN_B: PortPinDirection=PORT_PIN_IN, PortPinId=63, PortPinInitialMode=PORT_PIN_MODE_SPI, PortPinMode=PORT_PIN_MODE_SPI, ArcPortPinSlewRate=PORT_PIN_SLEW_RATE_MIN
            PG[6]: PortPinDirection=PORT_PIN_OUT, PortPinId=102, PortPinInitialMode=PORT_PIN_MODE_DIO, PortPinMode=PORT_PIN_MODE_DIO, ArcPortPinSlewRate=PORT_PIN_SLEW_RATE_MIN
    PortGeneral: PortDevErrorDetect=1, PortSetPinDirectionApi=1, PortSetPinModeApi=1, PortVersionInfoApi=1
  module config EcuM: implementation-config-variant=VARIANT-PRE-COMPILE, module-description=EcuM
    EcuMConfiguration
      EcuMCommonConfiguration: EcuMConfigConsistencyHash=(unset), EcuMDefaultAppMode=(unset), EcuMOSResource=(unset)
        EcuMDefaultShutdownTarget: EcuMDefaultState=EcuMStateOff
        EcuMSleepMode: EcuMSleepModeId=(unset), EcuMSleepModeSuspend=(unset), EcuMSleepModeMcuModeRef=SLEEP, EcuMWakeupSourceMask=EcuMWakeupSource
        EcuMWakeupSource: EcuMWakeupSourceId=(unset), EcuMWakeupSourcePolling=0, EcuMResetReasonRef=(unset)
      EcuMFixedConfiguration: EcuMNvramReadallTimeout=10.0, EcuMNvramWriteallTimeout=10.0, EcuMRunMinimumDuration=10.0, EcuMNormalMcuModeRef=NORMAL
        EcuMFixedUserConfig: EcuMFixedUser=(unset)
    EcuMGeneral: EcuMDevErrorDetect=0, EcuMIncludeDem=0, EcuMIncludeDet=0, EcuMMainFunctionPeriod=0.2, EcuMVersionInfoApi=0
    EcuMFixedGeneral: EcuMIncludeComM=(unset), EcuMIncludeNvM=(unset), EcuMIncludeNvramMgr=(unset), EcuMTTIIEnabled=(unset), EcuMTTIIWakeupSourceRef=(unset)
