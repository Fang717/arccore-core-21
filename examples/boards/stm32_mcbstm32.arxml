AUTOSAR XML (schema 4-1-1)
package /ArcCore/Boards/stm32_mcbstm32
  ecuc value collection mcbstm32: ecuc-values=[Mcu, EcuM]
  module config Mcu: implementation-config-variant=VARIANT-PRE-COMPILE, module-description=Mcu
    McuGeneralConfiguration: McuDevErrorDetect=1, McuGetRamStateApi=0, McuInitClock=1, McuNoPll=0, McuPerformResetApi=0, McuVersionInfoApi=1
    McuModuleConfiguration: McuClockSrcFailureNotification=DISABLED, McuNumberOfMcuModes=(unset), McuRamSectors=(unset), ArcDefaultClockRef=McuClockSettingConfig
      McuClockSettingConfig:
        McuClockSettingId = (unset)
        ArcAHBClocksEnable = DMA1
        ArcAPB1ClocksEnable = TIM3
        ArcAPB2ClocksEnable = GPIOC
        ArcAPB1ClocksEnable = TIM2
        ArcAPB1ClocksEnable = CAN1
        ArcAPB2ClocksEnable = AFIO
        ArcAPB2ClocksEnable = GPIOA
        ArcAPB2ClocksEnable = GPIOB
        ArcAPB2ClocksEnable = ADC1
        ArcAPB2ClocksEnable = TIM1
        ArcAPB1ClocksEnable = TIM4
        PLLSettings: IDF=9, NDIV=0, ODF=0
        McuClockReferencePoint: Frequency=, McuClockReferencePointFrequency=25E6
      3 x McuModeSettingConf:
        RUN: McuMode=RUN
        SLEEP: McuMode=SLEEP
        NORMAL: McuMode=(unset)
    McuPublishedInformation
      McuResetReasonConf: McuResetReason=(unset)
  module config EcuM: implementation-config-variant=VARIANT-POST-BUILD, module-description=EcuM
    EcuMConfiguration
      EcuMCommonConfiguration: EcuMConfigConsistencyHash=(unset), EcuMDefaultAppMode=(unset), EcuMOSResource=(unset)
        EcuMDefaultShutdownTarget: EcuMDefaultState=EcuMStateOff
        EcuMSleepMode: EcuMSleepModeId=(unset), EcuMSleepModeSuspend=(unset), EcuMSleepModeMcuModeRef=RUN, EcuMWakeupSourceMask=EcuMWakeupSource
        EcuMWakeupSource: EcuMWakeupSourceId=(unset), EcuMWakeupSourcePolling=0, EcuMResetReasonRef=(unset)
      EcuMFixedConfiguration: EcuMNvramReadallTimeout=10.0, EcuMNvramWriteallTimeout=10.0, EcuMRunMinimumDuration=10.0, EcuMNormalMcuModeRef=NORMAL
        User_1 (EcuMFixedUserConfig): EcuMFixedUser=(unset)
    EcuMGeneral: EcuMDevErrorDetect=0, EcuMIncludeDem=0, EcuMIncludeDet=0, EcuMMainFunctionPeriod=0.2, EcuMVersionInfoApi=0
    EcuMFixedGeneral: EcuMIncludeComM=(unset), EcuMIncludeNvM=(unset), EcuMIncludeNvramMgr=(unset), EcuMTTIIEnabled=(unset), EcuMTTIIWakeupSourceRef=(unset)
