AUTOSAR XML (schema 4-2-1)
package /ArcCore/Boards/tc297_trb
  ecuc value collection tc297_trb: ecuc-values=[Mcu, EcuM]
  module config Mcu: implementation-config-variant=VARIANT-PRE-COMPILE, module-description=Mcu
    McuGeneralConfiguration: McuDevErrorDetect=true, McuGetRamStateApi=false, McuInitClock=true, McuNoPll=false, McuPerformResetApi=false, McuVersionInfoApi=false
    McuModuleConfiguration: McuClockSrcFailureNotification=DISABLED, McuNumberOfMcuModes=, McuRamSectors=, ArcDefaultClockRef=McuClockSettingConfig
      McuClockSettingConfig: McuClockSettingId=
        McuClockReferencePoint: McuClockReferencePointFrequency=8000000.0
        ArcPLLSettings: PLL1N=20, PLL0ADJ=1, PLL0MD=0, PLL0N=11, PLL0P=2, PLL0MF=1, PLL1P=2, PLL0M=1, PLL1M=1
      NORMAL (McuModeSettingConf): McuMode=
      RUN (McuModeSettingConf): McuMode=
    McuPublishedInformation
      McuResetReasonConf: McuResetReason=
  module config EcuM: implementation-config-variant=VARIANT-PRE-COMPILE, module-description=EcuM
    EcuMConfiguration
      EcuMCommonConfiguration: EcuMConfigConsistencyHash=, EcuMDefaultAppMode=(unset), EcuMOSResource=(unset)
        EcuMDefaultShutdownTarget: EcuMDefaultState=EcuMStateOff
        EcuMSleepMode: EcuMSleepModeId=, EcuMSleepModeSuspend=, EcuMSleepModeMcuModeRef=NORMAL, EcuMWakeupSourceMask=EcuMWakeupSource
        EcuMWakeupSource: EcuMWakeupSourceId=, EcuMWakeupSourcePolling=false, EcuMResetReasonRef=(unset)
      EcuMFixedConfiguration: EcuMNvramReadallTimeout=10.0, EcuMNvramWriteallTimeout=10.0, EcuMRunMinimumDuration=10.0, EcuMNormalMcuModeRef=NORMAL
        EcuMFixedUserConfig: EcuMFixedUser=
    EcuMGeneral: EcuMDevErrorDetect=false, EcuMIncludeDem=false, EcuMIncludeDet=false, EcuMMainFunctionPeriod=0.2, EcuMVersionInfoApi=false
