AUTOSAR XML (schema 4-0-3)
package /Tests/Os/OsSchTbl/Boards/mpc5744p_mmb
  ecuc value collection OsSchTbl_mpc5744p_mmb: ecuc-values=[Os, EcuM, Mcu]
