AUTOSAR XML (schema 4-2-1)
package /ArcCore/Boards/mpc5567qrtech
  ecuc value collection mpc5567qrtech: ecuc-values=[Can, Dio, Mcu, Port, EcuM]
  module config Can: implementation-config-variant=VARIANT-PRE-COMPILE, module-description=Can
    CanConfigSet
      CTRL_A (CanController):
        CanBusoffProcessing = INTERRUPT
        CanControllerActivation = 1
        CanControllerBaseAddress = (unset)
        CanControllerId = 0
        CanRxProcessing = INTERRUPT
        CanTxProcessing = INTERRUPT
        CanWakeupProcessing = INTERRUPT
        CanWakeupSupport = (unset)
        ArcCanControllerLoopback = 1
        ArcCanNumMessageBox = 64
        ArcCanClockSourceOscillator = 0
        CanWakeupFunctionalityAPI = (unset)
        ArcCanControllerHwUnit = FLEXCAN_A
        CanControllerDefaultBaudrate = CanControllerBaudrateConfigA1
        CanCpuClockRef = (unset)
        CanControllerBaudrateConfigA1 (CanControllerBaudrateConfig):
          CanControllerBaudRate = 125
          CanControllerPropSeg = 2
          CanControllerSeg1 = 4
          CanControllerSeg2 = 4
          CanControllerSyncJumpWidth = 1
          CanControllerBaudRateConfigID = 0
      CAN_HRH_A_1 (CanHardwareObject):
        CanHandleType = BASIC
        CanIdType = EXTENDED
        CanObjectId = (unset)
        CanObjectType = RECEIVE
        ArcCanFifoEnable = 0
        ArcCanMessageboxesPerHwObj = 
        CanHwObjectCount = 1
        CanControllerRef = CTRL_A
        CanHwFilter: CanHwFilterCode=0, CanHwFilterMask=0
      CTRL_C (CanController):
        CanBusoffProcessing = INTERRUPT
        CanControllerActivation = 1
        CanControllerBaseAddress = (unset)
        CanControllerId = 1
        CanRxProcessing = INTERRUPT
        CanTxProcessing = INTERRUPT
        CanWakeupProcessing = INTERRUPT
        CanWakeupSupport = (unset)
        ArcCanControllerLoopback = 1
        ArcCanNumMessageBox = 64
        ArcCanClockSourceOscillator = 0
        CanWakeupFunctionalityAPI = (unset)
        ArcCanControllerHwUnit = FLEXCAN_C
        CanControllerDefaultBaudrate = CanControllerBaudrateConfigC1
        CanCpuClockRef = (unset)
        CanControllerBaudrateConfigC1 (CanControllerBaudrateConfig):
          CanControllerBaudRate = 125
          CanControllerPropSeg = 2
          CanControllerSeg1 = 4
          CanControllerSeg2 = 4
          CanControllerSyncJumpWidth = 1
          CanControllerBaudRateConfigID = 0
      3 x CanHardwareObject, all with CanHandleType=BASIC, CanObjectId=(unset), ArcCanFifoEnable=0, ArcCanMessageboxesPerHwObj=, CanHwObjectCount=1:
        CAN_HRH_C_1: CanIdType=STANDARD, CanObjectType=RECEIVE, CanControllerRef=CTRL_C
          CanHwFilter: CanHwFilterCode=0, CanHwFilterMask=0
        CAN_HTH_A_1: CanIdType=EXTENDED, CanObjectType=TRANSMIT, CanControllerRef=CTRL_A
        CAN_HTH_C_1: CanIdType=STANDARD, CanObjectType=TRANSMIT, CanControllerRef=CTRL_C
    CanGeneral:
      CanChangeBaudrateApi = false
      CanDevErrorDetection = 1
      CanHardwareCancellation = (unset)
      CanIdenticalIdCancellation = (unset)
      CanIndex = (unset)
      CanMainFunctionModePeriod = (unset)
      CanMultiplexedTransmission = (unset)
      CanTimeoutDuration = (unset)
      CanVersionInfoApi = 1
      CanCounterRef = (unset)
      CanSupportTTCANRef = (unset)
      CanMainFunctionRWPeriods
  module config Dio: implementation-config-variant=VARIANT-PRE-COMPILE, module-description=Dio
    DioConfig
      DioPort_1 (DioPort): DioPortId=1
        GPIO_127 (DioChannel): DioChannelId=127
        LED_K2 (DioChannel): DioChannelId=125
    DioGeneral: DioDevErrorDetect=1, DioFlipChannelApi=(unset), DioVersionInfoApi=1
  module config Mcu: implementation-config-variant=VARIANT-PRE-COMPILE, module-description=Mcu
    McuGeneralConfiguration: McuDevErrorDetect=0, McuGetRamStateApi=0, McuInitClock=1, McuNoPll=0, McuPerformResetApi=0, McuVersionInfoApi=0
    McuModuleConfiguration: McuClockSrcFailureNotification=DISABLED, McuNumberOfMcuModes=(unset), McuRamSectors=(unset), ArcDefaultClockRef=Clock
      Clock (McuClockSettingConfig): McuClockSettingId=(unset)
        PLLSettings: EPREDIV=1, EMFD=12, ERFD=0
        McuClockReferencePoint: Frequency=(unset), McuClockReferencePointFrequency=16000000.0
      3 x McuModeSettingConf, all with McuMode=(unset):
        SLEEP
        RUN
        NORMAL
    McuPublishedInformation
      McuResetReasonConf: McuResetReason=(unset)
  module config Port: implementation-config-variant=VARIANT-PRE-COMPILE, module-description=Port
    PortConfigSet
      Can (PortContainer): PortNumberOfPortPins=(unset)
        4 x PortPin, all with PortPinDirectionChangeable=0, PortPinInitialMode=PORT_PIN_MODE_CAN, PortPinLevelValue=PORT_PIN_LEVEL_LOW, PortPinMode=, PortPinModeChangeable=0, ArcPortPinPull=PORT_PIN_PULL_NONE, ArcPortPinSlewRate=PORT_PIN_SLEW_RATE_MAX, ArcPortPinOpenDrainEnable=0:
          CNTXA: PortPinDirection=PORT_PIN_OUT, PortPinId=83
          CNRXA: PortPinDirection=PORT_PIN_IN, PortPinId=84
          CNTXC: PortPinDirection=PORT_PIN_OUT, PortPinId=87
          CNRXC: PortPinDirection=PORT_PIN_IN, PortPinId=88
      Dio (PortContainer): PortNumberOfPortPins=(unset)
        GPIO125 (PortPin):
          PortPinDirection = PORT_PIN_OUT
          PortPinDirectionChangeable = 0
          PortPinId = 125
          PortPinInitialMode = PORT_PIN_MODE_DIO
          PortPinLevelValue = PORT_PIN_LEVEL_LOW
          PortPinMode = 
          PortPinModeChangeable = 0
          ArcPortPinPull = PORT_PIN_PULL_NONE
          ArcPortPinSlewRate = PORT_PIN_SLEW_RATE_MIN
          ArcPortPinOpenDrainEnable = 0
        GPIO127 (PortPin):
          PortPinDirection = PORT_PIN_OUT
          PortPinDirectionChangeable = 0
          PortPinId = 127
          PortPinInitialMode = PORT_PIN_MODE_DIO
          PortPinLevelValue = PORT_PIN_LEVEL_LOW
          PortPinMode = 
          PortPinModeChangeable = 0
          ArcPortPinPull = PORT_PIN_PULL_NONE
          ArcPortPinSlewRate = PORT_PIN_SLEW_RATE_MIN
          ArcPortPinOpenDrainEnable = 0
    PortGeneral: PortDevErrorDetect=1, PortSetPinDirectionApi=1, PortSetPinModeApi=1, PortVersionInfoApi=1
  module config EcuM: implementation-config-variant=VARIANT-PRE-COMPILE, module-description=EcuM
    EcuMConfiguration
      EcuMCommonConfiguration: EcuMConfigConsistencyHash=(unset), EcuMDefaultAppMode=(unset), EcuMOSResource=(unset)
        EcuMDefaultShutdownTarget: EcuMDefaultState=EcuMStateOff
        EcuMSleepMode: EcuMSleepModeId=(unset), EcuMSleepModeSuspend=(unset), EcuMSleepModeMcuModeRef=RUN, EcuMWakeupSourceMask=EcuMWakeupSource
        EcuMWakeupSource: EcuMWakeupSourceId=(unset), EcuMWakeupSourcePolling=0, EcuMResetReasonRef=(unset)
      EcuMFixedConfiguration: EcuMNvramReadallTimeout=10.0, EcuMNvramWriteallTimeout=10.0, EcuMRunMinimumDuration=10.0, EcuMNormalMcuModeRef=NORMAL
        User_1 (EcuMFixedUserConfig): EcuMFixedUser=(unset)
    EcuMGeneral: EcuMDevErrorDetect=0, EcuMIncludeDem=0, EcuMIncludeDet=0, EcuMMainFunctionPeriod=0.2, EcuMVersionInfoApi=0
    EcuMFixedGeneral: EcuMIncludeComM=(unset), EcuMIncludeNvM=(unset), EcuMIncludeNvramMgr=(unset), EcuMTTIIEnabled=(unset), EcuMTTIIWakeupSourceRef=(unset)
