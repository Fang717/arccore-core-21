AUTOSAR XML (schema 4-2-2)
package /ArcCore/Boards/mpc5746c_mpc574xg_mb
  ecuc value collection MyEcu: ecuc-values=[Adc, Can, Dio, Eth, Gpt, Lin, Mcu, Port, Pwm, Spi, Wdg]
  module config Adc: implementation-config-variant=VARIANT-PRE-COMPILE, module-description=Adc
    AdcConfigSet
      AdcHwUnit: AdcHwUnitId=ADC_CTRL_0, ArcAdcPrescaleDivideFactor=2
        AdcChannel1 (AdcChannel): ArcAdcChannelId=ADC_CH7, AdcChannelId=
        AdcGroup1 (AdcGroup):
          AdcGroupAccessMode = ADC_ACCESS_MODE_SINGLE
          AdcGroupConversionMode = ADC_CONV_MODE_ONESHOT
          AdcGroupId = 
          AdcGroupTriggSrc = 
          AdcStreamingBufferMode = ADC_STREAM_BUFFER_LINEAR
          AdcStreamingNumSamples = 1
          ArcAdcChannelConvTimeSampTime = 255
          ArcAdcChannelConvTimeCmpTime = ADC_INPCPM_3
          ArcAdcChannelConvTimeLatchTime = ADC_INPLATCH_1
          AdcNotification = IoHwAb_AdcConversionComplete
          AdcGroupDefinition = AdcChannel1
    AdcGeneral:
      AdcDeInitApi = true
      AdcDevErrorDetect = true
      AdcEnableLimitCheck = 
      AdcEnableQueuing = 
      AdcEnableStartStopGroupApi = true
      AdcGrpNotifCapability = true
      AdcHwTriggerApi = 
      AdcPriorityImplementation = 
      AdcReadGroupApi = true
      AdcResultAlignment = 
      AdcVersionInfoApi = 1
    AdcPublishedInformation: AdcChannelValueSigned=, AdcGroupFirstChannelFixed=, AdcMaxChannelResolution=
  module config Can: implementation-config-variant=VARIANT-PRE-COMPILE, module-description=Can
    CanConfigSet
      CanController0 (CanController):
        CanBusoffProcessing = INTERRUPT
        CanControllerActivation = true
        CanControllerBaseAddress = 
        CanControllerId = 0
        CanRxProcessing = INTERRUPT
        CanTxProcessing = INTERRUPT
        CanWakeupFunctionalityAPI = false
        CanWakeupProcessing = INTERRUPT
        CanWakeupSupport = false
        ArcCanControllerLoopback = false
        ArcCanNumMessageBox = 64
        ArcCanControllerHwUnit = FLEXCAN_A
        ArcCanClockSourceOscillator = true
        CanControllerDefaultBaudrate = CanControllerBaudrateConfig_0
        CanCpuClockRef = (unset)
        CanControllerBaudrateConfig_0 (CanControllerBaudrateConfig):
          CanControllerBaudRate = 500
          CanControllerBaudRateConfigID = 0
          CanControllerPropSeg = 3
          CanControllerSeg1 = 8
          CanControllerSeg2 = 4
          CanControllerSyncJumpWidth = 1
      Ctrl_0_Rx_0 (CanHardwareObject):
        CanHandleType = BASIC
        CanIdType = STANDARD
        CanObjectId = 
        CanObjectType = RECEIVE
        ArcCanFifoEnable = false
        ArcCanMessageboxesPerHwObj = 
        CanHwObjectCount = 1
        CanControllerRef = CanController0
        CanHwFilter: CanHwFilterCode=0, CanHwFilterMask=0
      Ctrl_0_Tx_0 (CanHardwareObject):
        CanHandleType = BASIC
        CanIdType = STANDARD
        CanObjectId = 
        CanObjectType = TRANSMIT
        ArcCanFifoEnable = false
        ArcCanMessageboxesPerHwObj = 
        CanHwObjectCount = 1
        CanControllerRef = CanController0
    CanGeneral:
      CanDevErrorDetection = true
      CanHardwareCancellation = false
      CanIdenticalIdCancellation = false
      CanIndex = 
      CanMainFunctionModePeriod = 
      CanMultiplexedTransmission = false
      CanTimeoutDuration = 
      CanVersionInfoApi = true
      CanCounterRef = (unset)
      CanSupportTTCANRef = (unset)
      CanMainFunctionRWPeriods
  module config Dio: implementation-config-variant=VARIANT-PRE-COMPILE, module-description=Dio
    DioConfig
      PortG (DioPort): DioPortId=6
        LED1 (DioChannel): DioChannelId=98
        LED2 (DioChannel): DioChannelId=99
      PortJ (DioPort): DioPortId=9
        SpiCs (DioChannel): DioChannelId=144
    DioGeneral: DioDevErrorDetect=true, DioFlipChannelApi=, DioVersionInfoApi=true
  module config Eth: implementation-config-variant=VARIANT-PRE-COMPILE, module-description=Eth
    EthConfigSet
      EthCtrlConfig:
        EthCtrlEnableMii = 1
        EthCtrlEnableRxInterrupt = 1
        EthCtrlEnableTxInterrupt = 1
        EthCtrlIdx = 0
        EthCtrlRxBufLenByte = 1522
        EthCtrlTxBufLenByte = 1522
        EthRxBufTotal = 2
        EthTxBufTotal = 3
        ArcEthControllerHwMIIMode = MII
        ArcEthControllerHwSpeed = MBPS_100
        ArcEthControllerHwUnit = HWUNIT_0
        ArcEthCtrlDiscardRxFCS = false
        ArcEthCtrlEnableRxChecksumOffload = false
        ArcEthCtrlEnableTxChecksumOffload = false
        ArcEthCtrlRxDMAChannel = 
        ArcEthCtrlRxQueueValue = 
        ArcEthCtrlTxDMAChannel = 
        ArcEthCtrlTxQueueValue = 
        ArcEthFifoPrio = 
        ArcEthCtrlEnableCircDesc = 
        EthCtrlPhyAddress = 12-34-56-78-9a-bc
    EthGeneral:
      EthDevErrorDetect = 1
      EthGetDropCountApi = 
      EthGetEtherStatsApi = 
      EthGlobalTimeSupport = 
      EthIndex = 
      EthMainFunctionPeriod = 0.1
      EthMaxCtrlsSupported = 
      EthUpdatePhysAddrFilter = true
      EthVersionInfoApi = 1
      ArcEthCpu1xclkValue = 
      ArcEthSoftReset = false
      EthCtrlOffloading: EthCtrlEnableOffloadChecksumICMP=, EthCtrlEnableOffloadChecksumIPv4=, EthCtrlEnableOffloadChecksumTCP=, EthCtrlEnableOffloadChecksumUDP=
  module config Gpt: implementation-config-variant=VARIANT-PRE-COMPILE, module-description=Gpt
    GptChannelConfigSet
      4 x GptChannelConfiguration, all with GptChannelId=(unset), GptChannelTickFrequency=(unset), GptChannelTickValueMax=(unset), GptEnableWakeup=0, GptChannelClkSrcRef=(unset):
        GptChannel_1: GptChannelMode=GPT_CH_MODE_CONTINUOUS, ArcCoreGptPhysicalChannel=GPT_CHANNEL_PIT_0, GptNotification=gpt_notification1
        GptChannel_3: GptChannelMode=GPT_CH_MODE_CONTINUOUS, ArcCoreGptPhysicalChannel=GPT_CHANNEL_PIT_2, GptNotification=gpt_notification3
        GptChannel_2: GptChannelMode=GPT_CH_MODE_ONESHOT, ArcCoreGptPhysicalChannel=GPT_CHANNEL_PIT_1, GptNotification=gpt_notification2
        GptChannel_4: GptChannelMode=GPT_CH_MODE_ONESHOT, ArcCoreGptPhysicalChannel=GPT_CHANNEL_PIT_3, GptNotification=gpt_notification4
    GptConfigurationOfOptApiServices: GptDeinitApi=1, GptEnableDisableNotificationApi=1, GptTimeElapsedApi=1, GptTimeRemainingApi=1, GptVersionInfoApi=1, GptWakeupFunctionalityApi=0
    GptDriverConfiguration: GptDevErrorDetect=1, GptReportWakeupSource=0, GptPredefTimer100us32bitEnable=(unset), GptPredefTimer1usEnablingGrade=
      GptClockReferencePoint: GptClockReference=(unset)
  module config Lin: implementation-config-variant=VARIANT-PRE-COMPILE, module-description=Lin
    LinGeneral: LinDevErrorDetect=true, LinIndex=, LinTimeoutDuration=, LinVersionInfoApi=true
    LinGlobalConfig
      Channel_0 (LinChannel): LinChannelBaudRate=19200, LinChannelId=1, LinChannelWakeupSupport=0, LinClockRef=(unset)
  module config Mcu: implementation-config-variant=VARIANT-PRE-COMPILE, module-description=Mcu
    McuGeneralConfiguration: McuDevErrorDetect=true, McuGetRamStateApi=false, McuInitClock=true, McuNoPll=false, McuPerformResetApi=false, McuVersionInfoApi=false
    McuModuleConfiguration: McuClockSrcFailureNotification=DISABLED, McuNumberOfMcuModes=, McuRamSectors=, ArcDefaultClockRef=McuClockSettingConfig
      McuClockSettingConfig: McuClockSettingId=
        McuClockReferencePoint: Frequency=, McuClockReferencePointFrequency=40000000.0
        ArcPLLSettings: PLLDV_PREDIV=1, PLLDV_MFD=16, PLLDV_RFDPHI=1, PLLDV_RFDPHI1=2, PLLFM_MODPRD=0, PLLFM_INCSTP=0, PLLFM_MODEN=false
      3 x McuModeSettingConf, all with McuMode=:
        NORMAL
        RUN
        SLEEP
    McuPublishedInformation
      McuResetReasonConf: McuResetReason=
  module config Port: implementation-config-variant=VARIANT-PRE-COMPILE, module-description=Port
    PortConfigSet
      6 x PortContainer, all with PortNumberOfPortPins=:
        CAN
          CAN0TX (PortPin):
            PortPinDirection = PORT_PIN_OUT
            PortPinDirectionChangeable = 0
            PortPinId = 16
            PortPinInitialMode = PORT_PIN_MODE_CAN
            PortPinLevelValue = PORT_PIN_LEVEL_LOW
            PortPinMode = PORT_PIN_MODE_CAN
            PortPinModeChangeable = 0
            ArcPortPinPull = PORT_PIN_PULL_NONE
            ArcPortPinSlewRate = PORT_PIN_SLEW_RATE_MED
            ArcPortPinOpenDrainEnable = false
          CAN0RX (PortPin):
            PortPinDirection = PORT_PIN_IN
            PortPinDirectionChangeable = 0
            PortPinId = 17
            PortPinInitialMode = PORT_PIN_MODE_CAN
            PortPinLevelValue = PORT_PIN_LEVEL_LOW
            PortPinMode = PORT_PIN_MODE_CAN
            PortPinModeChangeable = 0
            ArcPortPinPull = PORT_PIN_PULL_NONE
            ArcPortPinSlewRate = PORT_PIN_SLEW_RATE_MED
            ArcPortPinOpenDrainEnable = false
        GPIO
          LED1_DS2 (PortPin):
            PortPinDirection = PORT_PIN_OUT
            PortPinDirectionChangeable = 1
            PortPinId = 98
            PortPinInitialMode = PORT_PIN_MODE_DIO
            PortPinLevelValue = PORT_PIN_LEVEL_LOW
            PortPinMode = 
            PortPinModeChangeable = 0
            ArcPortPinPull = PORT_PIN_PULL_NONE
            ArcPortPinSlewRate = PORT_PIN_SLEW_RATE_MIN
            ArcPortPinOpenDrainEnable = false
          LED2_DS3 (PortPin):
            PortPinDirection = PORT_PIN_OUT
            PortPinDirectionChangeable = 1
            PortPinId = 99
            PortPinInitialMode = PORT_PIN_MODE_DIO
            PortPinLevelValue = PORT_PIN_LEVEL_LOW
            PortPinMode = PORT_PIN_MODE_DIO
            PortPinModeChangeable = 0
            ArcPortPinPull = PORT_PIN_PULL_NONE
            ArcPortPinSlewRate = PORT_PIN_SLEW_RATE_MIN
            ArcPortPinOpenDrainEnable = false
        ETH
          18 x PortPin, all with PortPinLevelValue=PORT_PIN_LEVEL_LOW, PortPinMode=PORT_PIN_MODE_ETH, PortPinModeChangeable=0, ArcPortPinPull=PORT_PIN_PULL_NONE, ArcPortPinSlewRate=PORT_PIN_SLEW_RATE_MAX, ArcPortPinOpenDrainEnable=false:
            ENET0_RXD_1: PortPinDirection=PORT_PIN_IN, PortPinDirectionChangeable=0, PortPinId=8, PortPinInitialMode=PORT_PIN_MODE_ETH
            ENET0_RXD_0: PortPinDirection=PORT_PIN_IN, PortPinDirectionChangeable=0, PortPinId=9, PortPinInitialMode=PORT_PIN_MODE_ETH
            ENET0_RXD_2: PortPinDirection=PORT_PIN_IN, PortPinDirectionChangeable=0, PortPinId=7, PortPinInitialMode=PORT_PIN_MODE_ETH
            ENET0_RXD_3: PortPinDirection=PORT_PIN_IN, PortPinDirectionChangeable=0, PortPinId=77, PortPinInitialMode=PORT_PIN_MODE_ETH
            ENET0_RX_CLK: PortPinDirection=PORT_PIN_IN, PortPinDirectionChangeable=0, PortPinId=3, PortPinInitialMode=PORT_PIN_MODE_ETH
            ENET0_RX_ER: PortPinDirection=PORT_PIN_IN, PortPinDirectionChangeable=0, PortPinId=11, PortPinInitialMode=PORT_PIN_MODE_ETH
            ENET0_RX_DV: PortPinDirection=PORT_PIN_IN, PortPinDirectionChangeable=0, PortPinId=95, PortPinInitialMode=PORT_PIN_MODE_ETH
            ENET0_COL: PortPinDirection=PORT_PIN_IN, PortPinDirectionChangeable=0, PortPinId=10, PortPinInitialMode=PORT_PIN_MODE_ETH
            ENET0_CRS: PortPinDirection=PORT_PIN_IN, PortPinDirectionChangeable=0, PortPinId=76, PortPinInitialMode=PORT_PIN_MODE_ETH
            ENET0_TX_CLK: PortPinDirection=PORT_PIN_IN, PortPinDirectionChangeable=0, PortPinId=97, PortPinInitialMode=PORT_PIN_MODE_OTHER1
            ENET0_MDIO: PortPinDirection=PORT_PIN_IN, PortPinDirectionChangeable=1, PortPinId=94, PortPinInitialMode=PORT_PIN_MODE_OTHER2
            ENET0_MDC: PortPinDirection=PORT_PIN_OUT, PortPinDirectionChangeable=0, PortPinId=96, PortPinInitialMode=PORT_PIN_MODE_ETH
            ENET0_TXD_0: PortPinDirection=PORT_PIN_OUT, PortPinDirectionChangeable=0, PortPinId=113, PortPinInitialMode=PORT_PIN_MODE_ETH
            ENET0_TXD_1: PortPinDirection=PORT_PIN_OUT, PortPinDirectionChangeable=0, PortPinId=112, PortPinInitialMode=PORT_PIN_MODE_ETH
            ENET0_TXD_2: PortPinDirection=PORT_PIN_OUT, PortPinDirectionChangeable=0, PortPinId=108, PortPinInitialMode=PORT_PIN_MODE_ETH
            ENET0_TXD_3: PortPinDirection=PORT_PIN_OUT, PortPinDirectionChangeable=0, PortPinId=109, PortPinInitialMode=PORT_PIN_MODE_ETH
            ENET0_TX_EN: PortPinDirection=PORT_PIN_OUT, PortPinDirectionChangeable=0, PortPinId=114, PortPinInitialMode=PORT_PIN_MODE_ETH
            ENET0_MDIO_OUT: PortPinDirection=PORT_PIN_OUT, PortPinDirectionChangeable=1, PortPinId=94, PortPinInitialMode=PORT_PIN_MODE_ETH
        ANALOG
          ADC_0_S_2 (PortPin):
            PortPinDirection = PORT_PIN_IN
            PortPinDirectionChangeable = 0
            PortPinId = 26
            PortPinInitialMode = PORT_PIN_MODE_ADC
            PortPinLevelValue = PORT_PIN_LEVEL_LOW
            PortPinMode = PORT_PIN_MODE_ADC
            PortPinModeChangeable = 0
            ArcPortPinPull = PORT_PIN_PULL_NONE
            ArcPortPinSlewRate = PORT_PIN_SLEW_RATE_MAX
            ArcPortPinOpenDrainEnable = false
        SPI
          5 x PortPin, all with PortPinDirectionChangeable=0, PortPinLevelValue=PORT_PIN_LEVEL_LOW, PortPinModeChangeable=0, ArcPortPinPull=PORT_PIN_PULL_NONE, ArcPortPinSlewRate=PORT_PIN_SLEW_RATE_MAX, ArcPortPinOpenDrainEnable=false:
            DSPI_0_dSOUT_0: PortPinDirection=PORT_PIN_OUT, PortPinId=13, PortPinInitialMode=PORT_PIN_MODE_SPI, PortPinMode=PORT_PIN_MODE_SPI
            DSPI_0_dCS0_0: PortPinDirection=PORT_PIN_OUT, PortPinId=15, PortPinInitialMode=PORT_PIN_MODE_SPI, PortPinMode=PORT_PIN_MODE_SPI
            DSPI_0_dSCLK_0: PortPinDirection=PORT_PIN_OUT, PortPinId=14, PortPinInitialMode=PORT_PIN_MODE_SPI, PortPinMode=PORT_PIN_MODE_SPI
            DSPI_0_dSIN_0: PortPinDirection=PORT_PIN_IN, PortPinId=12, PortPinInitialMode=PORT_PIN_MODE_OTHER2, PortPinMode=PORT_PIN_MODE_SPI
            SIUL2_GPIO_144: PortPinDirection=PORT_PIN_OUT, PortPinId=144, PortPinInitialMode=PORT_PIN_MODE_DIO, PortPinMode=PORT_PIN_MODE_DIO
        PWM
          EMIOS1_E1UC_13_LED3_DS7 (PortPin):
            PortPinDirection = PORT_PIN_OUT
            PortPinDirectionChangeable = 0
            PortPinId = 100
            PortPinInitialMode = PORT_PIN_MODE_PWM
            PortPinLevelValue = PORT_PIN_LEVEL_LOW
            PortPinMode = PORT_PIN_MODE_PWM
            PortPinModeChangeable = 0
            ArcPortPinPull = PORT_PIN_PULL_NONE
            ArcPortPinSlewRate = PORT_PIN_SLEW_RATE_MAX
            ArcPortPinOpenDrainEnable = false
          EMIOS1_E1UC_14_LED4_DS8 (PortPin):
            PortPinDirection = PORT_PIN_OUT
            PortPinDirectionChangeable = 0
            PortPinId = 101
            PortPinInitialMode = PORT_PIN_MODE_PWM
            PortPinLevelValue = PORT_PIN_LEVEL_LOW
            PortPinMode = PORT_PIN_MODE_PWM
            PortPinModeChangeable = 0
            ArcPortPinPull = PORT_PIN_PULL_NONE
            ArcPortPinSlewRate = PORT_PIN_SLEW_RATE_MAX
            ArcPortPinOpenDrainEnable = false
    PortGeneral: PortDevErrorDetect=true, PortSetPinDirectionApi=true, PortSetPinModeApi=true, PortVersionInfoApi=true
  module config Pwm: implementation-config-variant=VARIANT-PRE-COMPILE, module-description=Pwm
    PwmChannelConfigSet
      Channel_LED_3 (PwmChannel):
        PwmChannelId = 43
        PwmDutycycleDefault = 16384
        PwmIdleState = PWM_HIGH
        PwmPeriodDefault = 0.01
        PwmPolarity = PWM_LOW
        ArcPwmMode = PWM_MODE_BASIC
        ArcPwmClkSrc = PWM_CLKSRC_COUNTER_BUS_A
        ArcPwmChannelPrescaler = 1
        PwmChannelClass = PWM_FIXED_PERIOD
      Channel_LED_4 (PwmChannel):
        PwmChannelId = 44
        PwmDutycycleDefault = 0
        PwmIdleState = PWM_HIGH
        PwmPeriodDefault = 0.01
        PwmPolarity = PWM_LOW
        ArcPwmMode = PWM_MODE_COUNTER_BUS_PROVIDER_MCB_UP
        ArcPwmClkSrc = PWM_CLKSRC_INTERNAL_COUNTER
        ArcPwmChannelPrescaler = AUTO
        PwmChannelClass = PWM_FIXED_PERIOD
    PwmConfigurationOfOptApiServices: PwmDeInitApi=0, PwmGetOutputState=0, PwmSetDutyCycle=1, PwmSetOutputToIdle=0, PwmSetPeriodAndDuty=0, PwmVersionInfoApi=0
    PwmGeneral:
      PwmDevErorDetect = (unset)
      PwmDevErrorDetect = 1
      PwmDutycycleUpdatedEndperiod = 1
      PwmNotificationSupported = 1
      PwmPeriodUpdatedEndperiod = 1
      ArcPwmGlobalPrescalerDivisorEMIOS0 = 4
      ArcPwmGlobalPrescalerDivisorEMIOS1 = 4
      PwmIndex = (unset)
      ArcPwmGlobalPrescalerDivisorEMIOS2 = 1
  module config Spi: implementation-config-variant=VARIANT-PRE-COMPILE, module-description=Spi
    SpiDriver
      CH_ADDR (SpiChannel): SpiChannelId=, SpiChannelType=EB, SpiDataWidth=16, SpiEbMaxLength=64, SpiIbNBuffers=0, SpiTransferStart=MSB, SpiDefaultData=0
      device_1 (SpiExternalDevice):
        SpiBaudrate = 10000000
        SpiCsIdentifier = 0
        SpiCsPolarity = LOW
        SpiDataShiftEdge = LEADING
        SpiEnableCs = 
        SpiHwUnit = CSIB0
        SpiShiftClockIdleLevel = LOW
        SpiTimeClk2Cs = 0.000006
        ArcTimeCs2Clk = 0.000006
        ArcCsCallback = Spi_device_1
      JOB_CMD (SpiJob): SpiJobId=, SpiJobPriority=0, SpiDeviceAssignment=device_1
        cmd (SpiChannelList): SpiChannelIndex=0, SpiChannelAssignment=CH_CMD
      SEQ_CMD (SpiSequence): SpiInterruptibleSequence=, SpiSequenceId=, SpiJobAssignment=JOB_CMD
      3 x SpiChannel, all with SpiChannelId=, SpiChannelType=EB, SpiDataWidth=8, SpiIbNBuffers=0, SpiTransferStart=MSB:
        CH_CMD: SpiEbMaxLength=64
        CH_DATA: SpiEbMaxLength=64
        CH_WREN: SpiEbMaxLength=1, SpiDefaultData=6
      JOB_CMD2 (SpiJob): SpiJobId=, SpiJobPriority=0, SpiDeviceAssignment=device_1
        cmd (SpiChannelList): SpiChannelIndex=0, SpiChannelAssignment=CH_CMD
        data (SpiChannelList): SpiChannelIndex=1, SpiChannelAssignment=CH_DATA
      JOB_DATA (SpiJob): SpiJobId=, SpiJobPriority=2, SpiDeviceAssignment=device_1
        3 x SpiChannelList:
          addr: SpiChannelIndex=1, SpiChannelAssignment=CH_ADDR
          cmd: SpiChannelIndex=0, SpiChannelAssignment=CH_CMD
          data: SpiChannelIndex=2, SpiChannelAssignment=CH_DATA
      SEQ_CMD2 (SpiSequence): SpiInterruptibleSequence=, SpiSequenceId=, SpiJobAssignment=JOB_CMD2
      JOB_WREN (SpiJob): SpiJobId=, SpiJobPriority=3, SpiDeviceAssignment=device_1
        wren (SpiChannelList): SpiChannelIndex=0, SpiChannelAssignment=CH_WREN
      SEQ_READ (SpiSequence): SpiInterruptibleSequence=, SpiSequenceId=, SpiJobAssignment=JOB_DATA
      SEQ_WRITE (SpiSequence): SpiInterruptibleSequence=, SpiSequenceId=, SpiJobAssignment=JOB_WREN, SpiJobAssignment=JOB_DATA
    SpiGeneral:
      SpiCancelApi = true
      SpiChannelBuffersAllowed = 
      SpiDevErrorDetect = true
      SpiHwStatusApi = true
      SpiInterruptibleSeqAllowed = 
      SpiLevelDelivered = 
      SpiSupportConcurrentSyncTransmit = 
      SpiVersionInfoApi = true
      ArcImplementation = FIFO
    SpiPublishedInformation: SpiMaxHwUnit=
  module config Wdg: implementation-config-variant=VARIANT-PRE-COMPILE, module-description=Wdg
    WdgGeneral: WdgDevErrorDetect=1, WdgDisableAllowed=, WdgRunArea=, WdgTriggerLocation=, WdgVersionInfoApi=1
    WdgPublishedInformation: WdgTriggerMode=
    WdgSettingsConfig: WdgDefaultMode=WDGIF_FAST_MODE
      WdgSettingsFast: ActivationBit=1, ReloadValue=512, ArcWdgTimeoutValue=512
      WdgSettingsOff: ActivationBit=1, ReloadValue=32000
      WdgSettingsSlow: ActivationBit=1, ReloadValue=32000, ArcWdgTimeoutValue=1000
