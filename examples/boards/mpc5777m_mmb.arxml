AUTOSAR XML (schema 4-2-2)
package /ArcCore/Boards/mpc5777m_mmb
  module config Port: implementation-config-variant=VARIANT-PRE-COMPILE, module-description=Port
    PortConfigSet: ArcPortNumberOfPortPins=144
      3 x PortContainer, all with PortNumberOfPortPins=(unset):
        CAN
          4 x PortPin, all with PortPinDirectionChangeable=0, PortPinInitialMode=PORT_PIN_MODE_CAN, PortPinLevelValue=PORT_PIN_LEVEL_LOW, PortPinMode=PORT_PIN_MODE_CAN, PortPinModeChangeable=0, ArcPortPinPull=PORT_PIN_PULL_NONE, ArcPortPinSlewRate=PORT_PIN_SLEW_RATE_MAX, ArcPortPinOpenDrainEnable=0:
            M_CAN_1_MCAN1TX: PortPinDirection=PORT_PIN_OUT, PortPinId=10
            M_CAN_1_MCAN1RX: PortPinDirection=PORT_PIN_IN, PortPinId=11
            M_CAN_2_MCAN2RX: PortPinDirection=PORT_PIN_IN, PortPinId=40
            M_CAN_2_MCAN2TX: PortPinDirection=PORT_PIN_OUT, PortPinId=41
        LEDS
          SIUL2_GPIO_64 (PortPin):
            PortPinDirection = PORT_PIN_OUT
            PortPinDirectionChangeable = 0
            PortPinId = 64
            PortPinInitialMode = PORT_PIN_MODE_DIO
            PortPinLevelValue = PORT_PIN_LEVEL_LOW
            PortPinMode = PORT_PIN_MODE_DIO
            PortPinModeChangeable = 0
            ArcPortPinPull = PORT_PIN_PULL_NONE
            ArcPortPinSlewRate = PORT_PIN_SLEW_RATE_MAX
            ArcPortPinOpenDrainEnable = 0
          SIUL2_GPIO_65 (PortPin):
            PortPinDirection = PORT_PIN_OUT
            PortPinDirectionChangeable = 0
            PortPinId = 65
            PortPinInitialMode = PORT_PIN_MODE_DIO
            PortPinLevelValue = PORT_PIN_LEVEL_LOW
            PortPinMode = PORT_PIN_MODE_DIO
            PortPinModeChangeable = 0
            ArcPortPinPull = PORT_PIN_PULL_NONE
            ArcPortPinSlewRate = PORT_PIN_SLEW_RATE_MAX
            ArcPortPinOpenDrainEnable = 0
        ANALOG
          5 x PortPin, all with PortPinDirection=PORT_PIN_IN, PortPinDirectionChangeable=0, PortPinInitialMode=PORT_PIN_MODE_ADC, PortPinLevelValue=PORT_PIN_LEVEL_LOW, PortPinModeChangeable=0, ArcPortPinPull=PORT_PIN_PULL_NONE, ArcPortPinSlewRate=PORT_PIN_SLEW_RATE_MAX, ArcPortPinOpenDrainEnable=0:
            SARADC_0_AN6: PortPinId=20, PortPinMode=PORT_PIN_MODE_OTHER0
            SARADC_0_AN4: PortPinId=59, PortPinMode=PORT_PIN_MODE_OTHER0
            SARADC_0_AN5: PortPinId=77, PortPinMode=PORT_PIN_MODE_OTHER0
            SARADC_0_AN7: PortPinId=78, PortPinMode=PORT_PIN_MODE_OTHER0
            SARADC_B_AN_0: PortPinId=16, PortPinMode=PORT_PIN_MODE_ADC
    PortGeneral: PortDevErrorDetect=1, PortSetPinDirectionApi=1, PortSetPinModeApi=1, PortVersionInfoApi=0
  module config Dio: implementation-config-variant=VARIANT-PRE-COMPILE, module-description=Dio
    DioConfig
      PE (DioPort): DioPortId=4
        LED1 (DioChannel): DioChannelId=64
        LED2 (DioChannel): DioChannelId=65
      PH (DioPort): DioPortId=7
        SpiCs (DioChannel): DioChannelId=115
    DioGeneral: DioDevErrorDetect=1, DioFlipChannelApi=(unset), DioVersionInfoApi=0
  module config Spi: implementation-config-variant=VARIANT-PRE-COMPILE, module-description=Spi
    SpiDriver
      CH_ADDR (SpiChannel): SpiChannelId=(unset), SpiChannelType=EB, SpiDataWidth=16, SpiEbMaxLength=64, SpiIbNBuffers=(unset), SpiTransferStart=MSB, SpiDefaultData=0
      device_1 (SpiExternalDevice):
        SpiBaudrate = 4000000
        SpiCsIdentifier = 1
        SpiCsPolarity = LOW
        SpiDataShiftEdge = LEADING
        SpiEnableCs = (unset)
        SpiHwUnit = CSIB1
        SpiShiftClockIdleLevel = LOW
        SpiTimeClk2Cs = 0.000002
        ArcCsCallback = 
        ArcTimeCs2Clk = 0.000001
      JOB_CMD (SpiJob): SpiJobId=(unset), SpiJobPriority=0, SpiDeviceAssignment=device_1
        cmd (SpiChannelList): SpiChannelIndex=0, SpiChannelAssignment=CH_CMD
      SEQ_CMD (SpiSequence): SpiInterruptibleSequence=(unset), SpiSequenceId=(unset), SpiJobAssignment=JOB_CMD
      3 x SpiChannel, all with SpiChannelId=(unset), SpiChannelType=EB, SpiDataWidth=8, SpiIbNBuffers=(unset), SpiTransferStart=MSB:
        CH_CMD: SpiEbMaxLength=64
        CH_DATA: SpiEbMaxLength=64
        CH_WREN: SpiEbMaxLength=1, SpiDefaultData=6
      3 x SpiJob, all with SpiJobId=(unset), SpiDeviceAssignment=device_1:
        JOB_CMD2: SpiJobPriority=0
          cmd (SpiChannelList): SpiChannelIndex=0, SpiChannelAssignment=CH_CMD
          data (SpiChannelList): SpiChannelIndex=1, SpiChannelAssignment=CH_DATA
        JOB_DATA: SpiJobPriority=2
          3 x SpiChannelList:
            addr: SpiChannelIndex=1, SpiChannelAssignment=CH_ADDR
            cmd: SpiChannelIndex=0, SpiChannelAssignment=CH_CMD
            data: SpiChannelIndex=2, SpiChannelAssignment=CH_DATA
        JOB_WREN: SpiJobPriority=3
          wren (SpiChannelList): SpiChannelIndex=0, SpiChannelAssignment=CH_WREN
      3 x SpiSequence, all with SpiSequenceId=(unset):
        SEQ_CMD2: SpiInterruptibleSequence=(unset), SpiJobAssignment=JOB_CMD2
        SEQ_READ: SpiInterruptibleSequence=0, SpiJobAssignment=JOB_DATA
        SEQ_WRITE: SpiInterruptibleSequence=0, SpiJobAssignment=JOB_WREN, SpiJobAssignment=JOB_DATA
      CH_WATCHDOG (SpiChannel): SpiChannelId=(unset), SpiChannelType=IB, SpiDataWidth=16, SpiEbMaxLength=(unset), SpiIbNBuffers=1, SpiTransferStart=MSB, SpiDefaultData=0x5A00
    SpiGeneral:
      SpiCancelApi = 1
      SpiChannelBuffersAllowed = (unset)
      SpiDevErrorDetect = 1
      SpiHwStatusApi = 1
      SpiInterruptibleSeqAllowed = (unset)
      SpiLevelDelivered = (unset)
      SpiSupportConcurrentSyncTransmit = (unset)
      SpiVersionInfoApi = 1
      ArcImplementation = FIFO
    SpiPublishedInformation: SpiMaxHwUnit=(unset)
  module config Adc: implementation-config-variant=VARIANT-PRE-COMPILE, module-description=Adc
    AdcConfigSet
      AdcHwUnit: AdcHwUnitId=ADC_CTRL_B, ArcAdcPrescaleDivideFactor=2, AdcPrescale=1
        ADC0_AN11 (AdcChannel): ArcAdcChannelId=ADC_CH11, AdcChannelId=11
        AdcGroup1 (AdcGroup):
          AdcGroupAccessMode = ADC_ACCESS_MODE_STREAMING
          AdcGroupConversionMode = ADC_CONV_MODE_CONTINUOUS
          AdcGroupId = (unset)
          AdcGroupTriggSrc = ADC_TRIGG_SRC_SW
          AdcStreamingBufferMode = ADC_STREAM_BUFFER_LINEAR
          AdcStreamingNumSamples = 1
          ArcAdcChannelConvTimeCmpTime = ADC_INPCPM_1
          ArcAdcChannelConvTimeLatchTime = ADC_INPLATCH_0
          ArcAdcChannelConvTimeSampTime = 2
          AdcNotification = IoHwAb_AdcConversionComplete
          AdcGroupDefinition = ADC0_AN11
          AdcGroupDefinition = AdcChannel1
          AdcGroupDefinition = ADC0_AN10
          AdcGroupDefinition = ADC0_AN15
        3 x AdcChannel:
          AdcChannel1: ArcAdcChannelId=ADC_CH0, AdcChannelId=0
          ADC0_AN10: ArcAdcChannelId=ADC_CH10, AdcChannelId=10
          ADC0_AN15: ArcAdcChannelId=ADC_CH15, AdcChannelId=15
      ADC1 (AdcHwUnit): AdcHwUnitId=ADC_CTRL_1, AdcPrescale=1, ArcAdcPrescaleDivideFactor=2
        ADC1_AN11 (AdcChannel): ArcAdcChannelId=ADC_CH11, AdcChannelId=11
        AdcGroup2 (AdcGroup):
          AdcGroupAccessMode = ADC_ACCESS_MODE_STREAMING
          AdcGroupConversionMode = ADC_CONV_MODE_CONTINUOUS
          AdcGroupId = (unset)
          AdcGroupTriggSrc = ADC_TRIGG_SRC_SW
          AdcStreamingBufferMode = ADC_STREAM_BUFFER_LINEAR
          AdcStreamingNumSamples = 1
          ArcAdcChannelConvTimeSampTime = 2
          ArcAdcChannelConvTimeLatchTime = ADC_INPLATCH_0
          ArcAdcChannelConvTimeCmpTime = ADC_INPCPM_1
          AdcGroupDefinition = ADC1_AN11
    AdcGeneral:
      AdcDeInitApi = 1
      AdcDevErrorDetect = 1
      AdcEnableLimitCheck = (unset)
      AdcEnableQueuing = (unset)
      AdcEnableStartStopGroupApi = 1
      AdcGrpNotifCapability = 1
      AdcHwTriggerApi = 0
      AdcPriorityImplementation = ADC_PRIORITY_NONE
      AdcReadGroupApi = 1
      AdcResultAlignment = 
      AdcVersionInfoApi = 0
    AdcPublishedInformation: AdcChannelValueSigned=(unset), AdcGroupFirstChannelFixed=(unset), AdcMaxChannelResolution=(unset)
  module config Can: implementation-config-variant=VARIANT-PRE-COMPILE, module-description=Can
    CanConfigSet
      CanController0 (CanController):
        CanBusoffProcessing = INTERRUPT
        CanControllerActivation = 1
        CanControllerBaseAddress = (unset)
        CanControllerId = 
        CanRxProcessing = INTERRUPT
        CanTxProcessing = INTERRUPT
        CanWakeupFunctionalityAPI = false
        CanWakeupProcessing = INTERRUPT
        CanWakeupSupport = 0
        ArcCanControllerLoopback = 0
        ArcCanNumMessageBox = 64
        ArcCanControllerHwUnit = M_CAN_1
        ArcCanClockSourceOscillator = 1
        CanControllerDefaultBaudrate = CanControllerBaudrateConfig
        CanCpuClockRef = (unset)
        CanControllerBaudrateConfig:
          CanControllerBaudRate = 500
          CanControllerBaudRateConfigID = 0
          CanControllerPropSeg = 7
          CanControllerSeg1 = 6
          CanControllerSeg2 = 2
          CanControllerSyncJumpWidth = 1
      Ctrl_0_Rx_0 (CanHardwareObject):
        CanHandleType = BASIC
        CanIdType = STANDARD
        CanObjectId = (unset)
        CanObjectType = RECEIVE
        ArcCanFifoEnable = 0
        ArcCanMessageboxesPerHwObj = (unset)
        CanHwObjectCount = 1
        CanControllerRef = CanController0
        CanHwFilter: CanHwFilterCode=2, CanHwFilterMask=0
      Ctrl_0_Tx_0 (CanHardwareObject):
        CanHandleType = BASIC
        CanIdType = STANDARD
        CanObjectId = (unset)
        CanObjectType = TRANSMIT
        ArcCanFifoEnable = 0
        ArcCanMessageboxesPerHwObj = (unset)
        CanHwObjectCount = 1
        CanControllerRef = CanController0
    CanGeneral:
      CanDevErrorDetection = 1
      CanHardwareCancellation = 0
      CanIdenticalIdCancellation = 0
      CanIndex = (unset)
      CanMainFunctionModePeriod = (unset)
      CanMultiplexedTransmission = 0
      CanTimeoutDuration = (unset)
      CanVersionInfoApi = 0
      CanCounterRef = (unset)
      CanSupportTTCANRef = (unset)
      CanMainFunctionRWPeriods
  module config EcuM: implementation-config-variant=VARIANT-PRE-COMPILE, module-description=EcuM
    EcuMConfiguration
      EcuMCommonConfiguration: EcuMConfigConsistencyHash=(unset), EcuMDefaultAppMode=(unset), EcuMOSResource=(unset)
        EcuMDefaultShutdownTarget: EcuMDefaultState=EcuMStateOff
        EcuMSleepMode: EcuMSleepModeId=(unset), EcuMSleepModeSuspend=(unset), EcuMSleepModeMcuModeRef=SLEEP, EcuMWakeupSourceMask=EcuMWakeupSource
        EcuMWakeupSource: EcuMWakeupSourceId=(unset), EcuMWakeupSourcePolling=0, EcuMResetReasonRef=(unset)
      EcuMFixedConfiguration: EcuMNvramReadallTimeout=10.0, EcuMNvramWriteallTimeout=10.0, EcuMRunMinimumDuration=10.0, EcuMNormalMcuModeRef=NORMAL
        User_1 (EcuMFixedUserConfig): EcuMFixedUser=(unset)
    EcuMGeneral: EcuMDevErrorDetect=0, EcuMIncludeDem=0, EcuMIncludeDet=0, EcuMMainFunctionPeriod=0.2, EcuMVersionInfoApi=0
  module config Mcu: implementation-config-variant=VARIANT-PRE-COMPILE, module-description=Mcu
    McuGeneralConfiguration: McuDevErrorDetect=true, McuGetRamStateApi=false, McuInitClock=true, McuNoPll=false, McuPerformResetApi=false, McuVersionInfoApi=false
    McuModuleConfiguration: McuClockSrcFailureNotification=DISABLED, McuNumberOfMcuModes=, McuRamSectors=, ArcDefaultClockRef=XOSC40Mhz
      XOSC40Mhz (McuClockSettingConfig): McuClockSettingId=
        McuClockReferencePoint: Frequency=, McuClockReferencePointFrequency=40000000.0
        ArcPLLSettings: PLL0_PREDIV=5, PLL0_MFD=60, PLL0_RFDPHI=3, PLL1_MFD=30, PLL1_RFDPHI=3, PLL1FM_MODPRD=0, PLL1FM_INCSTP=0, PLL1FM_MODEN=false
      3 x McuModeSettingConf, all with McuMode=:
        RUN
        NORMAL
        SLEEP
    McuPublishedInformation
      McuResetReasonConf: McuResetReason=
