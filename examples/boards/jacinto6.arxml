AUTOSAR XML (schema 4-2-2)
package /ArcCore/Boards/jacinto6
  ecuc value collection MyEcu: ecu-extract=Jac5, ecuc-values=[Dio, Mcu, Port, Pwm, Can]
  module config Dio: implementation-config-variant=VARIANT-PRE-COMPILE, module-description=Dio
    DioConfig
      PC (DioPort): DioPortId=0
        3 x DioChannel:
          DioChannel_gp8_7: DioChannelId=231
          DioChannel_gp8_9: DioChannelId=233
          DioChannel_gp8_8: DioChannelId=232
      PE (DioPort): DioPortId=
        LED2 (DioChannel): DioChannelId=34
        LED1 (DioChannel): DioChannelId=39
    DioGeneral: DioDevErrorDetect=1, DioFlipChannelApi=(unset), DioVersionInfoApi=0
  module config Mcu: implementation-config-variant=VARIANT-PRE-COMPILE, module-description=Mcu
    McuGeneralConfiguration: McuDevErrorDetect=1, McuGetRamStateApi=(unset), McuInitClock=(unset), McuNoPll=(unset), McuPerformResetApi=1, McuVersionInfoApi=1
    McuModuleConfiguration: McuClockSrcFailureNotification=, McuNumberOfMcuModes=(unset), McuRamSectors=(unset), ArcDefaultClockRef=McuClockSettingConfig
      McuClockSettingConfig: McuClockSettingId=(unset)
        McuClockReferencePoint: McuClockReferencePointFrequency=212800000
        ArcClockSettings:
          Enable_Timer_1 = false
          Enable_Timer_2 = false
          Enable_Timer_3 = true
          Enable_Timer_{4..16} = false
          Enable_CAN0 = true
          Enable_CAN1 = true
      3 x McuModeSettingConf, all with McuMode=(unset):
        NORMAL
        RUN
        SLEEP
    McuPublishedInformation
      McuResetReasonConf: McuResetReason=(unset)
  module config Port: implementation-config-variant=VARIANT-PRE-COMPILE, module-description=Port
    PortConfigSet
      3 x PortContainer:
        CAN: PortNumberOfPortPins=(unset)
          4 x PortPin, all with PortPinDirectionChangeable=, PortPinInitialMode=PORT_PIN_MODE_CAN, PortPinLevelValue=PORT_PIN_LEVEL_LOW, PortPinMode=, PortPinModeChangeable=, ArcPortPinPull=PORT_PIN_PULL_NONE, ArcPortPinSlewRate=PORT_PIN_SLEW_FAST:
            dcan1_rx_h_ad17: PortPinDirection=PORT_PIN_IN, PortPinId=660
            dcan1_tx_g20: PortPinDirection=PORT_PIN_OUT, PortPinId=187
            dcan2_rx_f20: PortPinDirection=PORT_PIN_IN, PortPinId=159
            dcan2_tx_e21: PortPinDirection=PORT_PIN_OUT, PortPinId=132
        PWM: PortNumberOfPortPins=
          PortPin_pwm6_a11 (PortPin):
            PortPinDirection = PORT_PIN_OUT
            PortPinDirectionChangeable = 
            PortPinId = 10
            PortPinInitialMode = PORT_PIN_MODE_PWM
            PortPinLevelValue = PORT_PIN_LEVEL_HIGH
            PortPinMode = 
            PortPinModeChangeable = 
            ArcPortPinPull = PORT_PIN_PULL_NONE
            ArcPortPinSlewRate = PORT_PIN_SLEW_FAST
        GPIOs: PortNumberOfPortPins=
          3 x PortPin, all with PortPinDirectionChangeable=, PortPinInitialMode=PORT_PIN_MODE_DIO, PortPinLevelValue=PORT_PIN_LEVEL_LOW, PortPinMode=, PortPinModeChangeable=, ArcPortPinPull=PORT_PIN_PULL_NONE, ArcPortPinSlewRate=PORT_PIN_SLEW_FAST:
            PortPin_d9: PortPinDirection=PORT_PIN_OUT, PortPinId=92
            PortPin_e7: PortPinDirection=PORT_PIN_OUT, PortPinId=118
            PortPin_e8: PortPinDirection=PORT_PIN_IN, PortPinId=119
    PortGeneral: PortDevErrorDetect=1, PortSetPinDirectionApi=0, PortSetPinModeApi=0, PortVersionInfoApi=0, ArcPortGpioReset=true
  module config Pwm: implementation-config-variant=VARIANT-PRE-COMPILE, module-description=Pwm
    PwmChannelConfigSet
      Channel_LED_3 (PwmChannel):
        PwmChannelId = 5
        PwmDutycycleDefault = 8192
        PwmIdleState = PWM_HIGH
        PwmPeriodDefault = 0.1
        PwmPolarity = PWM_HIGH
        PwmChannelClass = PWM_VARIABLE_PERIOD
        ArcPwmChannelPrescaler = 
    PwmConfigurationOfOptApiServices: PwmDeInitApi=1, PwmGetOutputState=0, PwmSetDutyCycle=1, PwmSetOutputToIdle=1, PwmSetPeriodAndDuty=1, PwmVersionInfoApi=1
    PwmGeneral: PwmDevErrorDetect=1, PwmDutycycleUpdatedEndperiod=, PwmIndex=, PwmNotificationSupported=0, PwmPeriodUpdatedEndperiod=
  module config Can: implementation-config-variant=VARIANT-PRE-COMPILE, module-description=Can
    CanConfigSet
      CanController0 (CanController):
        CanBusoffProcessing = 
        CanControllerActivation = true
        CanControllerBaseAddress = 
        CanControllerId = 0
        CanRxProcessing = 
        CanTxProcessing = 
        CanWakeupFunctionalityAPI = false
        CanWakeupProcessing = 
        CanWakeupSupport = 
        CanControllerDefaultBaudrate = Ctrl_0_Baudrate_500
        CanCpuClockRef = (unset)
        Ctrl_0_Baudrate_500 (CanControllerBaudrateConfig):
          CanControllerBaudRate = 500
          CanControllerBaudRateConfigID = 0
          CanControllerPropSeg = 5
          CanControllerSeg1 = 1
          CanControllerSeg2 = 1
          CanControllerSyncJumpWidth = 
      Ctrl_0_Rx_0 (CanHardwareObject): CanHandleType=BASIC, CanIdType=STANDARD, CanObjectId=, CanObjectType=RECEIVE, ArcCanFifoEnable=false, CanControllerRef=CanController0
        CanHwFilter: CanHwFilterCode=0, CanHwFilterMask=0
      CanController1 (CanController):
        CanBusoffProcessing = 
        CanControllerActivation = true
        CanControllerBaseAddress = 
        CanControllerId = 1
        CanRxProcessing = 
        CanTxProcessing = 
        CanWakeupFunctionalityAPI = false
        CanWakeupProcessing = 
        CanWakeupSupport = 
        CanControllerDefaultBaudrate = Ctrl_1_Baudrate_500
        CanCpuClockRef = (unset)
        Ctrl_1_Baudrate_500 (CanControllerBaudrateConfig):
          CanControllerBaudRate = 500
          CanControllerBaudRateConfigID = 0
          CanControllerPropSeg = 5
          CanControllerSeg1 = 1
          CanControllerSeg2 = 1
          CanControllerSyncJumpWidth = 
      3 x CanHardwareObject, all with CanHandleType=BASIC, CanIdType=STANDARD, CanObjectId=, ArcCanFifoEnable=false:
        Ctrl_0_Rx_1: CanObjectType=RECEIVE, CanControllerRef=CanController1
          CanHwFilter: CanHwFilterCode=0, CanHwFilterMask=0
        Ctrl_0_Tx_0: CanObjectType=TRANSMIT, CanControllerRef=CanController0
        Ctrl_0_Tx_1: CanObjectType=TRANSMIT, CanControllerRef=CanController1
    CanGeneral:
      CanDevErrorDetection = true
      CanHardwareCancellation = 
      CanIdenticalIdCancellation = 
      ArcCanTimeoutDuration = 0xFFFFFFFF
      CanIndex = 
      CanMainFunctionModePeriod = 
      CanMultiplexedTransmission = 
      CanTimeoutDuration = 
      CanVersionInfoApi = true
      CanCounterRef = (unset)
      CanSupportTTCANRef = (unset)
      CanMainFunctionRWPeriods
