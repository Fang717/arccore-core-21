AUTOSAR XML (schema 4-2-1)
package /ArcCore/Boards/rh850f1h
  ecuc value collection rh850f1h: ecuc-values=[Fr, Can, Mcu, EcuM]
  module config Fr: implementation-config-variant=VARIANT-PRE-COMPILE, module-description=Fr
    FrGeneral:
      FrBufferReconfig = (unset)
      FrCtrlTestCount = 1
      FrDevErrorDetect = (unset)
      FrIndex = (unset)
      FrNumCtrlSupported = (unset)
      FrRxStringentCheck = false
      FrRxStringentLengthCheck = false
      FrVersionInfoApi = (unset)
    FrMultipleConfiguration
      FrController:
        FrCtrlIdx = (unset)
        FrPAllowHaltDueToClock = (unset)
        FrPAllowPassiveToActive = (unset)
        FrPChannels = 
        FrPClusterDriftDamping = (unset)
        FrPDecodingCorrection = (unset)
        FrPDelayCompensationA = (unset)
        FrPDelayCompensationB = (unset)
        FrPExternalSync = (unset)
        FrPFallBackInternal = (unset)
        FrPKeySlotId = (unset)
        FrPKeySlotOnlyEnabled = (unset)
        FrPKeySlotUsedForStartup = (unset)
        FrPKeySlotUsedForSync = (unset)
        FrPLatestTx = (unset)
        FrPMacroInitialOffsetA = (unset)
        FrPMacroInitialOffsetB = (unset)
        FrPMicroInitialOffsetA = (unset)
        FrPMicroInitialOffsetB = (unset)
        FrPMicroPerCycle = (unset)
        FrPNmVectorEarlyUpdate = (unset)
        FrPOffsetCorrectionOut = (unset)
        FrPOffsetCorrectionStart = (unset)
        FrPPayloadLengthDynMax = (unset)
        FrPRateCorrectionOut = (unset)
        FrPSamplesPerMicrotick = 
        FrPSecondKeySlotId = (unset)
        FrPTwoKeySlotMode = (unset)
        FrPWakeupChannel = 
        FrPWakeupPattern = (unset)
        FrPdAcceptedStartupRange = (unset)
        FrPdListenTimeout = (unset)
        FrPdMicrotick = 
        FrAbsoluteTimer: FrAbsTimerIdx=(unset)
  module config Can: implementation-config-variant=VARIANT-PRE-COMPILE, module-description=Can
    CanConfigSet
      CanController:
        CanBusoffProcessing = INTERRUPT
        CanControllerActivation = 1
        CanControllerBaseAddress = (unset)
        CanControllerId = 
        CanRxProcessing = INTERRUPT
        CanTxProcessing = INTERRUPT
        CanWakeupFunctionalityAPI = false
        CanWakeupProcessing = INTERRUPT
        CanWakeupSupport = 0
        ArcCanControllerLoopback = 0
        ArcCanControllerHwUnit = RSCAN_CH0
        ArcCanRxFifoDepth = RXFIFO_SZ_8
        CanControllerDefaultBaudrate = CanControllerBaudrateConfig
        CanCpuClockRef = (unset)
        CanControllerBaudrateConfig:
          CanControllerBaudRate = 500
          CanControllerBaudRateConfigID = 0
          CanControllerPropSeg = 7
          CanControllerSeg1 = 4
          CanControllerSeg2 = 4
          CanControllerSyncJumpWidth = 2
      RX_HRH_1 (CanHardwareObject): CanHandleType=BASIC, CanIdType=STANDARD, CanObjectId=(unset), CanObjectType=RECEIVE, CanControllerRef=CanController
        CanHwFilter: CanHwFilterCode=0, CanHwFilterMask=0
      TX_HRH_1 (CanHardwareObject): CanHandleType=BASIC, CanIdType=STANDARD, CanObjectId=(unset), CanObjectType=TRANSMIT, CanControllerRef=CanController
    CanGeneral:
      CanDevErrorDetection = 1
      CanHardwareCancellation = 0
      CanIdenticalIdCancellation = 0
      CanIndex = (unset)
      CanMainFunctionModePeriod = (unset)
      CanMultiplexedTransmission = 0
      CanTimeoutDuration = (unset)
      CanVersionInfoApi = 0
      CanCounterRef = (unset)
      CanSupportTTCANRef = (unset)
      CanMainFunctionRWPeriods
  module config Mcu: implementation-config-variant=VARIANT-PRE-COMPILE, module-description=Mcu
    McuGeneralConfiguration: McuDevErrorDetect=1, McuGetRamStateApi=0, McuInitClock=1, McuNoPll=0, McuPerformResetApi=1, McuVersionInfoApi=1
    McuModuleConfiguration: McuClockSrcFailureNotification=DISABLED, McuNumberOfMcuModes=(unset), McuRamSectors=(unset), ArcDefaultClockRef=Cpu120MHzCrystal16MHz
      Cpu120MHzCrystal16MHz (McuClockSettingConfig): McuClockSettingId=(unset)
        Crystal16Mhz (McuClockReferencePoint): McuClockReferencePointFrequency=16000000.0
        ArcPLLSettings: PLL1N=39, PLL0ADJ=1, PLL0MD=0, PLL0N=29, PLL0P=2, PLL0MF=0, PLL1P=2, PLL0M=0, PLL1M=1
      NORMAL (McuModeSettingConf): McuMode=(unset)
      SLEEP (McuModeSettingConf): McuMode=(unset)
      Cpu120MHzCrystal8MHz (McuClockSettingConfig): McuClockSettingId=(unset)
        Crystal8Mhz (McuClockReferencePoint): McuClockReferencePointFrequency=8000000.0
        ArcPLLSettings: PLL1N=39, PLL0ADJ=1, PLL0MD=0, PLL0N=59, PLL0P=2, PLL0MF=0, PLL1P=2, PLL0M=0, PLL1M=0
      RUN (McuModeSettingConf): McuMode=(unset)
    McuPublishedInformation
      McuResetReasonConf: McuResetReason=(unset)
  module config EcuM: implementation-config-variant=VARIANT-PRE-COMPILE, module-description=EcuM
    EcuMConfiguration
      EcuMCommonConfiguration: EcuMConfigConsistencyHash=(unset), EcuMDefaultAppMode=(unset), EcuMOSResource=(unset)
        EcuMDefaultShutdownTarget: EcuMDefaultState=EcuMStateOff
        EcuMSleepMode: EcuMSleepModeId=(unset), EcuMSleepModeSuspend=(unset), EcuMSleepModeMcuModeRef=RUN, EcuMWakeupSourceMask=EcuMWakeupSource
        EcuMWakeupSource: EcuMWakeupSourceId=(unset), EcuMWakeupSourcePolling=(unset), EcuMResetReasonRef=(unset)
      EcuMFixedConfiguration: EcuMNvramReadallTimeout=0.01, EcuMNvramWriteallTimeout=0.01, EcuMRunMinimumDuration=(unset), EcuMNormalMcuModeRef=RUN
        User_1 (EcuMFixedUserConfig): EcuMFixedUser=(unset)
    EcuMGeneral: EcuMDevErrorDetect=1, EcuMIncludeDem=(unset), EcuMIncludeDet=(unset), EcuMMainFunctionPeriod=0.01, EcuMVersionInfoApi=1
