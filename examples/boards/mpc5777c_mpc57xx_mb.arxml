AUTOSAR XML (schema 4-2-2)
package /ArcCore/Boards/mpc5777c_mpc57xx_mb
  ecuc value collection MyEcu: ecuc-values=[Port, EcuM, Mcu]
  module config Port: implementation-config-variant=VARIANT-PRE-COMPILE, module-description=Port
    PortConfigSet
      PortContainer: PortNumberOfPortPins=
        PortPin:
          PortPinDirection = 
          PortPinDirectionChangeable = 
          PortPinId = 
          PortPinInitialMode = 
          PortPinLevelValue = 
          PortPinMode = 
          PortPinModeChangeable = 
          ArcPortPinPull = 
          ArcPortPinSlewRate = 
          ArcPortPinOpenDrainEnable = false
    PortGeneral: PortDevErrorDetect=true, PortSetPinDirectionApi=false, PortSetPinModeApi=false, PortVersionInfoApi=false
  module config EcuM: implementation-config-variant=VARIANT-PRE-COMPILE, module-description=EcuM
    EcuMConfiguration
      EcuMCommonConfiguration: EcuMConfigConsistencyHash=, EcuMDefaultAppMode=(unset), EcuMOSResource=(unset)
        EcuMDefaultShutdownTarget: EcuMDefaultState=EcuMStateOff
        EcuMSleepMode: EcuMSleepModeId=, EcuMSleepModeSuspend=, EcuMSleepModeMcuModeRef=(unset), EcuMWakeupSourceMask=(unset)
        EcuMWakeupSource: EcuMWakeupSourceId=, EcuMWakeupSourcePolling=false, EcuMResetReasonRef=(unset)
      EcuMFixedConfiguration: EcuMNvramReadallTimeout=10.0, EcuMNvramWriteallTimeout=10.0, EcuMRunMinimumDuration=10.0, EcuMNormalMcuModeRef=(unset)
        EcuMFixedUserConfig: EcuMFixedUser=
    EcuMGeneral: EcuMDevErrorDetect=false, EcuMIncludeDem=false, EcuMIncludeDet=false, EcuMMainFunctionPeriod=0.2, EcuMVersionInfoApi=false
  module config Mcu: implementation-config-variant=VARIANT-PRE-COMPILE, module-description=Mcu
    McuGeneralConfiguration: McuDevErrorDetect=true, McuGetRamStateApi=false, McuInitClock=true, McuNoPll=false, McuPerformResetApi=false, McuVersionInfoApi=false
    McuModuleConfiguration: McuClockSrcFailureNotification=DISABLED, McuNumberOfMcuModes=, McuRamSectors=, ArcDefaultClockRef=McuClockSettingConfig
      McuClockSettingConfig: McuClockSettingId=
        McuClockReferencePoint: Frequency=, McuClockReferencePointFrequency=40e6
        ArcPLLSettings: PLL0_PREDIV=5, PLL0_MFD=60, PLL0_RFDPHI=3, PLL1_MFD=30, PLL1_RFDPHI=3, PLL1FM_MODPRD=0, PLL1FM_INCSTP=0, PLL1FM_MODEN=false
      3 x McuModeSettingConf, all with McuMode=:
        RUN
        NORMAL
        SLEEP
    McuPublishedInformation
      McuResetReasonConf: McuResetReason=
