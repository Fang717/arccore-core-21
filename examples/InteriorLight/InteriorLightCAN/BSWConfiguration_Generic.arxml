AUTOSAR XML (schema 4-3-0)
package /BSWConfiguration
  module config BswM: implementation-config-variant=VARIANT-PRE-COMPILE, module-description=BswM
    BswMConfig
      BswMArbitration: ArcBswMMaxRuleCount=20
        3 x BswMLogicalExpression:
          ComMFullCommuncationlExpression: BswMArgumentRef=ComMFullCommunicationCondition
          StartCommunicationExpression: BswMArgumentRef=StartCommunicationCondition
          ComMNoCommuncationlExpression: BswMArgumentRef=ComMNoCommunicationCondition
        3 x BswMModeCondition:
          ComMFullCommunicationCondition: BswMConditionType=BSWM_EQUALS, BswMConditionMode=BswComMIndication
            BswMConditionValue
              BswMBswMode: BswMBswRequestedMode=COMM_FULL_COMMUNICATION
          ComMNoCommunicationCondition: BswMConditionType=BSWM_EQUALS, BswMConditionMode=BswComMIndication
            BswMConditionValue
              BswMBswMode: BswMBswRequestedMode=COMM_NO_COMMUNICATION
          StartCommunicationCondition: BswMConditionType=BSWM_EQUALS_NOT, BswMConditionMode=SwcStartCommunication
            BswMConditionValue
              BswMBswMode: BswMBswRequestedMode=COMM_NO_COMMUNICATION
        3 x BswMRule, all with BswMNestedExecutionOnly=false, BswMRuleInitState=BSWM_FALSE:
          DisablePduGroupsRule: BswMRuleExpressionRef=ComMNoCommuncationlExpression, BswMRuleTrueActionList=DisablePdusActions
          EnablePduGroupsRule: BswMRuleExpressionRef=ComMFullCommuncationlExpression, BswMRuleTrueActionList=EnablePdusActions
          StartCommunicationRule: BswMRuleExpressionRef=StartCommunicationExpression, BswMRuleTrueActionList=StartCommuncationActions
        SwcStartCommunication (BswMModeRequestPort): BswMRequestProcessing=BSWM_DEFERRED
          BswMModeRequestSource
            BswMSwcModeRequest: BswMSwcModeRequestModeDeclarationGroupPrototypeRef=currentMode
        BswComMIndication (BswMModeRequestPort): BswMRequestProcessing=BSWM_DEFERRED
          BswMModeRequestSource
            BswMComMIndication: BswMComMChannelRef=ComMChannel
      BswMModeControl
        3 x BswMAction:
          IPduAllDisabled
            BswMAvailableActions
              BswMPduGroupSwitch: BswMPduGroupSwitchReinit=true, BswMDisabledPduGroupRef=ComIPduGroupRx, BswMDisabledPduGroupRef=ComIPduGroupTx
          RequestFullCom
            BswMAvailableActions
              BswMComMModeSwitch: BswMComMRequestedMode=BSWM_FULL_COM, BswMComMUserRef=ComMUser
          IPduAllEnabled
            BswMAvailableActions
              BswMPduGroupSwitch: BswMPduGroupSwitchReinit=true, BswMEnabledPduGroupRef=ComIPduGroupRx, BswMEnabledPduGroupRef=ComIPduGroupTx
        3 x BswMActionList, all with BswMActionListExecution=BSWM_TRIGGER:
          DisablePdusActions
            BswMActionListItem: BswMAbortOnFail=false, BswMActionListItemIndex=0, BswMActionListItemRef=IPduAllDisabled
          StartCommuncationActions
            BswMActionListItem: BswMAbortOnFail=false, BswMActionListItemIndex=0, BswMActionListItemRef=RequestFullCom
          EnablePdusActions
            BswMActionListItem: BswMAbortOnFail=false, BswMActionListItemIndex=0, BswMActionListItemRef=IPduAllEnabled
    BswMGeneral: BswMDevErrorDetect=false, BswMVersionInfoApi=true, BswMSdEnabled=false, BswMComMEnabled=1, BswMEcuMEnabled=1, BswMCanSMEnabled=1
  module config Com: implementation-config-variant=VARIANT-PRE-COMPILE, module-description=Com
    ComConfig: ComConfigurationId=
      ComTimeBase: ComRxTimeBase=0.01, ComTxTimeBase=0.01
      DoorStatus (ComSignal):
        ComBitPosition = 0
        ComHandleId = 
        ComSignalEndianness = LITTLE_ENDIAN
        ComSignalType = UINT32
        ComBitSize = 32
        ComTransferProperty = TRIGGERED_ON_CHANGE
        ComSystemTemplateSystemSignalRef = RxMessageMapping
      LightStatus (ComSignal):
        ComBitPosition = 0
        ComHandleId = 
        ComSignalEndianness = LITTLE_ENDIAN
        ComSignalType = UINT32
        ComBitSize = 32
        ComSystemTemplateSystemSignalRef = TxMessageMapping
      DoorStatusPdu (ComIPdu):
        ComIPduDirection = RECEIVE
        ComIPduSignalProcessing = DEFERRED
        ComIPduTriggerTransmitCallout = NULL
        ComIPduType = 
        ComPduIdRef = PduRx
        ComIPduGroupRef = ComIPduGroupRx
        ComIPduSignalRef = DoorStatus
      LightStatusPdu (ComIPdu):
        ComIPduDirection = SEND
        ComIPduSignalProcessing = DEFERRED
        ComIPduTriggerTransmitCallout = NULL
        ComIPduType = 
        ComPduIdRef = PduTx
        ComIPduGroupRef = ComIPduGroupTx
        ComIPduSignalRef = LightStatus
        ComTxIPdu: ComTxIPduUnusedAreasDefault=0
          ComTxModeTrue
            ComTxMode: ComTxModeMode=PERIODIC, ComTxModeTimePeriod=0.1
      ComIPduGroupRx (ComIPduGroup): ComIPduGroupHandleId=
      ComIPduGroupTx (ComIPduGroup): ComIPduGroupHandleId=
    ComGeneral:
      ComSupportedIPduGroups = 2
      ComVersionInfoApi = false
      ComSupportedIPdus = 10
      ComSupportedSignals = 20
      ComSupportedGroupSignals = 0
      ComRamBufferSize = 1024
      ArcMaxNumberOfSupportedIPduCounters = 0
      ArcComSupportedGatewaySourceDescriptions = 0
      ComConfigurationUseDet = 1
      ArcComOsekNmSupport = false
  module config ComM: implementation-config-variant=VARIANT-PRE-COMPILE, module-description=ComM
    ComMConfigSet
      ComMChannel:
        ComMBusType = COMM_BUS_TYPE_CAN
        ComMChannelId = 
        ComMFullCommRequestNotificationEnabled = false
        ComMGlobalNvmBlockDescriptor = false
        ComMMainFunctionPeriod = 0.01
        ComMNoCom = false
        ComMNoWakeup = false
        ComMNetworkManagement: ComMNmVariant=NONE, ComMPncNmRequest=false
        ComMUserPerChannel: ComMUserChannel=ComMUser
      ComMUser: ComMUserIdentifier=
    ComMGeneral:
      ComMNoCom = false
      ComMEcuGroupClassification = 3
      ComMModeLimitationEnabled = false
      ComMPncSupport = false
      ComMSynchronousWakeUp = true
      ComMTMinFullComModeDuration = 5.0
      ComMVersionInfoApi = true
      ComMWakeupInhibitionEnabled = false
      ComMDevErrorDetect = true
      ArcComMASRCompatibilityLessThan4_2 = true
  module config PduR: implementation-config-variant=VARIANT-POST-BUILD, module-description=PduR
    PduRGeneral: PduRDevErrorDetect=true, PduRVersionInfoApi=false, PduRZeroCostOperation=false
    PduRRoutingTables: PduRConfigurationId=0, ArcPduRMaxRouteCount=50
      PduRRoutingTable: PduRIsMinimumRouting=false
        PduRRoutingPathTx (PduRRoutingPath)
          PduRDestPdu: ArcOverridenDestModule=CanIf, PduRDestPduRef=PduTx
          PduRSrcPdu: PduRSourcePduHandleId=, ArcOverridenSrcModule=Com, PduRSrcPduRef=PduTx
        PduRRoutingPathRx (PduRRoutingPath)
          PduRDestPdu: ArcOverridenDestModule=Com, PduRDestPduRef=PduRx
          PduRSrcPdu: PduRSourcePduHandleId=, ArcOverridenSrcModule=CanIf, PduRSrcPduRef=PduRx
    Com (PduRBswModules):
      PduRCancelReceive = false
      PduRCancelTransmit = 
      PduRChangeParameterRequestApi = 
      PduRCommunicationInterface = 
      PduRLowerModule = 0
      PduRRetransmission = 
      PduRTransportProtocol = 
      PduRTriggertransmit = 
      PduRTxConfirmation = 
      PduRUpperModule = 1
      PduRUseTag = 
      PduRBswModuleRef = (unset)
    CanIf (PduRBswModules):
      PduRCancelReceive = false
      PduRCancelTransmit = 
      PduRChangeParameterRequestApi = 
      PduRCommunicationInterface = 
      PduRLowerModule = 1
      PduRRetransmission = 
      PduRTransportProtocol = 
      PduRTriggertransmit = 
      PduRTxConfirmation = 
      PduRUpperModule = 0
      PduRUseTag = 
      PduRBswModuleRef = (unset)
  module config Rte: implementation-config-variant=VARIANT-PRE-COMPILE, module-description=Rte
    RteBswGeneral: RteSchMVersionInfoApi=, RteUseComShadowSignalApi=false
    RteGeneration:
      RteCalibrationSupport = NONE
      RteCodeVendorId = 
      RteDevErrorDetect = false
      RteDevErrorDetectUninit = false
      RteGenerationMode = COMPATIBILITY_MODE
      RteIocInteractionReturnValue = RTE_IOC
      RteMeasurementSupport = false
      RteOptimizationMode = RUNTIME
      RteValueRangeCheckEnabled = false
      RteVfbTraceEnabled = false
    RteInitializationBehavior: RteInitializationStrategy=, RteSectionInitializationPolicy=
    RteOsInteraction
    RtePostBuildVariantConfiguration: RtePostBuildUsedPredefinedVariant=(unset)
    9 x RteSwComponentInstance:
      bswM: RteSoftwareComponentInstanceRef=bswM
      comM: RteSoftwareComponentInstanceRef=comM
      ecuM: RteSoftwareComponentInstanceRef=ecuM
      frontLightActuator: RteSoftwareComponentInstanceRef=frontLightActuator
        lightActuatorMainEvent_OsRteTask (RteEventToTaskMapping): RteImmediateRestart=false, RtePositionInTask=3, RteEventRef=lightActuatorMainEvent, RteMappedToTaskRef=OsRteTask, RteUsedOsEventRef=OsMainEvent
      ioHwAb: RteSoftwareComponentInstanceRef=ioHwAb
      leftDoorSensor: RteSoftwareComponentInstanceRef=leftDoorSensor
        doorSensorMainEvent_OsRteTask (RteEventToTaskMapping): RteImmediateRestart=false, RtePositionInTask=0, RteEventRef=doorSensorMainEvent, RteMappedToTaskRef=OsRteTask, RteUsedOsEventRef=OsMainEvent
      lightManager: RteSoftwareComponentInstanceRef=lightManager
        interiorLightManagerMainEvent_OsRteTask (RteEventToTaskMapping):
          RteImmediateRestart = false
          RtePositionInTask = 2
          RteEventRef = interiorLightManagerMainEvent
          RteMappedToTaskRef = OsRteTask
          RteUsedOsEventRef = OsMainEvent
      modeManager: RteSoftwareComponentInstanceRef=modeManager
        modeManagerInitEvent_OsRteTask (RteEventToTaskMapping): RteImmediateRestart=false, RteEventRef=modeManagerInitEvent, RteMappedToTaskRef=OsRteTask, RteUsedOsEventRef=OsInitEvent
      rightDoorSensor: RteSoftwareComponentInstanceRef=rightDoorSensor
        doorSensorMainEvent_OsRteTask (RteEventToTaskMapping): RteImmediateRestart=false, RtePositionInTask=1, RteEventRef=doorSensorMainEvent, RteMappedToTaskRef=OsRteTask, RteUsedOsEventRef=OsMainEvent
  module config CanSM: implementation-config-variant=VARIANT-PRE-COMPILE, module-description=CanSM
    CanSMConfiguration: CanSMModeRequestRepetitionMax=254, CanSMModeRequestRepetitionTime=0.2
      CanSMManagerNetwork:
        CanSMBorCounterL1ToL2 = 10
        CanSMBorTimeL1 = 0.1
        CanSMBorTimeL2 = 0.1
        CanSMBorTimeTxEnsured = 0.2
        CanSMBorTxConfirmationPolling = false
        CanSMComMNetworkHandleRef = ComMChannel
        CanSMController: CanSMControllerId=CanIfCtrlCfg
    CanSMGeneral: CanSMDevErrorDetect=true, CanSMMainFunctionTimePeriod=0.01, CanSMVersionInfoApi=false, CanSmChangeBaudrateApi=false
  module config Det: implementation-config-variant=VARIANT-PRE-COMPILE, module-description=Det
    DetGeneral:
      DetVersionInfoApi = false
      DetUseRamlog = true
      DetEnableCallbacks = false
      DetWrapRamlog = true
      DetUseStdErr = false
      DetDeInitAPI = false
      DetNumberOfCallbacks = 5
      DetRamlogSize = 16
      DetUseSafetyMonitor = false
  module config EcuC: implementation-config-variant=VARIANT-PRE-COMPILE, module-description=EcuC
    EcucPduCollection: PduIdTypeEnum=UINT16, PduLengthTypeEnum=UINT16
      PduTx (Pdu): PduLength=64
      PduRx (Pdu): PduLength=64
  module config Os: implementation-config-variant=VARIANT-PRE-COMPILE, module-description=Os
    OsAppMode
    OsOS:
      OsScalabilityClass = SC1
      OsStackMonitoring = true
      OsStatus = EXTENDED
      OsUseGetServiceId = true
      OsUseParameterAccess = true
      OsUseResScheduler = true
      ArcOsTickFrequency = 1000
      ArcOsInterruptStackSize = 2048
      ArcOsIdleStackSize = 512
      ArcOsMaxIsr = 10
      ArcSafetyPlatform = false
      OsHooks: OsErrorHook=false, OsPostTaskHook=false, OsPreTaskHook=false, OsShutdownHook=false, OsStartupHook=false
      ArcOsDebug: OsTaskDebug=false, OsAlarmDebug=false, OsResourceDebug=false, OsScheduleTableDebug=false, OsEventDebug=false, OsDebugActivated=false
    OsRteCounter (OsCounter): OsCounterMaxAllowedValue=65535, OsCounterMinCycle=1, OsCounterTicksPerBase=, OsCounterType=OS_TICK
    OsRteAlarm100ms (OsAlarm): OsAlarmCounterRef=OsRteCounter
      OsAlarmAction
        OsAlarmSetEvent: OsAlarmSetEventRef=OsMainEvent, OsAlarmSetEventTaskRef=OsRteTask
      OsAlarmAutostart: OsAlarmAlarmTime=100, OsAlarmAutostartType=RELATIVE, OsAlarmCycleTime=100, OsAlarmAppModeRef=(unset)
    OsMainEvent (OsEvent)
    OsRteTask (OsTask): OsTaskActivation=1, OsTaskPriority=1, OsTaskSchedule=FULL, ArcOsTaskStackSize=2048, OsTaskEventRef=OsMainEvent, OsTaskEventRef=OsInitEvent
      OsTaskAutostart: OsTaskAppModeRef=(unset)
    OsApplicationInteriorLight (OsApplication):
      OsTrusted = true
      OsAppAlarmRef = OsRteAlarm100ms
      OsAppCounterRef = OsRteCounter
      OsAppTaskRef = OsRteTask
      OsAppTaskRef = OsBswTask
      OsAppTaskRef = OsStartupTask
      OsAppAlarmRef = OsAlarmBswServices
      OsApplicationHooks: OsAppErrorHook=false, OsAppShutdownHook=false, OsAppStartupHook=false
    OsBswTask (OsTask): OsTaskActivation=1, OsTaskPriority=2, OsTaskSchedule=FULL, ArcOsTaskStackSize=2048
      OsTaskAutostart: OsTaskAppModeRef=(unset)
    OsStartupTask (OsTask): OsTaskActivation=1, OsTaskPriority=1, OsTaskSchedule=FULL, ArcOsTaskStackSize=2048
      OsTaskAutostart: OsTaskAppModeRef=(unset)
    OsInitEvent (OsEvent)
    OsAlarmBswServices (OsAlarm): OsAlarmCounterRef=OsRteCounter
      OsAlarmAction
        OsAlarmActivateTask: OsAlarmActivateTaskRef=OsBswTask
      OsAlarmAutostart: OsAlarmAlarmTime=5, OsAlarmAutostartType=RELATIVE, OsAlarmCycleTime=5, OsAlarmAppModeRef=(unset)
  module config EcuM: implementation-config-variant=VARIANT-PRE-COMPILE, module-description=EcuM
    EcuMConfiguration
      EcuMCommonConfiguration: EcuMConfigConsistencyHash=, EcuMDefaultAppMode=(unset), EcuMOSResource=(unset)
        EcuMDefaultShutdownTarget: EcuMDefaultState=EcuMStateOff
        EcuMSleepMode: EcuMSleepModeId=, EcuMSleepModeSuspend=, EcuMSleepModeMcuModeRef=SLEEP, EcuMWakeupSourceMask=EcuMWakeupSource
        EcuMWakeupSource: EcuMWakeupSourceId=, EcuMWakeupSourcePolling=false, EcuMResetReasonRef=(unset)
      EcuMFixedConfiguration:
        EcuMNvramReadallTimeout = 10.0
        EcuMNvramWriteallTimeout = 10.0
        EcuMRunMinimumDuration = 10.0
        EcuMNormalMcuModeRef = NORMAL
        EcuMComMCommunicationAllowedList = ComMChannel
        User (EcuMFixedUserConfig): EcuMFixedUser=
    EcuMGeneral: EcuMDevErrorDetect=false, EcuMIncludeDem=false, EcuMIncludeDet=false, EcuMMainFunctionPeriod=0.2, EcuMVersionInfoApi=false
    EcuMFixedGeneral: EcuMIncludeComM=, EcuMIncludeNvM=, EcuMIncludeNvramMgr=, EcuMTTIIEnabled=, EcuMTTIIWakeupSourceRef=(unset)
  module config IoHwAb: implementation-config-variant=VARIANT-PRE-COMPILE, module-description=IoHwAb
    ArcIoHwAbGeneral: ArcIoHwAbDevErrorDetect=false, ArcIoHwAbAnalogMaxVoltage=5.0, ArcIoHwAbUsePort=false, ArcIoHwCalibrationEnabled=false
    3 x ArcIoHwAbDigitalSignal, all with ArcIoHwAbDigitalDefaultValue=IOHWAB_LOW, ArcIoHwAbDigitalInverted=false, ArcIoHwAbDigitalType=IOHWAB_DIO:
      FrontLight: ArcIoHwAbDigitalMethod=IOHWAB_DIGITAL_WRITE, ArcIoHwAbDioChannelRef=LED1
      FrontDoorRight: ArcIoHwAbDigitalMethod=IOHWAB_DIGITAL_READ, ArcIoHwAbDioChannelRef=D7
      FrontDoorLeft: ArcIoHwAbDigitalMethod=IOHWAB_DIGITAL_READ, ArcIoHwAbDioChannelRef=D8
