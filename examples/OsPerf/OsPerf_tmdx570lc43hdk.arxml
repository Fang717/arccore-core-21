AUTOSAR XML (schema 4-2-2)
package /OsPerf_mpc5744p_mmb
  ecuc value collection OsPerf: ecuc-values=[Os, EcuM, Mcu, Port, Dio]
  module config Port: implementation-config-variant=VARIANT-PRE-COMPILE, module-description=Port
    PortConfigSet
      NHET (PortContainer): PortNumberOfPortPins=1
        N2HET1_17_A13_OUT (PortPin):
          PortPinDirection = PORT_PIN_OUT
          PortPinDirectionChangeable = 0
          PortPinId = 12
          PortPinInitialMode = PORT_PIN_MODE_DIO
          PortPinLevelValue = PORT_PIN_LEVEL_LOW
          PortPinMode = PORT_PIN_MODE_NHET
          PortPinModeChangeable = 0
          ArcPortPinPull = PORT_PIN_PULL_NONE
          ArcPortPinSlewRate = PORT_PIN_SLEW_RATE_MIN
          ArcPortPinOpenDrainEnable = false
          ArcPortPadId = A13
          ArcPortSignalName = N2HET1_17_A13_OUT
    PortGeneral: PortDevErrorDetect=true, PortSetPinDirectionApi=false, PortSetPinModeApi=false, PortVersionInfoApi=false
  module config Dio: implementation-config-variant=VARIANT-PRE-COMPILE, module-description=Dio
    DioConfig
      LED (DioPort): DioPortId=2
        LED_D3 (DioChannel): DioChannelId=33
    DioGeneral: DioDevErrorDetect=1, DioFlipChannelApi=, DioVersionInfoApi=0
