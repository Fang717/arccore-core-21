AUTOSAR XML (schema 4-1-1)
package /OsPerf_mpc5516it
  ecuc value collection OsPerf: ecuc-values=[Mcu, EcuM, Port, Os, Dio]
