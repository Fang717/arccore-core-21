AUTOSAR XML (schema 4-2-2)
package /OsPerf_mpc5645s_demo_v2
  ecuc value collection OsPerf: ecuc-values=[Mcu, EcuM, Os, Dio, Port, Gpt]
  module config Gpt: implementation-config-variant=VARIANT-PRE-COMPILE, module-description=Gpt
    GptChannelConfigSet
      GptCh0 (GptChannelConfiguration):
        GptChannelId = 
        GptChannelTickFrequency = 
        GptChannelTickValueMax = 
        GptEnableWakeup = false
        ArcCoreGptPhysicalChannel = GPT_CHANNEL_PIT_0
        GptChannelMode = GPT_CH_MODE_CONTINUOUS
        GptNotification = Gpt_NotifCh0
        GptChannelClkSrcRef = (unset)
      GptCh1 (GptChannelConfiguration):
        GptChannelId = 
        GptChannelTickFrequency = 
        GptChannelTickValueMax = 
        GptEnableWakeup = false
        ArcCoreGptPhysicalChannel = GPT_CHANNEL_PIT_1
        GptChannelMode = GPT_CH_MODE_CONTINUOUS
        GptNotification = Gpt_NotifCh1
        GptChannelClkSrcRef = (unset)
    GptConfigurationOfOptApiServices:
      GptDeinitApi = true
      GptEnableDisableNotificationApi = true
      GptTimeElapsedApi = true
      GptTimeRemainingApi = false
      GptVersionInfoApi = false
      GptWakeupFunctionalityApi = false
    GptDriverConfiguration: GptDevErrorDetect=true, GptReportWakeupSource=false, GptPredefTimer100us32bitEnable=, GptPredefTimer1usEnablingGrade=
      GptClockReferencePoint: GptClockReference=(unset)
