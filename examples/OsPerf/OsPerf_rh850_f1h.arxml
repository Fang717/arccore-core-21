AUTOSAR XML (schema 4-2-2)
package /OsPerf_rh850f1h
  ecuc value collection OsPerf: ecuc-values=[Os, Dio, Port, EcuM, Mcu]
  module config Dio: implementation-config-variant=VARIANT-PRE-COMPILE, module-description=Dio
    DioConfig
      DioPort_1 (DioPort): DioPortId=3
        4 x DioChannel:
          DioChannel1: DioChannelId=80
          DioChannel2: DioChannelId=81
          DioChannel3: DioChannelId=38
          DioChannel4: DioChannelId=82
        DioChannelGroup_1 (DioChannelGroup): DioChannelGroupIdentification=, DioPortMask=240, DioPortOffset=(unset)
    DioGeneral: DioDevErrorDetect=1, DioFlipChannelApi=(unset), DioVersionInfoApi=1
  module config Port: implementation-config-variant=VARIANT-PRE-COMPILE, module-description=Port
    PortConfigSet
      PortContainer: PortNumberOfPortPins=(unset)
        20 x PortPin, all with PortPinDirectionChangeable=(unset), PortPinMode=, PortPinModeChangeable=(unset), ArcPortPinPull=PORT_PIN_PULL_NONE:
          P8_0: PortPinDirection=PORT_PIN_OUT, PortPinId=80, PortPinInitialMode=PORT_PIN_MODE_DIO, PortPinLevelValue=PORT_PIN_LEVEL_LOW, ArcPortPinSlewRate=PORT_PIN_SLEW_RATE_MED, ArcPortPinOpenDrainEnable=1
          P8_1: PortPinDirection=PORT_PIN_OUT, PortPinId=81, PortPinInitialMode=PORT_PIN_MODE_DIO, PortPinLevelValue=PORT_PIN_LEVEL_LOW, ArcPortPinSlewRate=PORT_PIN_SLEW_RATE_MED, ArcPortPinOpenDrainEnable=1
          FLX0TXDB: PortPinDirection=PORT_PIN_OUT, PortPinId=154, PortPinInitialMode=PORT_PIN_MODE_FLEXRAY, PortPinLevelValue=PORT_PIN_LEVEL_HIGH, ArcPortPinSlewRate=PORT_PIN_SLEW_RATE_MED, ArcPortPinOpenDrainEnable=0
          FLX0RXDB: PortPinDirection=PORT_PIN_OUT, PortPinId=155, PortPinInitialMode=PORT_PIN_MODE_FLEXRAY, PortPinLevelValue=PORT_PIN_LEVEL_HIGH, ArcPortPinSlewRate=PORT_PIN_SLEW_RATE_MAX, ArcPortPinOpenDrainEnable=0
          FLX0CLK: PortPinDirection=PORT_PIN_OUT, PortPinId=156, PortPinInitialMode=PORT_PIN_MODE_FLEXRAY, PortPinLevelValue=PORT_PIN_LEVEL_HIGH, ArcPortPinSlewRate=PORT_PIN_SLEW_RATE_MAX, ArcPortPinOpenDrainEnable=0
          FLX0TXENA: PortPinDirection=PORT_PIN_OUT, PortPinId=157, PortPinInitialMode=PORT_PIN_MODE_FLEXRAY, PortPinLevelValue=PORT_PIN_LEVEL_HIGH, ArcPortPinSlewRate=PORT_PIN_SLEW_RATE_MAX, ArcPortPinOpenDrainEnable=0
          FLX0STPWT: PortPinDirection=PORT_PIN_OUT, PortPinId=158, PortPinInitialMode=PORT_PIN_MODE_FLEXRAY, PortPinLevelValue=PORT_PIN_LEVEL_HIGH, ArcPortPinSlewRate=PORT_PIN_SLEW_RATE_MAX, ArcPortPinOpenDrainEnable=0
          FLX0TXENB: PortPinDirection=PORT_PIN_OUT, PortPinId=159, PortPinInitialMode=PORT_PIN_MODE_FLEXRAY, PortPinLevelValue=PORT_PIN_LEVEL_HIGH, ArcPortPinSlewRate=PORT_PIN_SLEW_RATE_MAX, ArcPortPinOpenDrainEnable=0
          FLX0RXDA: PortPinDirection=PORT_PIN_IN, PortPinId=160, PortPinInitialMode=PORT_PIN_MODE_FLEXRAY, PortPinLevelValue=PORT_PIN_LEVEL_HIGH, ArcPortPinSlewRate=PORT_PIN_SLEW_RATE_MAX, ArcPortPinOpenDrainEnable=0
          FLX0TXDA: PortPinDirection=PORT_PIN_OUT, PortPinId=161, PortPinInitialMode=PORT_PIN_MODE_FLEXRAY, PortPinLevelValue=PORT_PIN_LEVEL_HIGH, ArcPortPinSlewRate=PORT_PIN_SLEW_RATE_MAX, ArcPortPinOpenDrainEnable=0
          P8_2: PortPinDirection=PORT_PIN_OUT, PortPinId=38, PortPinInitialMode=PORT_PIN_MODE_DIO, PortPinLevelValue=PORT_PIN_LEVEL_LOW, ArcPortPinSlewRate=PORT_PIN_SLEW_RATE_MED, ArcPortPinOpenDrainEnable=1
          P8_3: PortPinDirection=PORT_PIN_OUT, PortPinId=82, PortPinInitialMode=PORT_PIN_MODE_DIO, PortPinLevelValue=PORT_PIN_LEVEL_LOW, ArcPortPinSlewRate=PORT_PIN_SLEW_RATE_MED, ArcPortPinOpenDrainEnable=1
          P8_4: PortPinDirection=PORT_PIN_OUT, PortPinId=83, PortPinInitialMode=PORT_PIN_MODE_DIO, PortPinLevelValue=PORT_PIN_LEVEL_LOW, ArcPortPinSlewRate=PORT_PIN_SLEW_RATE_MED, ArcPortPinOpenDrainEnable=1
          P8_5: PortPinDirection=PORT_PIN_OUT, PortPinId=84, PortPinInitialMode=PORT_PIN_MODE_DIO, PortPinLevelValue=PORT_PIN_LEVEL_LOW, ArcPortPinSlewRate=PORT_PIN_SLEW_RATE_MED, ArcPortPinOpenDrainEnable=1
          CAN0TX: PortPinDirection=PORT_PIN_OUT, PortPinId=175, PortPinInitialMode=PORT_PIN_MODE_CAN, PortPinLevelValue=PORT_PIN_LEVEL_LOW, ArcPortPinSlewRate=PORT_PIN_SLEW_RATE_MAX, ArcPortPinOpenDrainEnable=0
          CAN0RX: PortPinDirection=PORT_PIN_IN, PortPinId=174, PortPinInitialMode=PORT_PIN_MODE_CAN, PortPinLevelValue=PORT_PIN_LEVEL_LOW, ArcPortPinSlewRate=PORT_PIN_SLEW_RATE_MAX, ArcPortPinOpenDrainEnable=0
          CAN1TX: PortPinDirection=PORT_PIN_OUT, PortPinId=21, PortPinInitialMode=PORT_PIN_MODE_CAN, PortPinLevelValue=PORT_PIN_LEVEL_LOW, ArcPortPinSlewRate=PORT_PIN_SLEW_RATE_MAX, ArcPortPinOpenDrainEnable=0
          CAN1RX: PortPinDirection=PORT_PIN_IN, PortPinId=20, PortPinInitialMode=PORT_PIN_MODE_CAN, PortPinLevelValue=PORT_PIN_LEVEL_LOW, ArcPortPinSlewRate=PORT_PIN_SLEW_RATE_MAX, ArcPortPinOpenDrainEnable=0
          CAN3RX: PortPinDirection=PORT_PIN_IN, PortPinId=32, PortPinInitialMode=PORT_PIN_MODE_CAN, PortPinLevelValue=PORT_PIN_LEVEL_LOW, ArcPortPinSlewRate=PORT_PIN_SLEW_RATE_MAX, ArcPortPinOpenDrainEnable=0
          CAN3TX: PortPinDirection=PORT_PIN_OUT, PortPinId=33, PortPinInitialMode=PORT_PIN_MODE_CAN, PortPinLevelValue=PORT_PIN_LEVEL_LOW, ArcPortPinSlewRate=PORT_PIN_SLEW_RATE_MAX, ArcPortPinOpenDrainEnable=0
    PortGeneral: PortDevErrorDetect=1, PortSetPinDirectionApi=1, PortSetPinModeApi=1, PortVersionInfoApi=1
