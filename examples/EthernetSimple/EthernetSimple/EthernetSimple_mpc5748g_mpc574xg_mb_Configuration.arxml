AUTOSAR XML (schema 4-0-3)
package /EthernetSimple_mpc5748g_mpc574xg_mb_Ecu
  ecuc value collection EthernetSimple_mpc5748g_mpc574xg_mb_Ecu: ecu-extract=EthernetSimple, ecuc-values=[EcuM, Det, PduR, EcuC, Com, TcpIp, Os, Xcp, Rte, BswM, ComM, EthSM, SoAd, CddPduR, Mcu, Eth, Dlt, CddEthTrcv, EthIf, Port, Dio, IoHwAb]
  module config EcuM: implementation-config-variant=VARIANT-PRE-COMPILE, module-description=EcuM
    EcuMConfiguration
      EcuMCommonConfiguration: EcuMConfigConsistencyHash=(unset), EcuMDefaultAppMode=(unset), EcuMOSResource=(unset)
        EcuMDefaultShutdownTarget: EcuMDefaultState=EcuMStateOff
        EcuMSleepMode: EcuMSleepModeId=(unset), EcuMSleepModeSuspend=(unset), EcuMSleepModeMcuModeRef=SLEEP, EcuMWakeupSourceMask=EcuMWakeupSource
        EcuMWakeupSource: EcuMWakeupSourceId=(unset), EcuMWakeupSourcePolling=0, EcuMResetReasonRef=(unset)
      EcuMFixedConfiguration:
        EcuMNvramReadallTimeout = 10.0
        EcuMNvramWriteallTimeout = 10.0
        EcuMRunMinimumDuration = 10.0
        EcuMNormalMcuModeRef = RUN
        EcuMComMCommunicationAllowedList = ComMChannel
        EthernetUser (EcuMFixedUserConfig): EcuMFixedUser=(unset)
    EcuMGeneral: EcuMDevErrorDetect=0, EcuMIncludeDem=0, EcuMIncludeDet=0, EcuMMainFunctionPeriod=0.01, EcuMVersionInfoApi=0
  module config Mcu: implementation-config-variant=VARIANT-PRE-COMPILE, module-description=Mcu
    McuGeneralConfiguration: McuDevErrorDetect=true, McuGetRamStateApi=false, McuInitClock=true, McuNoPll=false, McuPerformResetApi=false, McuVersionInfoApi=false
    McuModuleConfiguration: McuClockSrcFailureNotification=DISABLED, McuNumberOfMcuModes=, McuRamSectors=, ArcDefaultClockRef=McuClockSettingConfig
      McuClockSettingConfig: McuClockSettingId=
        McuClockReferencePoint: Frequency=, McuClockReferencePointFrequency=40000000.0
        ArcPLLSettings: PLLDV_PREDIV=1, PLLDV_MFD=16, PLLDV_RFDPHI=1, PLLDV_RFDPHI1=2, PLLFM_MODPRD=0, PLLFM_INCSTP=0, PLLFM_MODEN=false
      3 x McuModeSettingConf, all with McuMode=:
        NORMAL
        RUN
        SLEEP
    McuPublishedInformation
      McuResetReasonConf: McuResetReason=
  module config Eth: implementation-config-variant=VARIANT-PRE-COMPILE, module-description=Eth
    EthConfigSet
      EthCtrlConfig:
        EthCtrlEnableMii = 1
        EthCtrlEnableRxInterrupt = 1
        EthCtrlEnableTxInterrupt = 1
        EthCtrlIdx = 0
        EthCtrlRxBufLenByte = 1522
        EthCtrlTxBufLenByte = 1522
        EthRxBufTotal = 25
        EthTxBufTotal = 2
        ArcEthControllerHwMIIMode = MII
        ArcEthControllerHwSpeed = MBPS_100
        ArcEthControllerHwUnit = HWUNIT_0
        ArcEthCtrlDiscardRxFCS = true
        ArcEthCtrlEnableRxChecksumOffload = true
        ArcEthCtrlEnableTxChecksumOffload = true
        ArcEthCtrlRxDMAChannel = 
        ArcEthCtrlRxQueueValue = 
        ArcEthCtrlTxDMAChannel = 
        ArcEthCtrlTxQueueValue = 
        ArcEthFifoPrio = 
        ArcEthCtrlEnableCircDesc = 
        EthCtrlPhyAddress = 00-00-00-00-00-02
    EthGeneral:
      EthDevErrorDetect = 1
      EthGetDropCountApi = 
      EthGetEtherStatsApi = 
      EthGlobalTimeSupport = 
      EthIndex = 
      EthMainFunctionPeriod = 0.1
      EthMaxCtrlsSupported = 
      EthUpdatePhysAddrFilter = false
      EthVersionInfoApi = 1
      ArcEthCpu1xclkValue = 
      ArcEthSoftReset = false
  module config Port: implementation-config-variant=VARIANT-PRE-COMPILE, module-description=Port
    PortConfigSet
      4 x PortContainer, all with PortNumberOfPortPins=:
        CAN
          4 x PortPin, all with PortPinDirectionChangeable=0, PortPinInitialMode=PORT_PIN_MODE_CAN, PortPinLevelValue=PORT_PIN_LEVEL_LOW, PortPinMode=PORT_PIN_MODE_CAN, PortPinModeChangeable=0, ArcPortPinPull=PORT_PIN_PULL_NONE, ArcPortPinSlewRate=PORT_PIN_SLEW_RATE_MED, ArcPortPinOpenDrainEnable=false:
            CAN0TX: PortPinDirection=PORT_PIN_OUT, PortPinId=13
            CAN0RX: PortPinDirection=PORT_PIN_IN, PortPinId=15
            CAN1_RXD: PortPinDirection=PORT_PIN_IN, PortPinId=35
            CAN1_TXD: PortPinDirection=PORT_PIN_OUT, PortPinId=42
        GPIO
          GPIO0 (PortPin):
            PortPinDirection = PORT_PIN_OUT
            PortPinDirectionChangeable = 1
            PortPinId = 0
            PortPinInitialMode = PORT_PIN_MODE_DIO
            PortPinLevelValue = PORT_PIN_LEVEL_LOW
            PortPinMode = 
            PortPinModeChangeable = 1
            ArcPortPinPull = PORT_PIN_PULL_NONE
            ArcPortPinSlewRate = PORT_PIN_SLEW_RATE_MIN
            ArcPortPinOpenDrainEnable = false
          GPIO1 (PortPin):
            PortPinDirection = PORT_PIN_IN
            PortPinDirectionChangeable = 1
            PortPinId = 1
            PortPinInitialMode = PORT_PIN_MODE_DIO
            PortPinLevelValue = PORT_PIN_LEVEL_LOW
            PortPinMode = PORT_PIN_MODE_DIO
            PortPinModeChangeable = 1
            ArcPortPinPull = PORT_PIN_PULL_NONE
            ArcPortPinSlewRate = PORT_PIN_SLEW_RATE_MIN
            ArcPortPinOpenDrainEnable = false
        ETH
          18 x PortPin, all with PortPinLevelValue=PORT_PIN_LEVEL_LOW, PortPinMode=PORT_PIN_MODE_ETH, PortPinModeChangeable=0, ArcPortPinPull=PORT_PIN_PULL_NONE, ArcPortPinSlewRate=PORT_PIN_SLEW_RATE_MAX, ArcPortPinOpenDrainEnable=false:
            ENET0_RXD_1: PortPinDirection=PORT_PIN_IN, PortPinDirectionChangeable=0, PortPinId=8, PortPinInitialMode=PORT_PIN_MODE_ETH
            ENET0_RXD_0: PortPinDirection=PORT_PIN_IN, PortPinDirectionChangeable=0, PortPinId=9, PortPinInitialMode=PORT_PIN_MODE_ETH
            ENET0_RXD_2: PortPinDirection=PORT_PIN_IN, PortPinDirectionChangeable=0, PortPinId=7, PortPinInitialMode=PORT_PIN_MODE_ETH
            ENET0_RXD_3: PortPinDirection=PORT_PIN_IN, PortPinDirectionChangeable=0, PortPinId=77, PortPinInitialMode=PORT_PIN_MODE_ETH
            ENET0_RX_CLK: PortPinDirection=PORT_PIN_IN, PortPinDirectionChangeable=0, PortPinId=3, PortPinInitialMode=PORT_PIN_MODE_ETH
            ENET0_RX_ER: PortPinDirection=PORT_PIN_IN, PortPinDirectionChangeable=0, PortPinId=11, PortPinInitialMode=PORT_PIN_MODE_ETH
            ENET0_RX_DV: PortPinDirection=PORT_PIN_IN, PortPinDirectionChangeable=0, PortPinId=95, PortPinInitialMode=PORT_PIN_MODE_ETH
            ENET0_COL: PortPinDirection=PORT_PIN_IN, PortPinDirectionChangeable=0, PortPinId=10, PortPinInitialMode=PORT_PIN_MODE_ETH
            ENET0_CRS: PortPinDirection=PORT_PIN_IN, PortPinDirectionChangeable=0, PortPinId=76, PortPinInitialMode=PORT_PIN_MODE_ETH
            ENET0_TX_CLK: PortPinDirection=PORT_PIN_IN, PortPinDirectionChangeable=0, PortPinId=97, PortPinInitialMode=PORT_PIN_MODE_OTHER0
            ENET0_MDIO: PortPinDirection=PORT_PIN_IN, PortPinDirectionChangeable=1, PortPinId=94, PortPinInitialMode=PORT_PIN_MODE_OTHER1
            ENET0_MDC: PortPinDirection=PORT_PIN_OUT, PortPinDirectionChangeable=0, PortPinId=96, PortPinInitialMode=PORT_PIN_MODE_ETH
            ENET0_TXD_0: PortPinDirection=PORT_PIN_OUT, PortPinDirectionChangeable=0, PortPinId=113, PortPinInitialMode=PORT_PIN_MODE_ETH
            ENET0_TXD_1: PortPinDirection=PORT_PIN_OUT, PortPinDirectionChangeable=0, PortPinId=112, PortPinInitialMode=PORT_PIN_MODE_ETH
            ENET0_TXD_2: PortPinDirection=PORT_PIN_OUT, PortPinDirectionChangeable=0, PortPinId=108, PortPinInitialMode=PORT_PIN_MODE_ETH
            ENET0_TXD_3: PortPinDirection=PORT_PIN_OUT, PortPinDirectionChangeable=0, PortPinId=109, PortPinInitialMode=PORT_PIN_MODE_ETH
            ENET0_TX_EN: PortPinDirection=PORT_PIN_OUT, PortPinDirectionChangeable=0, PortPinId=114, PortPinInitialMode=PORT_PIN_MODE_ETH
            ENET0_MDIO_OUT: PortPinDirection=PORT_PIN_OUT, PortPinDirectionChangeable=1, PortPinId=94, PortPinInitialMode=PORT_PIN_MODE_ETH
        LED
          LED1 (PortPin):
            PortPinDirection = PORT_PIN_OUT
            PortPinDirectionChangeable = 0
            PortPinId = 98
            PortPinInitialMode = PORT_PIN_MODE_DIO
            PortPinLevelValue = PORT_PIN_LEVEL_HIGH
            PortPinMode = 
            PortPinModeChangeable = 0
            ArcPortPinPull = PORT_PIN_PULL_DOWN
            ArcPortPinSlewRate = PORT_PIN_SLEW_RATE_MIN
            ArcPortPinOpenDrainEnable = false
          LED2 (PortPin):
            PortPinDirection = PORT_PIN_OUT
            PortPinDirectionChangeable = 0
            PortPinId = 99
            PortPinInitialMode = PORT_PIN_MODE_DIO
            PortPinLevelValue = PORT_PIN_LEVEL_LOW
            PortPinMode = 
            PortPinModeChangeable = 0
            ArcPortPinPull = PORT_PIN_PULL_DOWN
            ArcPortPinSlewRate = PORT_PIN_SLEW_RATE_MIN
            ArcPortPinOpenDrainEnable = false
    PortGeneral: PortDevErrorDetect=true, PortSetPinDirectionApi=true, PortSetPinModeApi=true, PortVersionInfoApi=true
  module config Dio: implementation-config-variant=VARIANT-PRE-COMPILE, module-description=Dio
    DioConfig
      DioPort: DioPortId=0
        LED1 (DioChannel): DioChannelId=98
        LED2 (DioChannel): DioChannelId=99
    DioGeneral: DioDevErrorDetect=true, DioFlipChannelApi=, DioVersionInfoApi=false
  module config IoHwAb: implementation-config-variant=VARIANT-PRE-COMPILE, module-description=IoHwAb
    ArcIoHwAbGeneral: ArcIoHwAbDevErrorDetect=1, ArcIoHwAbAnalogMaxVoltage=5.0, ArcIoHwAbUsePort=1, ArcIoHwCalibrationEnabled=0
    DigitalSignal_LED1 (ArcIoHwAbDigitalSignal):
      ArcIoHwAbDigitalDefaultValue = IOHWAB_HIGH
      ArcIoHwAbDigitalInverted = 0
      ArcIoHwAbDigitalMethod = IOHWAB_DIGITAL_WRITE
      ArcIoHwAbDigitalType = IOHWAB_DIO
      ArcIoHwAbDioChannelRef = DioPort/LED1
    DigitalSignal_LED2 (ArcIoHwAbDigitalSignal):
      ArcIoHwAbDigitalDefaultValue = IOHWAB_HIGH
      ArcIoHwAbDigitalInverted = 0
      ArcIoHwAbDigitalMethod = IOHWAB_DIGITAL_WRITE
      ArcIoHwAbDigitalType = IOHWAB_DIO
      ArcIoHwAbDioChannelRef = DioPort/LED2
    ArcIoHwAbScaling: ArcIoHwAbScalingOffset=0.0, ArcIoHwAbScalingScale=1.0, ArcIoHwAbScalingType=Volt
