AUTOSAR XML (schema 4-0-3)
package /EthernetSimple_mpc5777c_mpc57xx_mb
  ecuc value collection mpc5777c: ecu-extract=EthernetSimple, ecuc-values=[Det, PduR, EcuC, Com, Os, Xcp, Rte, Dlt, CddPduR, BswM, ComM, EthSM, SoAd, TcpIp, EthIf, CddEthTrcv, EcuM, Mcu, Port, Dio, Eth]
  module config Det: implementation-config-variant=VARIANT-PRE-COMPILE, module-description=Det
    DetGeneral:
      DetVersionInfoApi = 0
      DetUseRamlog = 1
      DetEnableCallbacks = 0
      DetWrapRamlog = 1
      DetUseStdErr = 0
      DetDeInitAPI = 0
      DetNumberOfCallbacks = 5
      DetRamlogSize = 16
      DetForwardToDlt = 1
      DetUseSafetyMonitor = false
  module config PduR: implementation-config-variant=VARIANT-PRE-COMPILE, module-description=PduR
    PduRGeneral: PduRDevErrorDetect=1, PduRVersionInfoApi=0, PduRZeroCostOperation=0
    PduRRoutingTables: PduRConfigurationId=0, ArcPduRMaxRouteCount=30
      PduRRoutingTable: PduRIsMinimumRouting=0
        6 x PduRRoutingPath:
          PduRRoutingPath1
            PduRDestPdu: ArcOverridenDestModule=Com, PduRDestPduRef=PDU_UDP6661_RX
            PduRSrcPdu: PduRSourcePduHandleId=(unset), ArcOverridenSrcModule=SoAdIf, PduRSrcPduRef=PDU_UDP6661_RX
          PduRRoutingPath2
            PduRDestPdu: ArcOverridenDestModule=SoAdIf, PduRDestPduDataProvision=PDUR_DIRECT, PduRDestPduRef=PDU_UDP6661_TX
            PduRSrcPdu: PduRSourcePduHandleId=(unset), ArcOverridenSrcModule=Com, PduRSrcPduRef=PDU_UDP6661_TX
          PduRRoutingPath_CddPduR_Dlt_Rx
            PduRDestPdu: ArcOverridenDestModule=CddPduR, PduRDestPduRef=Dlt_Rx
            PduRSrcPdu: PduRSourcePduHandleId=, ArcOverridenSrcModule=SoAdIf, PduRSrcPduRef=Dlt_Rx
          PduRRoutingPath_CddPduR_Dlt_Tx
            PduRDestPdu: ArcOverridenDestModule=SoAdIf, PduRDestPduRef=Dlt_Tx
            PduRSrcPdu: PduRSourcePduHandleId=, ArcOverridenSrcModule=CddPduR, PduRSrcPduRef=Dlt_Tx
          PduRRoutingPath_Test_Rx
            PduRDestPdu: ArcOverridenDestModule=CddPduR, PduRDestPduRef=Test_Rx
            PduRSrcPdu: PduRSourcePduHandleId=, ArcOverridenSrcModule=SoAdTp, PduRSrcPduRef=Test_Rx
          PduRRoutingPath_Test_Tx
            PduRDestPdu: ArcOverridenDestModule=SoAdTp, PduRDestPduRef=Test_Tx
            PduRSrcPdu: PduRSourcePduHandleId=, ArcOverridenSrcModule=CddPduR, PduRSrcPduRef=Test_Tx
    3 x PduRBswModules, all with PduRBswModuleRef=(unset):
      Com: PduRCancelReceive=0, PduRCancelTransmit=(unset), PduRChangeParameterRequestApi=(unset), PduRCommunicationInterface=(unset), PduRLowerModule=1, PduRRetransmission=(unset), PduRTransportProtocol=(unset), PduRTriggertransmit=(unset), PduRTxConfirmation=(unset), PduRUpperModule=1, PduRUseTag=(unset)
      SoAdIf: PduRCancelReceive=0, PduRCancelTransmit=(unset), PduRChangeParameterRequestApi=(unset), PduRCommunicationInterface=(unset), PduRLowerModule=1, PduRRetransmission=(unset), PduRTransportProtocol=(unset), PduRTriggertransmit=(unset), PduRTxConfirmation=(unset), PduRUpperModule=0, PduRUseTag=(unset)
      CddPduR: PduRCancelReceive=false, PduRCancelTransmit=, PduRChangeParameterRequestApi=, PduRCommunicationInterface=, PduRLowerModule=0, PduRRetransmission=, PduRTransportProtocol=, PduRTriggertransmit=, PduRTxConfirmation=, PduRUpperModule=1, PduRUseTag=
  module config EcuC: implementation-config-variant=VARIANT-PRE-COMPILE, module-description=EcuC
    EcucPduCollection: PduIdTypeEnum=UINT16, PduLengthTypeEnum=UINT16
      11 x Pdu:
        Dcm_Rx: PduLength=8
        Dcm_Tx: PduLength=8
        PDU_UDP6661_RX: PduLength=4
        PDU_UDP6661_TX: PduLength=4
        Dcm_RxFunc: PduLength=8
        XCP_RX_PDU: PduLength=8
        XCP_TX_PDU: PduLength=8
        Dlt_Tx: PduLength=500
        Dlt_Rx: PduLength=500
        Test_Tx: PduLength=500
        Test_Rx: PduLength=500
  module config Com: implementation-config-variant=VARIANT-PRE-COMPILE, module-description=Com
    ComConfig: ComConfigurationId=(unset)
      ComTimeBase: ComRxTimeBase=0.01, ComTxTimeBase=0.01
      IPDU_UDP6661_RX (ComIPdu):
        ComIPduDirection = RECEIVE
        ComIPduSignalProcessing = DEFERRED
        ComIPduTriggerTransmitCallout = NULL
        ComIPduType = 
        ComPduIdRef = PDU_UDP6661_RX
        ComIPduGroupRef = ComIPduGroupRx
        ComIPduSignalRef = ComSignal_RxUDP
      ComIPduGroupRx (ComIPduGroup): ComIPduGroupHandleId=(unset)
      IPDU_UDP6661_TX (ComIPdu):
        ComIPduDirection = SEND
        ComIPduSignalProcessing = IMMEDIATE
        ComIPduTriggerTransmitCallout = NULL
        ComIPduType = 
        ComPduIdRef = PDU_UDP6661_TX
        ComIPduGroupRef = ComIPduGroupTx
        ComIPduSignalRef = ComSignal_TxUDP
        ComTxIPdu: ComTxIPduUnusedAreasDefault=0
          ComTxModeTrue
            ComTxMode: ComTxModeMode=DIRECT
      ComSignal_TxUDP (ComSignal):
        ComBitPosition = 0
        ComHandleId = (unset)
        ComSignalEndianness = opaque
        ComSignalType = UINT32
        ComTransferProperty = TRIGGERED
        ComBitSize = 32
        ComSystemTemplateSystemSignalRef = Tx01dataMapping
      ComSignal_RxUDP (ComSignal):
        ComBitPosition = 0
        ComHandleId = (unset)
        ComSignalEndianness = opaque
        ComSignalType = UINT32
        ComBitSize = 32
        ComSystemTemplateSystemSignalRef = Rx01dataMapping
      ComIPduGroupTx (ComIPduGroup): ComIPduGroupHandleId=(unset)
    ComGeneral:
      ComSupportedIPduGroups = 4
      ComVersionInfoApi = 0
      ComSupportedIPdus = 20
      ComSupportedSignals = 40
      ComSupportedGroupSignals = 40
      ComRamBufferSize = 100
      ArcMaxNumberOfSupportedIPduCounters = 10
      ArcComSupportedGatewaySourceDescriptions = 0
      ArcComOsekNmSupport = false
  module config Os: implementation-config-variant=VARIANT-PRE-COMPILE, module-description=Os
    OsAppMode
    OsOS:
      OsScalabilityClass = SC1
      OsStackMonitoring = 1
      OsStatus = EXTENDED
      OsUseGetServiceId = 1
      OsUseParameterAccess = 1
      OsUseResScheduler = 1
      ArcOsTickFrequency = 1000
      ArcOsInterruptStackSize = 2048
      ArcOsIdleStackSize = 512
      ArcOsMaxIsr = 200
      ArcSafetyPlatform = false
      OsHooks: OsErrorHook=1, OsPostTaskHook=0, OsPreTaskHook=0, OsShutdownHook=1, OsStartupHook=1
      ArcOsDebug: OsTaskDebug=0, OsAlarmDebug=0, OsResourceDebug=0, OsScheduleTableDebug=0, OsEventDebug=0, OsDebugActivated=0
    OsApplication:
      OsTrusted = 1
      OsAppAlarmRef = OsAlarmLWIPMain
      OsAppCounterRef = OsCounter
      OsAppTaskRef = MainLWIPTask
      OsAppTaskRef = OsStartupTask
      OsAppTaskRef = tcpip_task
      OsAppAlarmRef = OsAlarmBswService
      OsAppTaskRef = OsBswServiceTask
      OsAppAlarmRef = OsAlarm100ms
      OsAppAlarmRef = OsAlarm1000ms
      OsAppTaskRef = OsRteTask
      OsApplicationHooks: OsAppErrorHook=0, OsAppShutdownHook=0, OsAppStartupHook=0
    OsCounter:
      OsCounterMaxAllowedValue = 65535
      OsCounterMinCycle = 1
      OsCounterTicksPerBase = (unset)
      OsCounterType = OS_TICK
      OsCounterAccessingApplication = OsApplication
    OsAlarmLWIPMain (OsAlarm): OsAlarmCounterRef=OsCounter, OsAlarmAccessingApplication=OsApplication
      OsAlarmAction
        OsAlarmSetEvent: OsAlarmSetEventRef=LWIP_MAIN, OsAlarmSetEventTaskRef=MainLWIPTask
    MainLWIPTask (OsTask): OsTaskActivation=1, OsTaskPriority=4, OsTaskSchedule=FULL, ArcOsTaskStackSize=2048, OsTaskAccessingApplication=OsApplication, OsTaskEventRef=LWIP_MAIN
      OsTaskAutostart: OsTaskAppModeRef=(unset)
    OsStartupTask (OsTask):
      OsTaskActivation = 1
      OsTaskPriority = 4
      OsTaskSchedule = FULL
      ArcOsTaskStackSize = 1024
      OsTaskAccessingApplication = OsApplication
      OsTaskEventRef = START_TCPIP
      OsTaskAutostart: OsTaskAppModeRef=(unset)
    START_TCPIP (OsEvent)
    tcpip_task (OsTask): OsTaskActivation=1, OsTaskPriority=4, OsTaskSchedule=FULL, ArcOsTaskStackSize=4096, OsTaskEventRef=START_TCPIP
      OsTaskAutostart: OsTaskAppModeRef=(unset)
    LWIP_MAIN (OsEvent)
    OsBswServiceTask (OsTask):
      OsTaskActivation = 1
      OsTaskPriority = 5
      OsTaskSchedule = FULL
      ArcOsTaskStackSize = 2048
      OsTaskAccessingApplication = OsApplication
      OsTaskEventRef = OsBwmMainEvent
      OsTaskAutostart: OsTaskAppModeRef=(unset)
    OsAlarmBswService (OsAlarm): OsAlarmCounterRef=OsCounter, OsAlarmAccessingApplication=OsApplication
      OsAlarmAction
        OsAlarmSetEvent: OsAlarmSetEventRef=OsBwmMainEvent, OsAlarmSetEventTaskRef=OsBswServiceTask
      OsAlarmAutostart: OsAlarmAlarmTime=5, OsAlarmAutostartType=RELATIVE, OsAlarmCycleTime=5, OsAlarmAppModeRef=(unset)
    OsAlarm100ms (OsAlarm): OsAlarmCounterRef=OsCounter, OsAlarmAccessingApplication=OsApplication
      OsAlarmAction
        OsAlarmSetEvent: OsAlarmSetEventRef=OsRteEvent1, OsAlarmSetEventTaskRef=OsRteTask
      OsAlarmAutostart: OsAlarmAlarmTime=100, OsAlarmAutostartType=RELATIVE, OsAlarmCycleTime=100, OsAlarmAppModeRef=(unset)
    3 x OsEvent:
      OsRteEvent1
      OsRteEvent2
      ModeSwitchOsEvent
    OsRteTask (OsTask):
      OsTaskActivation = 1
      OsTaskPriority = 2
      OsTaskSchedule = FULL
      ArcOsTaskStackSize = 2048
      OsTaskAccessingApplication = OsApplication
      OsTaskEventRef = OsRteEvent1
      OsTaskEventRef = OsRteEvent2
      OsTaskEventRef = ModeSwitchOsEvent
      OsTaskAutostart: OsTaskAppModeRef=(unset)
    OsAlarm1000ms (OsAlarm): OsAlarmCounterRef=OsCounter, OsAlarmAccessingApplication=OsApplication
      OsAlarmAction
        OsAlarmSetEvent: OsAlarmSetEventRef=OsRteEvent2, OsAlarmSetEventTaskRef=OsRteTask
      OsAlarmAutostart: OsAlarmAlarmTime=1000, OsAlarmAutostartType=RELATIVE, OsAlarmCycleTime=1000, OsAlarmAppModeRef=(unset)
    OsBwmMainEvent (OsEvent)
  module config Xcp: implementation-config-variant=VARIANT-PRE-COMPILE, module-description=Xcp
    XcpConfig
      XcpEventChannel:
        XcpEventChannelConsistency = ODT
        XcpEventChannelMaxDaqList = 4
        XcpEventChannelNumber = 0
        XcpEventChannelPriority = (unset)
        XcpEventChannelTimeCycle = 1
        XcpEventChannelType = DAQ_STIM
        XcpEventChannelTimeUnit = TIMESTAMP_UNIT_10MS
      XcpPdu0 (XcpPdu)
        XcpRxPdu: XcpRxPduId=(unset), XcpRxPduRef=XCP_RX_PDU
      XcpPdu1 (XcpPdu)
        XcpTxPdu: XcpTxPduId=(unset), XcpTxPduRef=XCP_TX_PDU
    XcpGeneral:
      XcpDaqConfigType = DAQ_DYNAMIC
      XcpDaqCount = 4
      ArcXcpMaxRxTxQueue = 10
      ArcXcpFeatureStim = 1
      ArcXcpFeatureGetSlaveId = 0
      ArcXcpFeatureProtection = 1
      ArcXcpFeatureDio = 0
      ArcXcpFeatureBlockMode = 1
      ArcXcpFeatureCalibrationPage = 0
      XcpDevErrorDetect = 1
      XcpIdentificationFieldType = ABSOLUTE
      XcpMainFunctionPeriod = (unset)
      XcpMaxCto = 8
      XcpMaxDto = 8
      XcpMaxEventChannel = (unset)
      XcpMinDaq = 0
      XcpOdtCount = 4
      XcpOdtEntriesCount = 4
      XcpOdtEntrySizeDaq = (unset)
      XcpOdtEntrySizeStim = (unset)
      XcpOnCanEnabled = 0
      XcpOnCddEnabled = 0
      XcpOnEthernetEnabled = 1
      XcpOnFlexRayEnabled = 0
      XcpPrescalerSupported = (unset)
      XcpSuppressTxSupport = (unset)
      XcpTimestampTicks = 0
      XcpTimestampType = NO_TIME_STAMP
      XcpTimestampUnit = TIMESTAMP_UNIT_1MS
      XcpVersionInfoApi = 0
      ArcXcpFeatureProgram = false
      XcpCounterRef = OsCounter
  module config Rte: implementation-config-variant=VARIANT-PRE-COMPILE, module-description=Rte
    RteBswGeneral: RteSchMVersionInfoApi=(unset), RteUseComShadowSignalApi=0
    RteGeneration:
      RteCalibrationSupport = NONE
      RteCodeVendorId = (unset)
      RteDevErrorDetect = 0
      RteDevErrorDetectUninit = 0
      RteGenerationMode = COMPATIBILITY_MODE
      RteIocInteractionReturnValue = RTE_IOC
      RteMeasurementSupport = 0
      RteOptimizationMode = RUNTIME
      RteValueRangeCheckEnabled = 0
      RteVfbTraceEnabled = 0
    RteInitializationBehavior: RteInitializationStrategy=, RteSectionInitializationPolicy=
    RteOsInteraction
    RtePostBuildVariantConfiguration: RtePostBuildUsedPredefinedVariant=(unset)
    7 x RteSwComponentInstance:
      bswm: RteSoftwareComponentInstanceRef=bswm
      comM: RteSoftwareComponentInstanceRef=comM
      dlt: RteSoftwareComponentInstanceRef=dlt
      ecuM: RteSoftwareComponentInstanceRef=ecuM
      ioHwAb: RteSoftwareComponentInstanceRef=ioHwAb
      SwcReader: RteSoftwareComponentInstanceRef=SwcReader
        InitEvent_OsRteTask (RteEventToTaskMapping): RteImmediateRestart=false, RtePositionInTask=1, RteEventRef=InitEvent, RteMappedToTaskRef=OsRteTask, RteUsedOsEventRef=ModeSwitchOsEvent
        SwcReaderRunnable_timingEvent_0_1_OsRteTask (RteEventToTaskMapping): RteImmediateRestart=false, RteEventRef=SwcReaderRunnable_timingEvent_0_1, RteMappedToTaskRef=OsRteTask, RteUsedOsEventRef=OsRteEvent1
      SwcWriter: RteSoftwareComponentInstanceRef=SwcWriter
        InitEvent_OsRteTask (RteEventToTaskMapping): RteImmediateRestart=false, RtePositionInTask=2, RteEventRef=InitEvent, RteMappedToTaskRef=OsRteTask, RteUsedOsEventRef=ModeSwitchOsEvent
        SwcWriterRunnable_timingEvent_1_0_OsRteTask (RteEventToTaskMapping): RteImmediateRestart=false, RteEventRef=SwcWriterRunnable_timingEvent_1_0, RteMappedToTaskRef=OsRteTask, RteUsedOsEventRef=OsRteEvent2
  module config Dlt: implementation-config-variant=VARIANT-PRE-COMPILE, module-description=Dlt
    DltGeneral:
      DltDevErrorDetect = 1
      DltImplementAppIdContextIdQuery = 1
      DltImplementExtendedHeader = 
      DltImplementFilterMessages = 1
      DltImplementNVRamStorage = 
      DltImplementSWCInjection = 
      DltImplementTimestamp = 0
      DltImplementVerboseMode = 1
      DltImplementVfbTrace = 
      DltVfbTraceLogLevel = 
      DltGptChannel = (unset)
    DltMemory: DltInitBufferSize=, DltMaxCountAppIds=, DltMaxCountContextIds=, DltMaxCountContextIdsPerAppId=, DltMessageBufferSize=300
    DltMultipleConfigurationContainer: DltNvRamBlockRef=(unset)
      DltBandwidth: DltBandwidthForComModule=, DltBandwidthForDiagChannel=, DltTimePeriodTrafficShaping=
      DltMessageFiltering: DltDefaultMaxLogLevel=0, DltDefaultTraceStatus=, DltFactoryDefaultMaxLogLevel=, DltFilterMessages=1
      DltProtocol:
        DltEcuId = DLTT
        DltHeaderPayloadEndianes = BigEndian
        DltHeaderUseEcuId = 1
        DltHeaderUseExtendedHeader = 1
        DltHeaderUseSessionID = 1
        DltHeaderUseTimestamp = 0
        DltMaxMessageLength = 100
        DltUseVerboseMode = 1
  module config CddPduR: implementation-config-variant=VARIANT-PRE-COMPILE, module-description=CddPduR
    CddPduRConfig: CddPduRConfigurationId=
      4 x CddPduRIPdu:
        CddPduRIPdu_Dlt_Rx: CddPduRPduIdRef=Dlt_Rx
        CddPduRIPdu_Dlt_Tx: CddPduRPduIdRef=Dlt_Tx
        CddPduRIPdu_Test_Rx: CddPduRPduIdRef=Test_Rx
        CddPduRIPdu_Test_Tx: CddPduRPduIdRef=Test_Tx
  module config BswM: implementation-config-variant=VARIANT-PRE-COMPILE, module-description=BswM
    BswMConfig
      BswMArbitration: ArcBswMMaxRuleCount=20
        BswComMIndication (BswMModeRequestPort): BswMRequestProcessing=BSWM_DEFERRED
          BswMModeRequestSource
            BswMComMIndication: BswMComMChannelRef=ComMChannel
        EnablePduGroupsRule (BswMRule):
          BswMNestedExecutionOnly = false
          BswMRuleInitState = BSWM_FALSE
          BswMRuleExpressionRef = ComMFullCommuncationlExpression
          BswMRuleTrueActionList = EnablePdusActions
        ComMFullCommunicationCondition (BswMModeCondition): BswMConditionType=BSWM_EQUALS, BswMConditionMode=BswComMIndication
          BswMConditionValue
            BswMBswMode: BswMBswRequestedMode=COMM_FULL_COMMUNICATION
        ComMFullCommuncationlExpression (BswMLogicalExpression): BswMArgumentRef=ComMFullCommunicationCondition
        SwcStartCommunication (BswMModeRequestPort): BswMRequestProcessing=BSWM_DEFERRED
          BswMModeRequestSource
            BswMSwcModeRequest: BswMSwcModeRequestModeDeclarationGroupPrototypeRef=currentMode
        StartCommunicationCondition (BswMModeCondition): BswMConditionType=BSWM_EQUALS_NOT, BswMConditionMode=SwcStartCommunication
          BswMConditionValue
            BswMBswMode: BswMBswRequestedMode=COMM_NO_COMMUNICATION
        StartCommunicationRule (BswMRule):
          BswMNestedExecutionOnly = false
          BswMRuleInitState = BSWM_FALSE
          BswMRuleExpressionRef = StartCommunicationExpression
          BswMRuleTrueActionList = StartCommuncationActions
        StartCommunicationExpression (BswMLogicalExpression): BswMArgumentRef=StartCommunicationCondition
      BswMModeControl
        EnablePdusActions (BswMActionList): BswMActionListExecution=BSWM_TRIGGER
          BswMActionListItem: BswMAbortOnFail=false, BswMActionListItemIndex=0, BswMActionListItemRef=IPduStart
        IPduStart (BswMAction)
          BswMAvailableActions
            BswMPduGroupSwitch: BswMPduGroupSwitchReinit=false, BswMEnabledPduGroupRef=ComIPduGroupRx, BswMEnabledPduGroupRef=ComIPduGroupTx
        StartCommuncationActions (BswMActionList): BswMActionListExecution=BSWM_TRIGGER
          BswMActionListItem: BswMAbortOnFail=false, BswMActionListItemIndex=0, BswMActionListItemRef=RequestFullCom
        RequestFullCom (BswMAction)
          BswMAvailableActions
            BswMComMModeSwitch: BswMComMRequestedMode=BSWM_FULL_COM, BswMComMUserRef=ComMUser
    BswMGeneral: BswMDevErrorDetect=true, BswMVersionInfoApi=true, BswMComMEnabled=1, BswMEcuMEnabled=1, BswMCanSMEnabled=0, BswMEthSMEnabled=1, BswMSdEnabled=false
  module config ComM: implementation-config-variant=VARIANT-PRE-COMPILE, module-description=ComM
    ComMConfigSet
      ComMChannel:
        ComMBusType = COMM_BUS_TYPE_ETH
        ComMChannelId = 
        ComMFullCommRequestNotificationEnabled = false
        ComMGlobalNvmBlockDescriptor = false
        ComMMainFunctionPeriod = 0.01
        ComMNoCom = false
        ComMNoWakeup = false
        ComMNetworkManagement: ComMNmVariant=NONE, ComMPncNmRequest=false
        ComMUserPerChannel: ComMUserChannel=ComMUser
      ComMUser: ComMUserIdentifier=
    ComMGeneral:
      ComMNoCom = false
      ComMEcuGroupClassification = 3
      ComMModeLimitationEnabled = false
      ComMPncSupport = false
      ComMSynchronousWakeUp = true
      ComMTMinFullComModeDuration = 5.0
      ComMVersionInfoApi = false
      ComMWakeupInhibitionEnabled = false
      ComMDevErrorDetect = true
      ArcComMASRCompatibilityLessThan4_2 = true
  module config EthSM: implementation-config-variant=VARIANT-PRE-COMPILE, module-description=EthSM
    EthSMGeneral: EthSMDevErrorDetect=1, EthSMMainFunctionPeriod=0.01, EthSMDummyMode=1, EthSMVersionInfoApi=1
    EthSMNetwork: EthSMConfirmationTimeout=1, EthSMComMNetworkHandleRef=ComMChannel, EthSMEthIfControllerRef=EthIfController
  module config SoAd: implementation-config-variant=VARIANT-PRE-COMPILE, module-description=SoAd
    SoAdConfig
      SoAdSocketConnectionGroupUDPCom (SoAdSocketConnectionGroup):
        SoAdPduHeaderEnable = 0
        SoAdResourceManagementEnable = 0
        SoAdSocketAutomaticSoConSetup = true
        SoAdSocketIpAddrAssignmentChgNotification = false
        SoAdSocketLocalPort = 1234
        SoAdSocketMsgAcceptanceFilterEnabled = true
        SoAdSocketSoConModeChgNotification = false
        SoAdSocketLocalAddressRef = TcpIpLocalAddr
        SoAdSocketConnectionUdpCom (SoAdSocketConnection): SoAdSocketId=
          SoAdSocketRemoteAddress: SoAdSocketRemoteIpAddress=192.168.0.5, SoAdSocketRemotePort=1234
        SoAdSocketProtocol
          SoAdSocketUdp: SoAdSocketUdpListenOnly=false, SoAdSocketUdpStrictHeaderLenCheckEnabled=false
      SoAdPduRouteTxUDP6661 (SoAdPduRoute): SoAdTxPduId=, SoAdTxUpperLayerType=IF, SoAdTxPduRef=PDU_UDP6661_TX
        SoAdPduRouteDest: SoAdTxUdpTriggerMode=TRIGGER_ALWAYS, SoAdTxSocketConnOrSocketConnBundleRef=SoAdSocketConnectionUdpCom
      SoAdSocketRouteRxUdp6661 (SoAdSocketRoute): SoAdRxSocketConnOrSocketConnBundleRef=SoAdSocketConnectionUdpCom
        SoAdSocketRouteDest: SoAdRxUpperLayerType=IF, SoAdRxPduRef=PDU_UDP6661_RX
      SoAdSocketConnectionGroupDltCom (SoAdSocketConnectionGroup):
        SoAdPduHeaderEnable = 0
        SoAdResourceManagementEnable = 0
        SoAdSocketAutomaticSoConSetup = true
        SoAdSocketIpAddrAssignmentChgNotification = false
        SoAdSocketLocalPort = 999
        SoAdSocketMsgAcceptanceFilterEnabled = true
        SoAdSocketSoConModeChgNotification = false
        SoAdSocketLocalAddressRef = TcpIpLocalAddr
        SoAdSocketConnectionDltCom (SoAdSocketConnection): SoAdSocketId=
          SoAdSocketRemoteAddress: SoAdSocketRemoteIpAddress=0.0.0.0, SoAdSocketRemotePort=0
        SoAdSocketProtocol
          SoAdSocketTcp: SoAdSocketTcpImmediateTpTxConfirmation=false, SoAdSocketTcpInitiate=0, SoAdSocketTcpKeepAlive=false
      SoAdSocketRouteDltRxTcp (SoAdSocketRoute): SoAdRxSocketConnOrSocketConnBundleRef=SoAdSocketConnectionDltCom
        SoAdSocketRouteDest: SoAdRxUpperLayerType=IF, SoAdRxPduRef=Dlt_Rx
      SoAdPduRouteDltTx (SoAdPduRoute): SoAdTxPduId=, SoAdTxUpperLayerType=IF, SoAdTxPduRef=Dlt_Tx
        SoAdPduRouteDest: SoAdTxUdpTriggerMode=TRIGGER_ALWAYS, SoAdTxSocketConnOrSocketConnBundleRef=SoAdSocketConnectionDltCom
      SoAdSocketRouteXcpRx (SoAdSocketRoute): SoAdRxSocketConnOrSocketConnBundleRef=SoAdSocketConnectionGroupXCP
        SoAdSocketRouteDest: SoAdRxUpperLayerType=IF, SoAdRxPduRef=XCP_RX_PDU
      SoAdSocketConnectionGroupXCP (SoAdSocketConnectionGroup):
        SoAdPduHeaderEnable = 0
        SoAdResourceManagementEnable = 0
        SoAdSocketAutomaticSoConSetup = true
        SoAdSocketIpAddrAssignmentChgNotification = false
        SoAdSocketLocalPort = 13600
        SoAdSocketMsgAcceptanceFilterEnabled = true
        SoAdSocketSoConModeChgNotification = false
        SoAdSocketLocalAddressRef = TcpIpLocalAddr
        SoAdSocketConnectionXcp (SoAdSocketConnection): SoAdSocketId=
          SoAdSocketRemoteAddress: SoAdSocketRemoteIpAddress=0.0.0.0, SoAdSocketRemotePort=0
        SoAdSocketProtocol
          SoAdSocketUdp: SoAdSocketUdpListenOnly=false, SoAdSocketUdpStrictHeaderLenCheckEnabled=false
      SoAdPduRouteXcpTx (SoAdPduRoute): SoAdTxPduId=, SoAdTxUpperLayerType=IF, SoAdTxPduRef=XCP_TX_PDU
        SoAdPduRouteDest: SoAdTxUdpTriggerMode=TRIGGER_ALWAYS, SoAdTxSocketConnOrSocketConnBundleRef=SoAdSocketConnectionXcp
      SoAdRoutingGroup: SoAdRoutingGroupId=, SoAdRoutingGroupIsEnabledAtInit=1, SoAdRoutingGroupTxTriggerable=false
      SoAdPduRouteTestTx (SoAdPduRoute): SoAdTxPduId=, SoAdTxUpperLayerType=IF, SoAdTxPduRef=Test_Tx
        SoAdPduRouteDest: SoAdTxUdpTriggerMode=TRIGGER_ALWAYS, SoAdTxSocketConnOrSocketConnBundleRef=SoAdSocketConnectionTest
      SoAdSocketRouteTestRxTcp (SoAdSocketRoute): SoAdRxSocketConnOrSocketConnBundleRef=SoAdSocketConnectionGroupTest
        SoAdSocketRouteDest: SoAdRxUpperLayerType=IF, SoAdRxPduRef=Test_Rx
      SoAdSocketConnectionGroupTest (SoAdSocketConnectionGroup):
        SoAdPduHeaderEnable = 0
        SoAdResourceManagementEnable = 
        SoAdSocketAutomaticSoConSetup = true
        SoAdSocketIpAddrAssignmentChgNotification = false
        SoAdSocketLocalPort = 111
        SoAdSocketMsgAcceptanceFilterEnabled = true
        SoAdSocketSoConModeChgNotification = false
        SoAdSocketLocalAddressRef = TcpIpLocalAddr
        SoAdSocketConnectionTest (SoAdSocketConnection): SoAdSocketId=
          SoAdSocketRemoteAddress: SoAdSocketRemoteIpAddress=0.0.0.0, SoAdSocketRemotePort=0
        SoAdSocketProtocol
          SoAdSocketTcp: SoAdSocketTcpImmediateTpTxConfirmation=false, SoAdSocketTcpInitiate=0, SoAdSocketTcpKeepAlive=false
    SoAdGeneral: SoAdDevErrorDetect=1, SoAdIPv6AddressEnabled=0, SoAdMainFunctionPeriod=0.005, SoAdRoutingGroupMax=10, SoAdSoConMax=10, SoAdVersionInfoApi=1
    SoAdBswModulesPduR (SoAdBswModules):
      SoAdIf = 1
      SoAdIfTriggerTransmit = false
      SoAdIfTxConfirmation = 1
      SoAdLocalIpAddrAssigmentChg = 0
      SoAdSoConModeChg = 0
      SoAdTp = 0
      SoAdUseCallerInfix = true
      SoAdUseTypeInfix = true
      SoAdBswModuleRef = PduR
    SoAdBswModulesXcp (SoAdBswModules):
      SoAdIf = 1
      SoAdIfTriggerTransmit = false
      SoAdIfTxConfirmation = 1
      SoAdLocalIpAddrAssigmentChg = 0
      SoAdSoConModeChg = 0
      SoAdTp = 0
      SoAdUseCallerInfix = true
      SoAdUseTypeInfix = true
      SoAdBswModuleRef = Xcp
  module config TcpIp: implementation-config-variant=VARIANT-PRE-COMPILE, module-description=TcpIp
    TcpIpConfig
      TcpIpCtrl: TcpIpEthIfCtrlRef=EthIfController
        TcpIpIpVXCtrl
          TcpIpIpV4Ctrl:
            TcpIpDhcpConfigRef = (unset)
            TcpIpArpConfigRef = TcpIpArpConfig1
            TcpIpAutoIpConfigRef = (unset)
            TcpIpFragmentationConfigRef = TcpIpIpFragmentationConfig
        TcpIpCtrlDemEventParameterRefs
      TcpIpLocalAddr: TcpIpAddrId=1, TcpIpAddressType=TCPIP_UNICAST, TcpIpDomainType=TCPIP_AF_INET, TcpIpCtrlRef=TcpIpCtrl
        TcpIpStaticIpAddressConfig: TcpIpStaticIpAddress=192.168.0.10, TcpIpDefaultRouter=192.168.0.1, TcpIpNetmask=24
        TcpIpAddrAssignment: TcpIpAssignmentMethod=TCPIP_STATIC, TcpIpAssignmentPriority=1, TcpIpAssignmentTrigger=TCPIP_AUTOMATIC
      TcpIpSocketOwnerConfig
        SoAd (TcpIpSocketOwner): TcpIpSocketOwnerUpperLayerType=SOAD
      TcpIpIpConfig
        TcpIpIpV4Config
          TcpIpArpConfig1 (TcpIpArpConfig): TcpIpArpNumGratuitousARPonStartup=, TcpIpArpPacketQueueEnabled=false, TcpIpArpTableEntryTimeout=, TcpIpArpTableSizeMax=10
          TcpIpArpConfig2 (TcpIpArpConfig): TcpIpArpNumGratuitousARPonStartup=, TcpIpArpPacketQueueEnabled=false, TcpIpArpTableEntryTimeout=, TcpIpArpTableSizeMax=5
          TcpIpIpFragmentationConfig: TcpIpIpFragmentationRxEnabled=true, ArcTcpIpIpMaxNofBufs=10, ArcTcpIpIpMaxReceiveBufferSize=1500, TcpIpIpReassTimeout=60
      TcpIpLocalAddrMult (TcpIpLocalAddr): TcpIpAddrId=2, TcpIpAddressType=TCPIP_MULTICAST, TcpIpDomainType=TCPIP_AF_INET, TcpIpCtrlRef=TcpIpCtrl
        TcpIpAddrAssignment: TcpIpAssignmentMethod=TCPIP_STATIC, TcpIpAssignmentPriority=3, TcpIpAssignmentTrigger=TCPIP_MANUAL
      TcpIpLocalAddrMultAuto (TcpIpLocalAddr): TcpIpAddrId=3, TcpIpAddressType=TCPIP_MULTICAST, TcpIpDomainType=TCPIP_AF_INET, TcpIpCtrlRef=TcpIpCtrl
        TcpIpAddrAssignment: TcpIpAssignmentMethod=TCPIP_STATIC, TcpIpAssignmentPriority=2, TcpIpAssignmentTrigger=TCPIP_AUTOMATIC
        TcpIpStaticIpAddressConfig: TcpIpStaticIpAddress=225.0.0.1
    TcpIpGeneral:
      TcpIpBufferMemory = 5200
      TcpIpDevErrorDetect = 1
      TcpIpDhcpServerEnabled = 
      TcpIpMainFunctionPeriod = 0.005
      TcpIpResetIpAssignmentApi = 1
      TcpIpScalabilityClass = SC1
      TcpIpTcpEnabled = 1
      TcpIpTcpSocketMax = 3
      TcpIpUdpEnabled = 1
      TcpIpUdpSocketMax = 3
      TcpIpVersionInfoApi = 1
      TcpIpIpV4General:
        TcpIpArpEnabled = 1
        TcpIpAutoIpEnabled = 0
        TcpIpDhcpClientEnabled = 0
        TcpIpIcmpEnabled = 1
        TcpIpIpV4Enabled = 1
        TcpIpLocalAddrIpv4EntriesMax = 10
        TcpIpPathMtuDiscoveryEnabled = 1
      TcpIpIpV6General:
        TcpIpDhcpV6ClientEnabled = 
        TcpIpIpV6Enabled = 
        TcpIpIpV6PathMtuDiscoveryEnabled = 
        TcpIpLocalAddrIpv6EntriesMax = 
        TcpIpNdpAddressResolutionUnrechabilityDetectionEnabled = 
        TcpIpNdpPrefixAndRouterDiscoveryEnabled = 
    ArcLwIpConfig:
      LwIpMempNumNetConn = 6
      LwIpPoolSize = 30
      LwIpMemSize = 20000
      LwIpMempNumPBuf = 30
      LwIpEthernetMacAddress = 00-00-00-00-00-02
      LwIpTrcvAddress = 0
      LwIpMaxMTU = 1500
      LwIpMaxMRU = 1500
      LwIpTcpWnd = 20000
      LwIpStats = 1
  module config EthIf: implementation-config-variant=VARIANT-PRE-COMPILE, module-description=EthIf
    EthIfConfigSet
      EthIfController: EthIfCtrlIdx=, EthIfCtrlMtu=1500, EthIfMaxTxBufsTotal=2, EthIfEthCtrlRef=EthCtrlConfig
      EthIfFrameOwnerConfig1 (EthIfFrameOwnerConfig): EthIfFrameType=2048, EthIfOwner=, ArcEthIfRxIndication=EthIfRxIndicationConfig1
      EthIfRxIndicationConfig1 (EthIfRxIndicationConfig): EthIfRxIndicationFunction=TcpIp_RxIndication
      EthIfTrcvLinkStateChgConfig: EthIfTrcvLinkStateChgFunction=
      EthIfRxIndicationConfig2 (EthIfRxIndicationConfig): EthIfRxIndicationFunction=TcpIp_RxIndication
      EthIfFrameOwnerConfig2 (EthIfFrameOwnerConfig): EthIfFrameType=2054, EthIfOwner=, ArcEthIfRxIndication=EthIfRxIndicationConfig2
    EthIfGeneral:
      EthIfDevErrorDetect = 1
      EthIfEnableRxInterrupt = 1
      EthIfEnableTxInterrupt = 1
      EthIfGetBaudRate = 0
      EthIfGetCounterState = 0
      EthIfGlobalTimeSupport = 0
      EthIfMainFunctionPeriod = 0.01
      EthIfMaxTrcvsTotal = 1
      EthIfStartAutoNegotiation = 0
      EthIfTrcvLinkStateChgMainReload = 2
      EthIfVersionInfoApi = 1
      EthIfVersionInfoApiMacro = 1
      EthIfWakeUpSupport = false
      EthIfRxIndicationIterations = 1
      ArcEthIfMaxFrameOwnerConfig = 5
  module config CddEthTrcv: implementation-config-variant=VARIANT-PRE-COMPILE, module-description=CddEthTrcv
    EthTrcvConfigSet
    EthTrcvGeneral: EthTrcvAutoNegotiate=false, EthTrcvAutoFindAddress=true
  module config EcuM: implementation-config-variant=VARIANT-PRE-COMPILE, module-description=EcuM
    EcuMConfiguration
      EcuMCommonConfiguration: EcuMConfigConsistencyHash=, EcuMDefaultAppMode=(unset), EcuMOSResource=(unset)
        EcuMDefaultShutdownTarget: EcuMDefaultState=EcuMStateOff
        EcuMSleepMode: EcuMSleepModeId=, EcuMSleepModeSuspend=, EcuMSleepModeMcuModeRef=SLEEP, EcuMWakeupSourceMask=EcuMWakeupSource
        EcuMWakeupSource: EcuMWakeupSourceId=, EcuMWakeupSourcePolling=false, EcuMResetReasonRef=(unset)
      EcuMFixedConfiguration:
        EcuMNvramReadallTimeout = 10.0
        EcuMNvramWriteallTimeout = 10.0
        EcuMRunMinimumDuration = 10.0
        EcuMNormalMcuModeRef = NORMAL
        EcuMComMCommunicationAllowedList = ComMChannel
        EthernetUser (EcuMFixedUserConfig): EcuMFixedUser=
    EcuMGeneral: EcuMDevErrorDetect=false, EcuMIncludeDem=false, EcuMIncludeDet=false, EcuMMainFunctionPeriod=0.01, EcuMVersionInfoApi=false
  module config Mcu: implementation-config-variant=VARIANT-PRE-COMPILE, module-description=Mcu
    McuGeneralConfiguration: McuDevErrorDetect=true, McuGetRamStateApi=false, McuInitClock=true, McuNoPll=false, McuPerformResetApi=false, McuVersionInfoApi=false
    McuModuleConfiguration: McuClockSrcFailureNotification=DISABLED, McuNumberOfMcuModes=, McuRamSectors=, ArcDefaultClockRef=McuClockSettingConfig
      McuClockSettingConfig: McuClockSettingId=
        McuClockReferencePoint: Frequency=, McuClockReferencePointFrequency=40000000
        ArcPLLSettings: PLL0_PREDIV=5, PLL0_MFD=60, PLL0_RFDPHI=3, PLL1_MFD=30, PLL1_RFDPHI=3, PLL1FM_MODPRD=0, PLL1FM_INCSTP=0, PLL1FM_MODEN=false
      3 x McuModeSettingConf, all with McuMode=:
        RUN
        NORMAL
        SLEEP
    McuPublishedInformation
      McuResetReasonConf: McuResetReason=
  module config Port: implementation-config-variant=VARIANT-PRE-COMPILE, module-description=Port
    PortConfigSet
      4 x PortContainer, all with PortNumberOfPortPins=:
        GPIO
          SIU_A_GPIO_446 (PortPin):
            PortPinDirection = PORT_PIN_OUT
            PortPinDirectionChangeable = 1
            PortPinId = 446
            PortPinInitialMode = PORT_PIN_MODE_DIO
            PortPinLevelValue = PORT_PIN_LEVEL_LOW
            PortPinMode = PORT_PIN_MODE_None
            PortPinModeChangeable = 1
            ArcPortPinPull = PORT_PIN_PULL_NONE
            ArcPortPinSlewRate = PORT_PIN_SLEW_RATE_MED
            ArcPortPinOpenDrainEnable = false
          SIU_A_GPIO_447 (PortPin):
            PortPinDirection = PORT_PIN_IN
            PortPinDirectionChangeable = 1
            PortPinId = 447
            PortPinInitialMode = PORT_PIN_MODE_DIO
            PortPinLevelValue = PORT_PIN_LEVEL_LOW
            PortPinMode = PORT_PIN_MODE_None
            PortPinModeChangeable = 1
            ArcPortPinPull = PORT_PIN_PULL_NONE
            ArcPortPinSlewRate = PORT_PIN_SLEW_RATE_MED
            ArcPortPinOpenDrainEnable = false
        CAN
          FlexCAN_A_CNTXA (PortPin):
            PortPinDirection = PORT_PIN_OUT
            PortPinDirectionChangeable = 0
            PortPinId = 83
            PortPinInitialMode = PORT_PIN_MODE_CAN
            PortPinLevelValue = PORT_PIN_LEVEL_LOW
            PortPinMode = PORT_PIN_MODE_None
            PortPinModeChangeable = 0
            ArcPortPinPull = PORT_PIN_PULL_NONE
            ArcPortPinSlewRate = PORT_PIN_SLEW_RATE_MAX
            ArcPortPinOpenDrainEnable = 0
        ETH
          10 x PortPin, all with PortPinInitialMode=PORT_PIN_MODE_ETH, PortPinLevelValue=PORT_PIN_LEVEL_LOW, PortPinMode=PORT_PIN_MODE_ETH, PortPinModeChangeable=0, ArcPortPinPull=PORT_PIN_PULL_NONE, ArcPortPinOpenDrainEnable=false:
            FEC_FEC_TXD0: PortPinDirection=PORT_PIN_OUT, PortPinDirectionChangeable=0, PortPinId=248, ArcPortPinSlewRate=PORT_PIN_SLEW_RATE_MAX
            FEC_FEC_RX_DV: PortPinDirection=PORT_PIN_IN, PortPinDirectionChangeable=0, PortPinId=249, ArcPortPinSlewRate=PORT_PIN_SLEW_RATE_MAX
            FEC_FEC_RXD0: PortPinDirection=PORT_PIN_IN, PortPinDirectionChangeable=0, PortPinId=250, ArcPortPinSlewRate=PORT_PIN_SLEW_RATE_MAX
            FEC_FEC_TXD1: PortPinDirection=PORT_PIN_OUT, PortPinDirectionChangeable=0, PortPinId=251, ArcPortPinSlewRate=PORT_PIN_SLEW_RATE_MAX
            FEC_FEC_TXEN: PortPinDirection=PORT_PIN_OUT, PortPinDirectionChangeable=0, PortPinId=252, ArcPortPinSlewRate=PORT_PIN_SLEW_RATE_MAX
            FEC_FEC_RXD1: PortPinDirection=PORT_PIN_IN, PortPinDirectionChangeable=0, PortPinId=253, ArcPortPinSlewRate=PORT_PIN_SLEW_RATE_MAX
            FEC_FEC_MDC: PortPinDirection=PORT_PIN_OUT, PortPinDirectionChangeable=0, PortPinId=109, ArcPortPinSlewRate=PORT_PIN_SLEW_RATE_MAX
            FEC_FEC_MDIO_OUT: PortPinDirection=PORT_PIN_OUT, PortPinDirectionChangeable=1, PortPinId=99, ArcPortPinSlewRate=PORT_PIN_SLEW_RATE_MAX
            FEC_FEC_MDIO: PortPinDirection=PORT_PIN_IN, PortPinDirectionChangeable=1, PortPinId=99, ArcPortPinSlewRate=PORT_PIN_SLEW_RATE_MAX
            FEC_FEC_TXCLK_REFCLK: PortPinDirection=PORT_PIN_IN, PortPinDirectionChangeable=0, PortPinId=474, ArcPortPinSlewRate=PORT_PIN_SLEW_RATE_MIN
        LED
          LED1 (PortPin):
            PortPinDirection = PORT_PIN_OUT
            PortPinDirectionChangeable = 0
            PortPinId = 156
            PortPinInitialMode = PORT_PIN_MODE_DIO
            PortPinLevelValue = PORT_PIN_LEVEL_HIGH
            PortPinMode = PORT_PIN_MODE_DIO
            PortPinModeChangeable = 0
            ArcPortPinPull = PORT_PIN_PULL_NONE
            ArcPortPinSlewRate = PORT_PIN_SLEW_RATE_MAX
            ArcPortPinOpenDrainEnable = false
          LED2 (PortPin):
            PortPinDirection = PORT_PIN_OUT
            PortPinDirectionChangeable = 0
            PortPinId = 157
            PortPinInitialMode = PORT_PIN_MODE_DIO
            PortPinLevelValue = PORT_PIN_LEVEL_LOW
            PortPinMode = PORT_PIN_MODE_DIO
            PortPinModeChangeable = 0
            ArcPortPinPull = PORT_PIN_PULL_NONE
            ArcPortPinSlewRate = PORT_PIN_SLEW_RATE_MAX
            ArcPortPinOpenDrainEnable = false
    PortGeneral: PortDevErrorDetect=true, PortSetPinDirectionApi=true, PortSetPinModeApi=true, PortVersionInfoApi=true
  module config Dio: implementation-config-variant=VARIANT-PRE-COMPILE, module-description=Dio
    DioConfig
      DioPort: DioPortId=5
        4 x DioChannel:
          DioChannel_446: DioChannelId=446
          DioChannel_447: DioChannelId=447
          LED1: DioChannelId=156
          LED2: DioChannelId=157
    DioGeneral: DioDevErrorDetect=true, DioFlipChannelApi=, DioVersionInfoApi=true
  module config Eth: implementation-config-variant=VARIANT-PRE-COMPILE, module-description=Eth
    EthConfigSet
      EthCtrlConfig:
        EthCtrlEnableMii = 1
        EthCtrlEnableRxInterrupt = 1
        EthCtrlEnableTxInterrupt = 1
        EthCtrlIdx = 0
        EthCtrlRxBufLenByte = 1522
        EthCtrlTxBufLenByte = 1522
        EthRxBufTotal = 25
        EthTxBufTotal = 3
        ArcEthControllerHwMIIMode = RMII
        ArcEthControllerHwSpeed = MBPS_100
        ArcEthControllerHwUnit = HWUNIT_0
        ArcEthCtrlDiscardRxFCS = true
        ArcEthCtrlEnableRxChecksumOffload = true
        ArcEthCtrlEnableTxChecksumOffload = true
        ArcEthCtrlRxDMAChannel = 
        ArcEthCtrlRxQueueValue = 
        ArcEthCtrlTxDMAChannel = 
        ArcEthCtrlTxQueueValue = 
        ArcEthFifoPrio = 
        ArcEthCtrlEnableCircDesc = 0
        EthCtrlPhyAddress = 00-00-00-00-00-02
    EthGeneral:
      EthDevErrorDetect = 1
      EthGetDropCountApi = 
      EthGetEtherStatsApi = 
      EthGlobalTimeSupport = 
      EthIndex = 
      EthMainFunctionPeriod = 0.1
      EthMaxCtrlsSupported = 
      EthUpdatePhysAddrFilter = true
      EthVersionInfoApi = 1
      ArcEthCpu1xclkValue = 
      ArcEthSoftReset = false
      EthCtrlOffloading: EthCtrlEnableOffloadChecksumICMP=, EthCtrlEnableOffloadChecksumIPv4=, EthCtrlEnableOffloadChecksumTCP=, EthCtrlEnableOffloadChecksumUDP=
