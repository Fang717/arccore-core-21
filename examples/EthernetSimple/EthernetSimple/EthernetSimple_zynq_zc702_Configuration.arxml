AUTOSAR XML (schema 4-0-3)
package /EthernetSimple_Zynq_zc702_Ecu
  ecuc value collection EthernetSimple_zynq_zc702_Ecu: ecu-extract=EthernetSimple, ecuc-values=[Mcu, Port, Eth, Det, PduR, EcuC, Com, TcpIp, Xcp, EcuM, IoHwAb, Dio, Rte, Os, BswM, ComM, EthSM, Dlt, CddPduR, SoAd, EthIf, CddEthTrcv]
  module config Com: implementation-config-variant=VARIANT-POST-BUILD, module-description=Com
    ComConfig: ComConfigurationId=(unset)
      ComTimeBase: ComRxTimeBase=0.01, ComTxTimeBase=0.01
      IPDU_UDP6661_RX (ComIPdu):
        ComIPduDirection = RECEIVE
        ComIPduSignalProcessing = DEFERRED
        ComIPduTriggerTransmitCallout = NULL
        ComIPduType = 
        ComPduIdRef = PDU_UDP6661_RX
        ComIPduGroupRef = ComIPduGroupUDP
        ComIPduSignalRef = ComSignal_RxUDP
      ComIPduGroupUDP (ComIPduGroup): ComIPduGroupHandleId=(unset)
      IPDU_UDP6661_TX (ComIPdu):
        ComIPduDirection = SEND
        ComIPduSignalProcessing = DEFERRED
        ComIPduTriggerTransmitCallout = NULL
        ComIPduType = 
        ComPduIdRef = PDU_UDP6661_TX
        ComIPduGroupRef = ComIPduGroupUDP
        ComIPduSignalRef = ComSignal_TxUDP
        ComTxIPdu: ComTxIPduUnusedAreasDefault=0
          ComTxModeTrue
            ComTxMode: ComTxModeMode=DIRECT
      3 x ComSignal, all with ComBitPosition=0, ComHandleId=(unset):
        ComSignal_TxUDP: ComSignalEndianness=opaque, ComSignalType=UINT8_N, ComTransferProperty=TRIGGERED, ComSignalLength=250, ComFirstTimeout=4, ComTimeout=2
        ComSignal_RxUDP: ComSignalEndianness=opaque, ComSignalType=UINT8_N, ComSignalLength=250, ComFirstTimeout=5, ComTimeout=0
        AdcValue: ComSignalEndianness=LITTLE_ENDIAN, ComSignalType=SINT32, ComBitSize=32, ComSignalInitValue=52, ComTransferProperty=PENDING, ComFirstTimeout=8, ComTimeout=2
      ComIPduGroupTx (ComIPduGroup): ComIPduGroupHandleId=(unset)
    ComGeneral:
      ComSupportedIPduGroups = 4
      ComVersionInfoApi = 0
      ComSupportedIPdus = 20
      ComSupportedSignals = 40
      ComSupportedGroupSignals = 40
      ComRamBufferSize = 1500
      ArcMaxNumberOfSupportedIPduCounters = 10
  module config SoAd: implementation-config-variant=VARIANT-PRE-COMPILE, module-description=SoAd
    SoAdDoIpConfig:
      SoAdDoIpAliveCheckResponseTime = 0.5
      SoAdDoIpControlTimeout = (unset)
      SoAdDoIpGenericInactiveTime = 300
      SoAdDoIpHostNameOpt = 
      SoAdDoIpInitialInactiveTime = 2
      SoAdDoIpResponseTimeout = (unset)
      SoAdDoIpVidAnnounceInterval = 1
      SoAdDoIpVidAnnounceMaxWait = 1
      SoAdDoIpVidAnnounceMinWait = (unset)
      SoAdDoIpVidAnnounceNum = 3
      ArcDoIpMainFunctionPeriod = 0.005
      ArcDoIpNodeType = SOAD_DOIP_NODETYPE_NODE
      ArcDoIpMaxActiveTesterConnections = 1
      ArcDoIpLogicalAddress = 4097
      ArcSocketAnnouncementRef = SoAdSocketConnectionAnnBroadcast
      SoAdDoIpEid
        6 x SoAdDoIpEidByte, all with SoAdDoIpEidByteIndex=(unset), SoAdDoIpEidByteValue=(unset):
          SoAdDoIpEidByte{1..6}
    SoAdDoIpRoute: SoAdDoIpSourceAddress=(unset), SoAdDoIpTargetAddress=(unset), SoAdDoIpSocketConnectionRef=(unset)
    SoAdGeneral:
      SoAdBufferMemorySize = 1500
      SoAdCallbackApi = (unset)
      SoAdDevErrorDetect = 0
      SoAdDoIpActive = 1
      SoAdDoIpVersionInfoApi = 1
      SoAdIPv6AddressEnabled = (unset)
      SoAdMainFunctionPeriod = 0.005
      SoAdMaxOpenSockets = 5
      SoAdPollingInterval = 0.005
      SoAdSocketCount = (unset)
      SoAdTcpIpMainFunctionPeriod = 0.005
      SoAdTcpIpVersionInfoApi = 0
      SoAdUdpNmApiEnabled = (unset)
      SoAdVersionInfoApi = 1
      SoAdXcpApiEnabled = (unset)
      ArcDoIpPowerModeCallbackFunction = SoAd_DoIp_Arc_GetPowerMode
    SoAdPduRouteDcmTx (SoAdPduRoute):
      SoAdDestinationId = (unset)
      SoAdSourcePduId = (unset)
      SoAdSourceSduLength = 1000
      SoAdUserTxConfirmationUL = PduR
      SoAdDestinationSocketRef = SoAdSocketConnectionTcpDoip
      SoAdSourcePduRef = Dcm_Tx
    SoAdSocketConnectionAnnBroadcast (SoAdSocketConnection):
      SoAdAutosarConnector = DoIP
      SoAdPduHeaderEnable = (unset)
      SoAdPduProvideBufferEnable = 1
      SoAdResourceManagementEnable = 0
      SoAdSocketAutosarApi = (unset)
      SoAdSocketId = (unset)
      SoAdSocketLocalIpAddress = 
      SoAdSocketProtocol = UDP
      SoAdSocketRemoteIpAddress = 255.255.255.255
      SoAdSocketLocalPort = 0
      SoAdSocketRemotePort = 13400
    SoAdSocketRouteDcmRxTcp (SoAdSocketRoute):
      SoAdDestinationSduLength = 500
      SoAdSourceId = (unset)
      SoAdUserRxIndicationUL = PduR
      SoAdDestinationPduRef = Dcm_Rx
      SoAdSourceSocketRef = SoAdSocketConnectionTcpDoip
    ArcDoIpTester: ArcDoIpTesterSA=3712, ArcDoIpRoutingActivationRef=ArcDoIpRoutingActivation
    ArcDoIpTargetAddressDCM (ArcDoIpTargetAddress): ArcDoIpTargetAddressValue=4097, ArcDoIpPduRRxPduRef=Dcm_Tx, ArcDoIpPduRTxPduRef=Dcm_Rx
    ArcDoIpRoutingActivation: ArcDoIpRoutingActivationNumber=0, ArcDoIpTargetAddressRef=ArcDoIpTargetAddressDCM
    SoAdSocketRouteDcmRxUdp (SoAdSocketRoute):
      SoAdDestinationSduLength = 500
      SoAdSourceId = (unset)
      SoAdUserRxIndicationUL = PduR
      SoAdDestinationPduRef = Dcm_Rx
      SoAdSourceSocketRef = SoAdSocketConnectionUdpDoip
    3 x SoAdSocketConnection, all with SoAdPduHeaderEnable=(unset), SoAdResourceManagementEnable=0, SoAdSocketAutosarApi=(unset), SoAdSocketId=(unset), SoAdSocketLocalIpAddress=, SoAdSocketRemoteIpAddress=0.0.0.0, SoAdSocketRemotePort=0:
      SoAdSocketConnectionTcpDoip: SoAdAutosarConnector=DoIP, SoAdPduProvideBufferEnable=1, SoAdSocketProtocol=TCP, SoAdSocketLocalPort=13400
      SoAdSocketConnectionUdpDoip: SoAdAutosarConnector=DoIP, SoAdPduProvideBufferEnable=1, SoAdSocketProtocol=UDP, SoAdSocketLocalPort=13400
      SoAdSocketConnectionUDPXcp: SoAdAutosarConnector=Xcp, SoAdPduProvideBufferEnable=0, SoAdSocketProtocol=UDP, SoAdSocketLocalPort=13600
    SoAdPduRouteXcpTx (SoAdPduRoute):
      SoAdDestinationId = (unset)
      SoAdSourcePduId = (unset)
      SoAdSourceSduLength = 255
      SoAdUserTxConfirmationUL = Xcp
      SoAdDestinationSocketRef = SoAdSocketConnectionUDPXcp
      SoAdSourcePduRef = XCP_TX_PDU
    SoAdSocketRouteXcpRx (SoAdSocketRoute):
      SoAdDestinationSduLength = 255
      SoAdSourceId = (unset)
      SoAdUserRxIndicationUL = Xcp
      SoAdDestinationPduRef = XCP_RX_PDU
      SoAdSourceSocketRef = SoAdSocketConnectionUDPXcp
  module config Mcu: implementation-config-variant=VARIANT-PRE-COMPILE, module-description=Mcu
    McuGeneralConfiguration: McuDevErrorDetect=1, McuGetRamStateApi=1, McuInitClock=1, McuNoPll=0, McuPerformResetApi=1, McuVersionInfoApi=1
    McuModuleConfiguration: McuClockSrcFailureNotification=DISABLED, McuNumberOfMcuModes=(unset), McuRamSectors=(unset), ArcDefaultClockRef=Cpu667Mhz
      Cpu667Mhz (McuClockSettingConfig): McuClockSettingId=(unset)
        Crystal33Mhz (McuClockReferencePoint): McuClockReferencePointFrequency=33000000
        ArcPLLSettings: ARM_PLL_FDIV=40, ARM_PLL_LOCK_CNT=250, ARM_PLL_CP=2, ARM_PLL_RES=2, IO_PLL_FDIV=30, IO_PLL_LOCK_CNT=325, IO_PLL_CP=2, IO_PLL_RES=12
        ArcClockSettings:
          LQSPI_DIVISOR = 0
          GEM0_DIVISOR = 8
          SMC_DIVISOR = 0
          SDIO_DIVISOR = 0
          SPI_DIVISOR = 1
          CPU_DIVISOR = 2
          UART_DIVISOR = 0
          CAN_DIVISOR1 = 0
          PCAP_DIVISOR = 0
          GEM0_RCLK_ACT = 1
          CAN_DIVISOR = 0
          CAN_MIOCLK_CTRL = 0
          GEM0_DIVISOR1 = 5
          GEM1_DIVISOR = 0
          GEM1_DIVISOR1 = 0
          GEM1_RCLK_ACT = 0
          CAN_CLKACT = 0
          CAN_CLKACT1 = 0
          CPU_1XCLKACT = 1
          CPU_2XCLKACT = 1
          CPU_3OR2XCLKACT = 1
          CPU_6OR4XCLKACT = 1
          GEM0_CLKACT = 1
          GEM1_CLKACT = 0
          SPI_CLKACT = 0
          SPI_CLKACT1 = 0
          UART_CLKACT = 0
          UART_CLKACT1 = 0
          LQSPI_CLKACT = 0
          SDIO_CLKACT1 = 0
          SDIO_CLKACT = 0
          SMC_CLKACT = 0
          PCAP_CLKACT = 0
          CPU_PERI_CLKACT = 1
          GEM0_RCLK_CTRL = MIO
          GEM1_RCLK_CTRL = UNSET
          GEM0_RCLK_CLKACT = 1
          GEM1_RCLK_CLKACT = 0
      3 x McuModeSettingConf, all with McuMode=(unset):
        NORMAL
        SLEEP
        RUN
    McuPublishedInformation
      McuResetReasonConf: McuResetReason=(unset)
  module config Port: implementation-config-variant=VARIANT-PRE-COMPILE, module-description=Port
    PortConfigSet
      ETH (PortContainer): PortNumberOfPortPins=(unset)
        12 x PortPin, all with PortPinDirectionChangeable=0, PortPinLevelValue=PORT_PIN_LEVEL_LOW, PortPinModeChangeable=0, ArcPortPinDisableHstlInputBuffer=ENABLE_INPUT_BUFFER, ArcPortPinIOBufferType=LVCMOS18, ArcPortPinPull=DISABLE_PULLUP, ArcPortPinSlewRate=SLOW_CMOS_EDGE, PortPinInitialMode=PORT_PIN_MODE_ETHERNET, PortPinMode=PORT_PIN_MODE_ETHERNET:
          ETHERNET0_RXBIT0: PortPinDirection=PORT_PIN_IN, PortPinId=23
          ETHERNET0_RXBIT1: PortPinDirection=PORT_PIN_IN, PortPinId=24
          ETHERNET0_RXBIT2: PortPinDirection=PORT_PIN_IN, PortPinId=25
          ETHERNET0_RXBIT3: PortPinDirection=PORT_PIN_IN, PortPinId=26
          ETHERNET0_RXCLK: PortPinDirection=PORT_PIN_IN, PortPinId=22
          ETHERNET0_RXCTRL: PortPinDirection=PORT_PIN_IN, PortPinId=27
          ETHERNET0_TXBIT0: PortPinDirection=PORT_PIN_OUT, PortPinId=17
          ETHERNET0_TXBIT2: PortPinDirection=PORT_PIN_OUT, PortPinId=19
          ETHERNET0_TXBIT1: PortPinDirection=PORT_PIN_OUT, PortPinId=18
          ETHERNET0_TXBIT3: PortPinDirection=PORT_PIN_OUT, PortPinId=20
          ETHERNET0_TXCLK: PortPinDirection=PORT_PIN_OUT, PortPinId=16
          ETHERNET0_TXCTRL: PortPinDirection=PORT_PIN_OUT, PortPinId=21
      DIO (PortContainer): PortNumberOfPortPins=(unset)
        GPIO8 (PortPin):
          PortPinDirection = PORT_PIN_OUT
          PortPinDirectionChangeable = 0
          PortPinId = 8
          PortPinLevelValue = PORT_PIN_LEVEL_LOW
          PortPinModeChangeable = 0
          ArcPortPinDisableHstlInputBuffer = ENABLE_INPUT_BUFFER
          ArcPortPinIOBufferType = LVCMOS18
          ArcPortPinPull = DISABLE_PULLUP
          ArcPortPinSlewRate = SLOW_CMOS_EDGE
          PortPinInitialMode = PORT_PIN_MODE_DIO
          PortPinMode = PORT_PIN_MODE_DIO
        GPIO7 (PortPin):
          PortPinDirection = PORT_PIN_OUT
          PortPinDirectionChangeable = 0
          PortPinId = 7
          PortPinLevelValue = PORT_PIN_LEVEL_LOW
          PortPinModeChangeable = 0
          ArcPortPinDisableHstlInputBuffer = ENABLE_INPUT_BUFFER
          ArcPortPinIOBufferType = LVCMOS18
          ArcPortPinPull = DISABLE_PULLUP
          ArcPortPinSlewRate = SLOW_CMOS_EDGE
          PortPinInitialMode = PORT_PIN_MODE_DIO
          PortPinMode = PORT_PIN_MODE_DIO
    PortGeneral: PortDevErrorDetect=1, PortSetPinDirectionApi=1, PortSetPinModeApi=1, PortVersionInfoApi=1
  module config Eth: implementation-config-variant=VARIANT-PRE-COMPILE, module-description=Eth
    EthConfigSet
      EthCtrlConfig:
        EthCtrlEnableMii = 1
        EthCtrlEnableRxInterrupt = 1
        EthCtrlEnableTxInterrupt = 1
        EthCtrlIdx = 0
        EthCtrlRxBufLenByte = 1522
        EthCtrlTxBufLenByte = 1522
        EthRxBufTotal = 5
        EthTxBufTotal = 2
        ArcEthControllerHwUnit = HWUNIT_0
        ArcEthControllerHwSpeed = MBPS_100
        ArcEthCtrlEnableRxChecksumOffload = 1
        ArcEthCtrlEnableTxChecksumOffload = 1
        ArcEthCtrlDiscardRxFCS = 1
        EthCtrlPhyAddress = 00-00-00-00-00-02
        ArcEthControllerHwMIIMode = 
        ArcEthCtrlTxDMAChannel = 
        ArcEthCtrlRxDMAChannel = 
        ArcEthCtrlRxQueueValue = 
        ArcEthCtrlTxQueueValue = 
        ArcEthFifoPrio = 
        ArcEthCtrlEnableCircDesc = 
    EthGeneral:
      EthDevErrorDetect = 1
      EthIndex = (unset)
      EthMaxCtrlsSupported = (unset)
      EthUpdatePhysAddrFilter = true
      EthVersionInfoApi = 0
      ArcEthCpu1xclkValue = (unset)
      ArcEthSoftReset = false
      EthGetDropCountApi = 
      EthGetEtherStatsApi = 
      EthGlobalTimeSupport = 
      EthMainFunctionPeriod = 0.01
  module config EcuM: implementation-config-variant=VARIANT-PRE-COMPILE, module-description=EcuM
    EcuMConfiguration
      EcuMCommonConfiguration: EcuMConfigConsistencyHash=(unset), EcuMDefaultAppMode=(unset), EcuMOSResource=(unset)
        EcuMDefaultShutdownTarget: EcuMDefaultState=EcuMStateOff
        EcuMSleepMode: EcuMSleepModeId=(unset), EcuMSleepModeSuspend=(unset), EcuMSleepModeMcuModeRef=SLEEP, EcuMWakeupSourceMask=EcuMWakeupSource
        EcuMWakeupSource: EcuMWakeupSourceId=(unset), EcuMWakeupSourcePolling=0, EcuMResetReasonRef=(unset)
      EcuMFixedConfiguration:
        EcuMNvramReadallTimeout = 10.0
        EcuMNvramWriteallTimeout = 10.0
        EcuMRunMinimumDuration = 10.0
        EcuMNormalMcuModeRef = NORMAL
        EcuMComMCommunicationAllowedList = ComMChannel
        EthernetUser (EcuMFixedUserConfig): EcuMFixedUser=(unset)
    EcuMGeneral: EcuMDevErrorDetect=0, EcuMIncludeDem=0, EcuMIncludeDet=0, EcuMMainFunctionPeriod=0.01, EcuMVersionInfoApi=0
  module config IoHwAb: implementation-config-variant=VARIANT-PRE-COMPILE, module-description=IoHwAb
    ArcIoHwAbGeneral: ArcIoHwAbDevErrorDetect=1, ArcIoHwAbAnalogMaxVoltage=5.0, ArcIoHwAbUsePort=1, ArcIoHwCalibrationEnabled=0
    DigitalSignal_LED1 (ArcIoHwAbDigitalSignal):
      ArcIoHwAbDigitalDefaultValue = IOHWAB_HIGH
      ArcIoHwAbDigitalInverted = 0
      ArcIoHwAbDigitalMethod = IOHWAB_DIGITAL_WRITE
      ArcIoHwAbDigitalType = IOHWAB_DIO
      ArcIoHwAbDioChannelRef = LED1
    DigitalSignal_LED2 (ArcIoHwAbDigitalSignal):
      ArcIoHwAbDigitalDefaultValue = IOHWAB_HIGH
      ArcIoHwAbDigitalInverted = 0
      ArcIoHwAbDigitalMethod = IOHWAB_DIGITAL_WRITE
      ArcIoHwAbDigitalType = IOHWAB_DIO
      ArcIoHwAbDioChannelRef = LED2
    ArcIoHwAbScaling: ArcIoHwAbScalingOffset=0.0, ArcIoHwAbScalingScale=1.0, ArcIoHwAbScalingType=Volt
  module config Dio: implementation-config-variant=VARIANT-PRE-COMPILE, module-description=Dio
    DioConfig
      LED (DioPort): DioPortId=0
        LED1 (DioChannel): DioChannelId=10
        LED2 (DioChannel): DioChannelId=8
    DioGeneral: DioDevErrorDetect=1, DioFlipChannelApi=(unset), DioVersionInfoApi=0
  module config Os: implementation-config-variant=VARIANT-PRE-COMPILE, module-description=Os
    OsAppMode
    OsOS:
      OsScalabilityClass = SC1
      OsStackMonitoring = 1
      OsStatus = EXTENDED
      OsUseGetServiceId = 1
      OsUseParameterAccess = 1
      OsUseResScheduler = 1
      ArcOsTickFrequency = 1000
      ArcOsInterruptStackSize = 2048
      ArcOsIdleStackSize = 512
      ArcOsMaxIsr = 200
      OsHooks: OsErrorHook=1, OsPostTaskHook=0, OsPreTaskHook=0, OsShutdownHook=1, OsStartupHook=1
      ArcOsDebug: OsTaskDebug=0, OsAlarmDebug=0, OsResourceDebug=0, OsScheduleTableDebug=0, OsEventDebug=0, OsDebugActivated=0
    OsApplication:
      OsTrusted = 1
      OsAppAlarmRef = OsAlarmLWIPMain
      OsAppCounterRef = OsCounter
      OsAppTaskRef = MainLWIPTask
      OsAppTaskRef = OsStartupTask
      OsAppTaskRef = tcpip_task
      OsAppTaskRef = OsRteTask
      OsApplicationHooks: OsAppErrorHook=0, OsAppShutdownHook=0, OsAppStartupHook=0
    OsCounter: OsCounterMaxAllowedValue=255, OsCounterMinCycle=1, OsCounterTicksPerBase=(unset), OsCounterType=OS_TICK, OsCounterAccessingApplication=OsApplication
    OsAlarmLWIPMain (OsAlarm): OsAlarmCounterRef=OsCounter, OsAlarmAccessingApplication=OsApplication
      OsAlarmAction
        OsAlarmSetEvent: OsAlarmSetEventRef=LWIP_MAIN, OsAlarmSetEventTaskRef=MainLWIPTask
    MainLWIPTask (OsTask): OsTaskActivation=1, OsTaskPriority=1, OsTaskSchedule=FULL, ArcOsTaskStackSize=2048, OsTaskAccessingApplication=OsApplication, OsTaskEventRef=LWIP_MAIN
      OsTaskAutostart: OsTaskAppModeRef=(unset)
    OsStartupTask (OsTask):
      OsTaskActivation = 1
      OsTaskPriority = 1
      OsTaskSchedule = FULL
      ArcOsTaskStackSize = 2048
      OsTaskAccessingApplication = OsApplication
      OsTaskEventRef = OsEvent1
      OsTaskEventRef = OsEvent{10..19}
      OsTaskEventRef = OsEvent2
      OsTaskEventRef = OsEvent{20..25}
      OsTaskEventRef = OsEvent{3..9}
      OsTaskAutostart: OsTaskAppModeRef=(unset)
    26 x OsEvent:
      OsEvent1
      OsEvent25
      OsEvent24
      OsEvent23
      OsEvent22
      OsEvent21
      OsEvent20
      OsEvent19
      OsEvent18
      OsEvent17
      OsEvent16
      OsEvent15
      OsEvent14
      OsEvent13
      OsEvent12
      OsEvent11
      OsEvent10
      OsEvent9
      OsEvent8
      OsEvent7
      OsEvent6
      OsEvent5
      OsEvent4
      OsEvent3
      OsEvent2
      START_TCPIP
    tcpip_task (OsTask):
      OsTaskActivation = 1
      OsTaskPriority = 1
      OsTaskSchedule = FULL
      ArcOsTaskStackSize = 3072
      OsTaskEventRef = OsEvent1
      OsTaskEventRef = OsEvent{10..19}
      OsTaskEventRef = OsEvent2
      OsTaskEventRef = OsEvent{20..25}
      OsTaskEventRef = OsEvent{3..9}
      OsTaskEventRef = START_TCPIP
      OsTaskAutostart: OsTaskAppModeRef=(unset)
    4 x OsEvent:
      LWIP_MAIN
      OsRteEvent1
      OsRteEvent2
      ModeSwitchOsEvent
    OsRteTask (OsTask):
      OsTaskActivation = 2
      OsTaskPriority = 5
      OsTaskSchedule = FULL
      ArcOsTaskStackSize = 2048
      OsTaskEventRef = ModeSwitchOsEvent
      OsTaskEventRef = OsRteEvent1
      OsTaskEventRef = OsRteEvent2
      OsTaskAutostart: OsTaskAppModeRef=(unset)
