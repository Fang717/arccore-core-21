AUTOSAR XML (schema 4-0-1)
package /LinExample_MPC560x
  ecuc value collection MPC560x: ecuc-values=[Lin, Mcu, Port, LinIf, EcuC, LinSM, ComM, PduR, Os, Det, Com, EcuM]
  module config Lin: implementation-config-variant=VARIANT-PRE-COMPILE, module-description=Lin
    LinGeneral: LinDevErrorDetect=1, LinIndex=0, LinTimeoutDuration=128, LinVersionInfoApi=0
    LinGlobalConfig
      LinChannel1 (LinChannel): LinChannelBaudRate=19200, LinChannelId=0, LinChannelWakeupSupport=0, ArcLinHwChannel=0, LinClockRef=(unset)
  module config Mcu: implementation-config-variant=VARIANT-PRE-COMPILE, module-description=Mcu
    McuGeneralConfiguration: McuDevErrorDetect=0, McuGetRamStateApi=0, McuInitClock=1, McuNoPll=0, McuPerformResetApi=0, McuVersionInfoApi=0
    McuModuleConfiguration: McuClockSrcFailureNotification=DISABLED, McuNumberOfMcuModes=(unset), McuRamSectors=(unset), ArcDefaultClockRef=LinClockSettings
      LinClockSettings (McuClockSettingConfig): McuClockSettingId=(unset)
        PLLSettings: IDF=0, NDIV=64, ODF=2
        McuClockReferencePoint: Frequency=(unset), McuClockReferencePointFrequency=8000000.0
      RUN (McuModeSettingConf): McuMode=(unset)
      NORMAL (McuModeSettingConf): McuMode=(unset)
    McuPublishedInformation
      McuResetReasonConf: McuResetReason=(unset)
  module config Port: implementation-config-variant=VARIANT-PRE-COMPILE, module-description=Port
    PortConfigSet
      PortContainer: PortNumberOfPortPins=(unset)
        5 x PortPin, all with PortPinDirectionChangeable=0, PortPinLevelValue=PORT_PIN_LEVEL_LOW, PortPinModeChangeable=0, ArcPortPinPull=PORT_PIN_PULL_NONE, ArcPortPinOpenDrainEnable=0:
          LIN0TX: PortPinDirection=PORT_PIN_OUT, PortPinId=18, PortPinInitialMode=PORT_PIN_MODE_LIN, PortPinMode=, ArcPortPinSlewRate=PORT_PIN_SLEW_RATE_MIN
          LIN0RX: PortPinDirection=PORT_PIN_IN, PortPinId=19, PortPinInitialMode=PORT_PIN_MODE_LIN, PortPinMode=, ArcPortPinSlewRate=PORT_PIN_SLEW_RATE_MIN
          LIN1TX: PortPinDirection=PORT_PIN_OUT, PortPinId=38, PortPinInitialMode=PORT_PIN_MODE_LIN, PortPinMode=, ArcPortPinSlewRate=PORT_PIN_SLEW_RATE_MIN
          LIN1RX: PortPinDirection=PORT_PIN_IN, PortPinId=39, PortPinInitialMode=PORT_PIN_MODE_LIN, PortPinMode=, ArcPortPinSlewRate=PORT_PIN_SLEW_RATE_MIN
          GPIO68: PortPinDirection=PORT_PIN_OUT, PortPinId=68, PortPinInitialMode=PORT_PIN_MODE_DIO, PortPinMode=PORT_PIN_MODE_DIO, ArcPortPinSlewRate=PORT_PIN_SLEW_RATE_MAX
    PortGeneral: PortDevErrorDetect=0, PortSetPinDirectionApi=0, PortSetPinModeApi=0, PortVersionInfoApi=0
