AUTOSAR XML (schema 4-0-3)
package /OsSimple_stm32f3_discovery
  ecuc value collection MyEcu: ecuc-values=[EcuM, Os, Det, Mcu]
