AUTOSAR XML (schema 4-0-3)
package /OsSimple_mpc5606b
  ecuc value collection MyEcu: ecuc-values=[EcuM, Os, Mcu, Det]
