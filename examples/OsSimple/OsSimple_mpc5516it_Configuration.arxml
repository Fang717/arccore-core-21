AUTOSAR XML (schema 4-0-3)
package /os_simple_mpc5516it
  ecuc value collection os_simple_mpc5516it: ecuc-values=[EcuM, Os, Mcu, Det]
