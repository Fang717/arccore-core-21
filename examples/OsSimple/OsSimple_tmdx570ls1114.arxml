AUTOSAR XML (schema 4-0-3)
package /OsSimple_tmdx570ls12hdk
  ecuc value collection OsSimple_tms570ls1114: ecuc-values=[Os, Det, EcuM, Mcu]
