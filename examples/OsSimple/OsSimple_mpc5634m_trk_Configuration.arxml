AUTOSAR XML (schema 4-0-3)
package /os_simple_mpc5634m_trk
  ecuc value collection MyEcu: ecuc-values=[Det, EcuM, Os, Mcu]
  module config Os: implementation-config-variant=VARIANT-PRE-COMPILE, module-description=Os
    OsAppMode
    OsOS:
      OsScalabilityClass = SC1
      OsStackMonitoring = 1
      OsStatus = STANDARD
      OsUseGetServiceId = 1
      OsUseParameterAccess = 1
      OsUseResScheduler = 1
      ArcOsTickFrequency = 100
      ArcOsInterruptStackSize = 2048
      ArcOsIdleStackSize = 512
      ArcOsMaxIsr = 10
      OsHooks: OsErrorHook=1, OsPostTaskHook=0, OsPreTaskHook=0, OsShutdownHook=1, OsStartupHook=1
      ArcOsDebug: OsTaskDebug=0, OsAlarmDebug=0, OsResourceDebug=0, OsScheduleTableDebug=0, OsEventDebug=0, OsDebugActivated=0
