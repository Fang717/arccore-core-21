AUTOSAR XML (schema 4-0-3)
package /OsSimple_mpc5643l_spc56l
  ecuc value collection OsSimple_mpc5643l_spc56l: ecuc-values=[EcuM, Os, Det, Mcu]
