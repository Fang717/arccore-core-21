AUTOSAR XML (schema 4-0-3)
package /OsSimple_mpc5777m_mmb
  ecuc value collection OsSimple_mpc5777m_mmb: ecuc-values=[Os, Det, EcuM, Mcu]
