AUTOSAR XML (schema 4-0-3)
package /OsSimple_rh850f1h
  ecuc value collection OsSimple_rh850f1h: ecuc-values=[Os, Det, EcuM, Mcu]
