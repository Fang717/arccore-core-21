AUTOSAR XML (schema 4-0-3)
package /OsSimple_stm32_stm3210c
  ecuc value collection MyEcu: ecuc-values=[EcuM, Os, Det, Mcu]
