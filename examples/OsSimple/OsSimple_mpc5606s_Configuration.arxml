AUTOSAR XML (schema 4-0-3)
package /OsSimple_mpc5606s
  ecuc value collection MyEcu: ecuc-values=[Mcu, Os, Det, EcuM]
