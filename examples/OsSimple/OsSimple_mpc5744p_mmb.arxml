AUTOSAR XML (schema 4-0-3)
package /OsSimple_mpc5744p_mmb
  ecuc value collection OsSimple_mpc5744p_mmb: ecuc-values=[Os, Det, EcuM, Mcu]
