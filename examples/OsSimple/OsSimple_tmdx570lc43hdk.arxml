AUTOSAR XML (schema 4-0-3)
package /OsSimple_tmdx570lc43hdk
  ecuc value collection OsSimple_tmdx570lc43hdk: ecuc-values=[Os, Det, EcuM, Mcu]
