AUTOSAR XML (schema 4-0-3)
package /ARRoot
  ecuc value collection OsSimple_mpc5777c_mpc57xx_mb: ecuc-values=[EcuM, Os, Det, Mcu]
  module config EcuM: implementation-config-variant=VARIANT-PRE-COMPILE, module-description=EcuM
    EcuMConfiguration
      EcuMCommonConfiguration: EcuMConfigConsistencyHash=, EcuMDefaultAppMode=(unset), EcuMOSResource=(unset)
        EcuMDefaultShutdownTarget: EcuMDefaultState=EcuMStateOff
        EcuMSleepMode: EcuMSleepModeId=, EcuMSleepModeSuspend=, EcuMSleepModeMcuModeRef=SLEEP, EcuMWakeupSourceMask=EcuMWakeupSource
        EcuMWakeupSource: EcuMWakeupSourceId=, EcuMWakeupSourcePolling=false, EcuMResetReasonRef=(unset)
      EcuMFixedConfiguration: EcuMNvramReadallTimeout=10.0, EcuMNvramWriteallTimeout=10.0, EcuMRunMinimumDuration=10.0, EcuMNormalMcuModeRef=NORMAL
        user1 (EcuMFixedUserConfig): EcuMFixedUser=
    EcuMGeneral: EcuMDevErrorDetect=false, EcuMIncludeDem=false, EcuMIncludeDet=false, EcuMMainFunctionPeriod=0.2, EcuMVersionInfoApi=false
  module config Os: implementation-config-variant=VARIANT-PRE-COMPILE, module-description=Os
    OsAppMode
    OsOS:
      OsScalabilityClass = SC1
      OsStackMonitoring = 1
      OsStatus = EXTENDED
      OsUseGetServiceId = 1
      OsUseParameterAccess = 1
      OsUseResScheduler = 1
      ArcOsTickFrequency = 1000
      ArcOsInterruptStackSize = 2048
      ArcOsIdleStackSize = 512
      ArcOsMaxIsr = 10
      ArcSafetyPlatform = false
      OsHooks: OsErrorHook=1, OsPostTaskHook=1, OsPreTaskHook=1, OsShutdownHook=1, OsStartupHook=1
      ArcOsDebug: OsTaskDebug=0, OsAlarmDebug=0, OsResourceDebug=0, OsScheduleTableDebug=0, OsEventDebug=0, OsDebugActivated=0
    OsApplication1 (OsApplication): OsTrusted=1, OsAppCounterRef=Counter1, OsAppAlarmRef=Alarm1, OsAppTaskRef=eTask1, OsAppTaskRef=eTask2, OsAppTaskRef=bTask3
      OsApplicationHooks: OsAppErrorHook=0, OsAppShutdownHook=0, OsAppStartupHook=0
    Counter1 (OsCounter): OsCounterMaxAllowedValue=(unset), OsCounterMinCycle=1, OsCounterTicksPerBase=(unset), OsCounterType=OS_TICK
    Alarm1 (OsAlarm): OsAlarmCounterRef=Counter1
      OsAlarmAction
        OsAlarmSetEvent: OsAlarmSetEventRef=Event1, OsAlarmSetEventTaskRef=eTask1
      OsAlarmAutostart: OsAlarmAlarmTime=100, OsAlarmAutostartType=RELATIVE, OsAlarmCycleTime=100, OsAlarmAppModeRef=(unset)
    Event1 (OsEvent): OsEventMask=1
    Event2 (OsEvent): OsEventMask=1
    3 x OsTask, all with OsTaskPriority=1, OsTaskSchedule=FULL, ArcOsTaskStackSize=2048:
      eTask1: OsTaskActivation=2, OsTaskEventRef=Event1
        OsTaskAutostart: OsTaskAppModeRef=(unset)
      eTask2: OsTaskActivation=2, OsTaskEventRef=Event2
        OsTaskAutostart: OsTaskAppModeRef=(unset)
      bTask3: OsTaskActivation=1
  module config Det: implementation-config-variant=VARIANT-PRE-COMPILE, module-description=Det
    DetGeneral:
      DetVersionInfoApi = 0
      DetUseRamlog = 1
      DetEnableCallbacks = 0
      DetWrapRamlog = 1
      DetUseStdErr = 0
      DetDeInitAPI = 0
      DetNumberOfCallbacks = 5
      DetRamlogSize = 16
      DetUseSafetyMonitor = false
  module config Mcu: implementation-config-variant=VARIANT-PRE-COMPILE, module-description=Mcu
    McuGeneralConfiguration: McuDevErrorDetect=true, McuGetRamStateApi=false, McuInitClock=true, McuNoPll=false, McuPerformResetApi=false, McuVersionInfoApi=false
    McuModuleConfiguration: McuClockSrcFailureNotification=DISABLED, McuNumberOfMcuModes=, McuRamSectors=, ArcDefaultClockRef=McuClockSettingConfig
      McuClockSettingConfig: McuClockSettingId=
        McuClockReferencePoint: Frequency=, McuClockReferencePointFrequency=40000000
        ArcPLLSettings: PLL0_PREDIV=5, PLL0_MFD=60, PLL0_RFDPHI=3, PLL1_MFD=30, PLL1_RFDPHI=3, PLL1FM_MODPRD=0, PLL1FM_INCSTP=0, PLL1FM_MODEN=false
      3 x McuModeSettingConf, all with McuMode=:
        RUN
        NORMAL
        SLEEP
    McuPublishedInformation
      McuResetReasonConf: McuResetReason=
