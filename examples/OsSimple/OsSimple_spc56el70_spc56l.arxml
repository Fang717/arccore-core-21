AUTOSAR XML (schema 4-0-3)
package /OsSimple_spc56el70_spc56l
  ecuc value collection OsSimple_spc56el70_spc56l: ecuc-values=[EcuM, Os, Det, Mcu]
