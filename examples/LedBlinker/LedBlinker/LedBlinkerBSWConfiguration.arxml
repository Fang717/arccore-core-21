AUTOSAR XML (schema 4-2-2)
package /LedBlinkerBSWConfiguration
  ecuc value collection LedBlinkerBSWConfiguration: ecu-extract=LedBlinkerEcuExtract, ecuc-values=[Port, Dio, IoHwAb, Com, Det, EcuC, PduR, EcuM, Mcu, Os, Rte]
  module config Port: implementation-config-variant=VARIANT-PRE-COMPILE, module-description=Port
    PortConfigSet
      LEDs (PortContainer): PortNumberOfPortPins=
        LED1 (PortPin):
          PortPinDirection = PORT_PIN_OUT
          PortPinDirectionChangeable = 
          PortPinId = 55
          PortPinInitialMode = 
          PortPinLevelValue = PORT_PIN_LEVEL_LOW
          PortPinMode = 
          PortPinModeChangeable = 
          ArcPortPinGpioMode = GPIO_OUTPUT_PUSHPULL_CNF
          ArcPortPinSlewRate = PORT_PIN_SLEW_RATE_MED
    PortGeneral: PortDevErrorDetect=false, PortSetPinDirectionApi=false, PortSetPinModeApi=false, PortVersionInfoApi=false
  module config Dio: implementation-config-variant=VARIANT-PRE-COMPILE, module-description=Dio
    DioConfig
      D (DioPort): DioPortId=3
        LED1 (DioChannel): DioChannelId=55
    DioGeneral: DioDevErrorDetect=false, DioFlipChannelApi=, DioVersionInfoApi=false
  module config IoHwAb: implementation-config-variant=VARIANT-PRE-COMPILE, module-description=IoHwAb
    ArcIoHwAbGeneral: ArcIoHwAbDevErrorDetect=false, ArcIoHwAbAnalogMaxVoltage=5.0, ArcIoHwAbUsePort=false, ArcIoHwCalibrationEnabled=false
    LED1 (ArcIoHwAbDigitalSignal):
      ArcIoHwAbDigitalDefaultValue = IOHWAB_LOW
      ArcIoHwAbDigitalInverted = false
      ArcIoHwAbDigitalMethod = IOHWAB_DIGITAL_WRITE
      ArcIoHwAbDigitalType = IOHWAB_DIO
      ArcIoHwAbDioChannelRef = D/LED1
  module config Com: implementation-config-variant=VARIANT-POST-BUILD, module-description=Com
    ComConfig: ComConfigurationId=
      ComTimeBase: ComRxTimeBase=1, ComTxTimeBase=1
    ComGeneral:
      ComSupportedIPduGroups = 4
      ComVersionInfoApi = false
      ComSupportedIPdus = 20
      ComSupportedSignals = 40
      ComSupportedGroupSignals = 40
      ComRamBufferSize = 150
      ArcMaxNumberOfSupportedIPduCounters = 10
      ArcComSupportedGatewaySourceDescriptions = 0
      ArcComOsekNmSupport = false
  module config Det: implementation-config-variant=VARIANT-PRE-COMPILE, module-description=Det
    DetGeneral:
      DetVersionInfoApi = false
      DetUseRamlog = true
      DetEnableCallbacks = false
      DetWrapRamlog = true
      DetUseStdErr = false
      DetDeInitAPI = false
      DetNumberOfCallbacks = 5
      DetRamlogSize = 16
      DetUseSafetyMonitor = false
  module config EcuC: implementation-config-variant=VARIANT-PRE-COMPILE, module-description=EcuC
    EcucPduCollection: PduIdTypeEnum=UINT16, PduLengthTypeEnum=UINT16
  module config PduR: implementation-config-variant=VARIANT-POST-BUILD, module-description=PduR
    PduRGeneral: PduRDevErrorDetect=true, PduRVersionInfoApi=false, PduRZeroCostOperation=false
    PduRRoutingTables: PduRConfigurationId=1, ArcPduRMaxRouteCount=30
    Com (PduRBswModules):
      PduRCancelReceive = false
      PduRCancelTransmit = 
      PduRChangeParameterRequestApi = 
      PduRCommunicationInterface = 
      PduRLowerModule = 0
      PduRRetransmission = 
      PduRTransportProtocol = 
      PduRTriggertransmit = 
      PduRTxConfirmation = 
      PduRUpperModule = 1
      PduRUseTag = 
      PduRBswModuleRef = (unset)
  module config EcuM: implementation-config-variant=VARIANT-PRE-COMPILE, module-description=EcuM
    EcuMConfiguration
      EcuMCommonConfiguration: EcuMConfigConsistencyHash=, EcuMDefaultAppMode=(unset), EcuMOSResource=(unset)
        EcuMDefaultShutdownTarget: EcuMDefaultState=EcuMStateOff
        EcuMSleepMode: EcuMSleepModeId=, EcuMSleepModeSuspend=, EcuMSleepModeMcuModeRef=SLEEP, EcuMWakeupSourceMask=EcuMWakeupSource
        EcuMWakeupSource: EcuMWakeupSourceId=, EcuMWakeupSourcePolling=false, EcuMResetReasonRef=(unset)
      EcuMFixedConfiguration: EcuMNvramReadallTimeout=10.0, EcuMNvramWriteallTimeout=10.0, EcuMRunMinimumDuration=10.0, EcuMNormalMcuModeRef=NORMAL
        User (EcuMFixedUserConfig): EcuMFixedUser=
    EcuMGeneral: EcuMDevErrorDetect=false, EcuMIncludeDem=false, EcuMIncludeDet=false, EcuMMainFunctionPeriod=0.2, EcuMVersionInfoApi=false
    EcuMFixedGeneral: EcuMIncludeComM=, EcuMIncludeNvM=, EcuMIncludeNvramMgr=, EcuMTTIIEnabled=, EcuMTTIIWakeupSourceRef=(unset)
  module config Mcu: implementation-config-variant=VARIANT-PRE-COMPILE, module-description=Mcu
    McuGeneralConfiguration: McuDevErrorDetect=true, McuGetRamStateApi=false, McuInitClock=true, McuNoPll=false, McuPerformResetApi=false, McuVersionInfoApi=false
    McuModuleConfiguration: McuClockSrcFailureNotification=DISABLED, McuNumberOfMcuModes=, McuRamSectors=, ArcDefaultClockRef=McuClockSettingConfig
      McuClockSettingConfig: McuClockSettingId=, ArcAPB2ClocksEnable=GPIOD
        McuClockReferencePoint: Frequency=, McuClockReferencePointFrequency=25E6
        PLLSettings72MHzOn25MHzOsc (PLLSettings): IDF=9, NDIV=8, ODF=0
      3 x McuModeSettingConf, all with McuMode=:
        NORMAL
        RUN
        SLEEP
    McuPublishedInformation
      McuResetReasonConf: McuResetReason=
  module config Os: implementation-config-variant=VARIANT-PRE-COMPILE, module-description=Os
    OsAppMode
    OsOS:
      OsScalabilityClass = SC1
      OsStackMonitoring = true
      OsStatus = EXTENDED
      OsUseGetServiceId = true
      OsUseParameterAccess = true
      OsUseResScheduler = true
      ArcOsTickFrequency = 1000
      ArcOsInterruptStackSize = 2048
      ArcOsIdleStackSize = 512
      ArcOsMaxIsr = 10
      ArcSafetyPlatform = false
      OsHooks: OsErrorHook=false, OsPostTaskHook=false, OsPreTaskHook=false, OsShutdownHook=false, OsStartupHook=false
      ArcOsDebug: OsTaskDebug=false, OsAlarmDebug=false, OsResourceDebug=false, OsScheduleTableDebug=false, OsEventDebug=false, OsDebugActivated=false
    OsRteCounter (OsCounter): OsCounterMaxAllowedValue=65535, OsCounterMinCycle=1, OsCounterTicksPerBase=, OsCounterType=OS_TICK
    OsRteAlarm1000ms (OsAlarm): OsAlarmCounterRef=OsRteCounter
      OsAlarmAction
        OsAlarmSetEvent: OsAlarmSetEventRef=OsRteEvent, OsAlarmSetEventTaskRef=OsRteTask
      OsAlarmAutostart: OsAlarmAlarmTime=100, OsAlarmAutostartType=RELATIVE, OsAlarmCycleTime=100, OsAlarmAppModeRef=(unset)
    OsRteEvent (OsEvent): OsEventMask=1
    OsRteTask (OsTask): OsTaskActivation=1, OsTaskPriority=1, OsTaskSchedule=FULL, ArcOsTaskStackSize=2048, OsTaskEventRef=OsRteEvent
      OsTaskAutostart: OsTaskAppModeRef=(unset)
    OsSLBApplication (OsApplication): OsTrusted=true, OsAppAlarmRef=OsRteAlarm1000ms, OsAppCounterRef=OsRteCounter, OsAppTaskRef=OsRteTask
      OsApplicationHooks: OsAppErrorHook=false, OsAppShutdownHook=false, OsAppStartupHook=false
  module config Rte: implementation-config-variant=VARIANT-PRE-COMPILE, module-description=Rte
    RteBswGeneral: RteSchMVersionInfoApi=, RteUseComShadowSignalApi=false
    RteGeneration:
      RteCalibrationSupport = NONE
      RteCodeVendorId = 
      RteDevErrorDetect = false
      RteDevErrorDetectUninit = false
      RteGenerationMode = COMPATIBILITY_MODE
      RteIocInteractionReturnValue = RTE_IOC
      RteMeasurementSupport = false
      RteOptimizationMode = RUNTIME
      RteValueRangeCheckEnabled = false
      RteVfbTraceEnabled = false
    RteInitializationBehavior: RteInitializationStrategy=, RteSectionInitializationPolicy=
    RteOsInteraction
    RtePostBuildVariantConfiguration: RtePostBuildUsedPredefinedVariant=(unset)
    ledBlinkerSWC (RteSwComponentInstance): RteSoftwareComponentInstanceRef=ledBlinkerSWC
      LedBlinkerSWCMain_timingEvent_0_1_OsRteTask (RteEventToTaskMapping): RteImmediateRestart=false, RteEventRef=LedBlinkerSWCMain_timingEvent_0_1, RteMappedToTaskRef=OsRteTask, RteUsedOsEventRef=OsRteEvent
    serviceIoHwAb (RteSwComponentInstance): RteSoftwareComponentInstanceRef=serviceIoHwAb
