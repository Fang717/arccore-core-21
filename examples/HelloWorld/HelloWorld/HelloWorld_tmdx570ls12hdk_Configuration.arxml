AUTOSAR XML (schema 4-3-0)
package /HelloWorld_tmdx570ls12hdk
  ecuc value collection HelloWorld: ecu-extract=HelloWorld, ecuc-values=[Mcu, CanIf, CanSM, Com, ComM, Det, EcuC, EcuM, Os, PduR, Rte, IoHwAb, CanTp, Dcm, Dem, Xcp, Adc, Can, Dio, Port, Pwm, BswM, Dlt, WdgIf, WdgM, Wdg, FiM]
  module config Adc: implementation-config-variant=VARIANT-PRE-COMPILE, module-description=Adc
    AdcConfigSet
      AdcHwUnit: AdcHwUnitId=ADC_CORE1, ArcAdcSamplingTime=2, AdcPrescale=8
        AdcChannel1 (AdcChannel): AdcChannelId=0, AdcChannelResolution=10
        AdcGroup1 (AdcGroup):
          AdcGroupAccessMode = ADC_ACCESS_MODE_SINGLE
          AdcGroupConversionMode = ADC_CONV_MODE_ONESHOT
          AdcGroupId = (unset)
          AdcGroupTriggSrc = ADC_TRIGG_SRC_SW
          AdcStreamingBufferMode = ADC_STREAM_BUFFER_LINEAR
          AdcStreamingNumSamples = 1
          AdcNotification = IoHwAb_AdcConversionComplete
          ArcAdcGroupSampTime = 4
          AdcGroupDefinition = AdcChannel1
    AdcGeneral:
      AdcDeInitApi = 1
      AdcDevErrorDetect = 1
      AdcEnableLimitCheck = (unset)
      AdcEnableQueuing = (unset)
      AdcEnableStartStopGroupApi = 1
      AdcGrpNotifCapability = 1
      AdcHwTriggerApi = 0
      AdcPriorityImplementation = ADC_PRIORITY_NONE
      AdcReadGroupApi = 1
      AdcResultAlignment = 
      AdcVersionInfoApi = 0
    AdcPublishedInformation: AdcChannelValueSigned=(unset), AdcGroupFirstChannelFixed=(unset), AdcMaxChannelResolution=(unset)
  module config Can: implementation-config-variant=VARIANT-PRE-COMPILE, module-description=Can
    CanConfigSet
      CanController0 (CanController):
        CanBusoffProcessing = 
        CanControllerActivation = 1
        CanControllerBaseAddress = (unset)
        CanControllerId = 0
        CanRxProcessing = 
        CanTxProcessing = 
        CanWakeupFunctionalityAPI = false
        CanWakeupProcessing = 
        CanWakeupSupport = (unset)
        ArcCanControllerHwUnit = 0
        CanControllerDefaultBaudrate = CanControllerBaudrateConfig
        CanCpuClockRef = (unset)
        CanControllerBaudrateConfig:
          CanControllerBaudRate = 500
          CanControllerBaudRateConfigID = 0
          CanControllerPropSeg = 8
          CanControllerSeg1 = 5
          CanControllerSeg2 = 2
          CanControllerSyncJumpWidth = (unset)
      Ctrl_0_Rx_0 (CanHardwareObject): CanHandleType=BASIC, CanIdType=STANDARD, CanObjectId=(unset), CanObjectType=RECEIVE, ArcCanFifoEnable=0, CanControllerRef=CanController0
        CanHwFilter: CanHwFilterCode=2, CanHwFilterMask=0
      Ctrl_0_Tx_0 (CanHardwareObject): CanHandleType=BASIC, CanIdType=STANDARD, CanObjectId=(unset), CanObjectType=TRANSMIT, ArcCanFifoEnable=0, CanControllerRef=CanController0
    CanGeneral:
      CanDevErrorDetection = 1
      CanHardwareCancellation = (unset)
      CanIdenticalIdCancellation = (unset)
      CanIndex = (unset)
      CanMainFunctionModePeriod = (unset)
      CanMultiplexedTransmission = (unset)
      CanTimeoutDuration = (unset)
      CanVersionInfoApi = 1
      CanCounterRef = (unset)
      CanSupportTTCANRef = (unset)
      CanMainFunctionRWPeriods
  module config Dio: implementation-config-variant=VARIANT-PRE-COMPILE, module-description=Dio
    DioConfig
      PORT_NHET (DioPort): DioPortId=2
        3 x DioChannel:
          LED1: DioChannelId=43
          LED2: DioChannelId=21
          LED_D3: DioChannelId=33
      PORT_A (DioPort): DioPortId=0
        Switch7 (DioChannel): DioChannelId=7
    DioGeneral: DioDevErrorDetect=1, DioFlipChannelApi=(unset), DioVersionInfoApi=1
  module config Port: implementation-config-variant=VARIANT-PRE-COMPILE, module-description=Port
    PortConfigSet
      PortContainer: PortNumberOfPortPins=5
        5 x PortPin, all with PortPinDirectionChangeable=0, PortPinLevelValue=PORT_PIN_LEVEL_LOW, PortPinModeChangeable=0, ArcPortPinPull=PORT_PIN_PULL_NONE, ArcPortPinSlewRate=PORT_PIN_SLEW_RATE_MIN, ArcPortPinOpenDrainEnable=0, ArcPortPadId=A5:
          N2HET1_05: PortPinDirection=PORT_PIN_OUT, PortPinId=31, PortPinInitialMode=PORT_PIN_MODE_DIO, PortPinMode=PORT_PIN_MODE_NHET, ArcPortSignalName=N2HET1_05
          N2HET1_27: PortPinDirection=PORT_PIN_OUT, PortPinId=4, PortPinInitialMode=PORT_PIN_MODE_DIO, PortPinMode=PORT_PIN_MODE_NHET, ArcPortSignalName=N2HET1_27
          ETPWM1A: PortPinDirection=PORT_PIN_OUT, PortPinId=14, PortPinInitialMode=PORT_PIN_MODE_PWM, PortPinMode=PORT_PIN_MODE_PWM, ArcPortSignalName=ETPWM1A
          GIOA_7: PortPinDirection=PORT_PIN_IN, PortPinId=11, PortPinInitialMode=PORT_PIN_MODE_DIO, PortPinMode=PORT_PIN_MODE_DIO, ArcPortSignalName=GIOA_7
          N2HET1_17: PortPinDirection=PORT_PIN_OUT, PortPinId=130, PortPinInitialMode=PORT_PIN_MODE_DIO, PortPinMode=PORT_PIN_MODE_NHET, ArcPortSignalName=N2HET1_17
    PortGeneral: PortDevErrorDetect=1, PortSetPinDirectionApi=0, PortSetPinModeApi=1, PortVersionInfoApi=0
  module config Pwm: implementation-config-variant=VARIANT-PRE-COMPILE, module-description=Pwm
    PwmChannelConfigSet
      Channel_LED_3 (PwmChannel):
        PwmChannelId = 1
        PwmDutycycleDefault = 16384
        PwmIdleState = PWM_LOW
        PwmPeriodDefault = 0.001
        PwmPolarity = PWM_HIGH
        ArcPwmDeadbandDelay = 0
        PwmChannelClass = PWM_FIXED_PERIOD
        PwmNotification = NotificationPwmCh1
    PwmConfigurationOfOptApiServices: PwmDeInitApi=0, PwmGetOutputState=0, PwmSetDutyCycle=1, PwmSetOutputToIdle=0, PwmSetPeriodAndDuty=0, PwmVersionInfoApi=0
    PwmGeneral: PwmDevErrorDetect=1, PwmDutycycleUpdatedEndperiod=1, PwmIndex=(unset), PwmNotificationSupported=1, PwmPeriodUpdatedEndperiod=1
  module config Wdg: implementation-config-variant=VARIANT-PRE-COMPILE, module-description=Wdg
    WdgGeneral: WdgDevErrorDetect=1, WdgDisableAllowed=, WdgIndex=, WdgInitialTimeout=, WdgMaxTimeout=, WdgRunArea=, WdgTriggerLocation=, WdgVersionInfoApi=0
    WdgPublishedInformation: WdgTriggerMode=
    WdgSettingsConfig: WdgDefaultMode=WDGIF_OFF_MODE, ArcWdgInterruptPeriodMs=100
      WdgSettingsSlow (WdgSettingsFast): ArcWdgWindowSizeFast=WDG_WINDOW_100, ArcWdgTimeoutFast=0.25
      WdgSettingsOff
