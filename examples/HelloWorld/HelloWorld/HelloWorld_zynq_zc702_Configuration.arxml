AUTOSAR XML (schema 4-3-0)
package /HelloWorld_zynq_zc702
  ecuc value collection HelloWorld: ecu-extract=HelloWorld
    ecuc-values:
      CanIf
      CanSM
      Com
      ComM
      Det
      EcuC
      EcuM
      Os
      PduR
      Rte
      IoHwAb
      BswM
      CanTp
      Dcm
      Dem
      Xcp
      Mcu
      Adc
      Can
      Dio
      Port
      Pwm
      Crc
      Ea
      Fee
      MemIf
      NvM
      Spi
      Dlt
      WdgIf
      WdgM
      Wdg
      FiM
  module config Adc: implementation-config-variant=VARIANT-PRE-COMPILE, module-description=Adc
    AdcConfigSet
      AdcHwUnit: AdcHwUnitId=XADC, AdcPrescale=20, ArcAdcLogiCoreIpAxiBaseAddr=1136656384, ArcAdcInterruptId=61
        AdcChannel1 (AdcChannel): AdcChannelId=(unset), ArcAdcChannelId=INTERNAL_TEMP, ArcAdcChannelSettlingTime=DEFAULT_FOUR_CYCLES, ArcAdcChannelAnalogInputMode=DEFAULT_UNIPOLAR
        AdcGroup1 (AdcGroup):
          AdcGroupAccessMode = ADC_ACCESS_MODE_SINGLE
          AdcGroupConversionMode = ADC_CONV_MODE_ONESHOT
          AdcGroupId = (unset)
          AdcGroupTriggSrc = ADC_TRIGG_SRC_SW
          AdcStreamingBufferMode = ADC_STREAM_BUFFER_LINEAR
          AdcStreamingNumSamples = 1
          AdcNotification = IoHwAb_AdcConversionComplete
          AdcGroupDefinition = AdcChannel1
    AdcGeneral:
      AdcDeInitApi = 1
      AdcDevErrorDetect = 1
      AdcEnableLimitCheck = (unset)
      AdcEnableQueuing = (unset)
      AdcEnableStartStopGroupApi = 1
      AdcGrpNotifCapability = 1
      AdcHwTriggerApi = 1
      AdcPriorityImplementation = ADC_PRIORITY_NONE
      AdcReadGroupApi = 1
      AdcResultAlignment = 
      AdcVersionInfoApi = 1
    AdcPublishedInformation: AdcChannelValueSigned=(unset), AdcGroupFirstChannelFixed=(unset), AdcMaxChannelResolution=(unset)
  module config Can: implementation-config-variant=VARIANT-PRE-COMPILE, module-description=Can
    CanConfigSet
      CanController0 (CanController):
        CanBusoffProcessing = INTERRUPT
        CanControllerActivation = 1
        CanControllerBaseAddress = (unset)
        CanControllerId = 0
        CanRxProcessing = INTERRUPT
        CanTxProcessing = INTERRUPT
        CanWakeupFunctionalityAPI = false
        CanWakeupProcessing = 
        CanWakeupSupport = (unset)
        ArcCanControllerHwUnit = CAN_CTRL_0
        ArcCanControllerLoopback = 0
        CanControllerDefaultBaudrate = CanControllerBaudrateConfig
        CanCpuClockRef = (unset)
        CanControllerBaudrateConfig:
          CanControllerBaudRate = 500
          CanControllerBaudRateConfigID = 0
          CanControllerPropSeg = 6
          CanControllerSeg1 = 6
          CanControllerSeg2 = 3
          CanControllerSyncJumpWidth = 2
      Ctrl_0_Rx_0 (CanHardwareObject): CanHandleType=BASIC, CanIdType=STANDARD, CanObjectId=0, CanObjectType=RECEIVE, ArcCanFifoEnable=0, CanControllerRef=CanController0
        CanHwFilter: CanHwFilterCode=0, CanHwFilterMask=0
      Ctrl_0_Tx_0 (CanHardwareObject): CanHandleType=BASIC, CanIdType=STANDARD, CanObjectId=1, CanObjectType=TRANSMIT, ArcCanFifoEnable=0, CanControllerRef=CanController0
    CanGeneral:
      CanDevErrorDetection = 1
      CanHardwareCancellation = 0
      CanIdenticalIdCancellation = (unset)
      CanIndex = (unset)
      CanMainFunctionModePeriod = (unset)
      CanMultiplexedTransmission = (unset)
      CanTimeoutDuration = (unset)
      CanVersionInfoApi = 1
      CanCounterRef = (unset)
      CanSupportTTCANRef = (unset)
      CanMainFunctionRWPeriods
  module config Dio: implementation-config-variant=VARIANT-PRE-COMPILE, module-description=Dio
    DioConfig
      LED_PORT (DioPort): DioPortId=0
        LED1 (DioChannel): DioChannelId=8
        LED2 (DioChannel): DioChannelId=11
    DioGeneral: DioDevErrorDetect=1, DioFlipChannelApi=(unset), DioVersionInfoApi=0
  module config Port: implementation-config-variant=VARIANT-PRE-COMPILE, module-description=Port
    PortConfigSet
      4 x PortContainer, all with PortNumberOfPortPins=(unset):
        ICU
          MIO0_CH14 (PortPin):
            PortPinDirection = PORT_PIN_IN
            PortPinDirectionChangeable = 0
            PortPinId = 14
            PortPinLevelValue = PORT_PIN_LEVEL_LOW
            PortPinModeChangeable = (unset)
            ArcPortPinDisableHstlInputBuffer = ENABLE_INPUT_BUFFER
            ArcPortPinIOBufferType = LVCMOS33
            ArcPortPinPull = DISABLE_PULLUP
            ArcPortPinSlewRate = FAST_CMOS_EDGE
            PortPinInitialMode = PORT_PIN_MODE_ICU
            PortPinMode = 
          EMIO0_CH1 (PortPin):
            PortPinDirection = PORT_PIN_IN
            PortPinDirectionChangeable = 0
            PortPinId = 55
            PortPinLevelValue = PORT_PIN_LEVEL_LOW
            PortPinModeChangeable = (unset)
            ArcPortPinDisableHstlInputBuffer = ENABLE_INPUT_BUFFER
            ArcPortPinIOBufferType = LVCMOS33
            ArcPortPinPull = DISABLE_PULLUP
            ArcPortPinSlewRate = FAST_CMOS_EDGE
            PortPinInitialMode = PORT_PIN_MODE_ICU
            PortPinMode = 
        DIO
          3 x PortPin, all with PortPinDirection=PORT_PIN_OUT, PortPinDirectionChangeable=0, PortPinLevelValue=PORT_PIN_LEVEL_LOW, PortPinModeChangeable=(unset), ArcPortPinDisableHstlInputBuffer=ENABLE_INPUT_BUFFER, ArcPortPinIOBufferType=LVCMOS33, ArcPortPinPull=DISABLE_PULLUP, ArcPortPinSlewRate=FAST_CMOS_EDGE, PortPinInitialMode=PORT_PIN_MODE_DIO, PortPinMode=:
            MIO0_CH8: PortPinId=8
            EMIO0_CH0: PortPinId=54
            MIO0_CH11: PortPinId=11
        QSPI
          6 x PortPin, all with PortPinDirection=PORT_PIN_OUT, PortPinDirectionChangeable=0, PortPinLevelValue=PORT_PIN_LEVEL_LOW, PortPinModeChangeable=0, ArcPortPinDisableHstlInputBuffer=ENABLE_INPUT_BUFFER, ArcPortPinIOBufferType=LVCMOS18, ArcPortPinSlewRate=FAST_CMOS_EDGE, PortPinInitialMode=PORT_PIN_MODE_QSPI, PortPinMode=PORT_PIN_MODE_QSPI:
            QSPI0_CS: PortPinId=1, ArcPortPinPull=ENABLE_PULLUP
            QSPI0_IO0: PortPinId=2, ArcPortPinPull=DISABLE_PULLUP
            QSPI0_IO1: PortPinId=3, ArcPortPinPull=DISABLE_PULLUP
            QSPI0_IO2: PortPinId=4, ArcPortPinPull=DISABLE_PULLUP
            QSPI0_IO3: PortPinId=5, ArcPortPinPull=DISABLE_PULLUP
            QSPI0_SCLK: PortPinId=6, ArcPortPinPull=DISABLE_PULLUP
        CAN
          3 x PortPin, all with PortPinLevelValue=PORT_PIN_LEVEL_LOW, ArcPortPinDisableHstlInputBuffer=ENABLE_INPUT_BUFFER, ArcPortPinIOBufferType=LVCMOS18, ArcPortPinSlewRate=SLOW_CMOS_EDGE:
            CAN0_RXD: PortPinDirection=PORT_PIN_IN, PortPinDirectionChangeable=0, PortPinId=46, PortPinModeChangeable=0, ArcPortPinPull=ENABLE_PULLUP, PortPinInitialMode=PORT_PIN_MODE_CAN, PortPinMode=PORT_PIN_MODE_CAN
            CAN0_TXD: PortPinDirection=PORT_PIN_OUT, PortPinDirectionChangeable=0, PortPinId=47, PortPinModeChangeable=0, ArcPortPinPull=ENABLE_PULLUP, PortPinInitialMode=PORT_PIN_MODE_CAN, PortPinMode=PORT_PIN_MODE_CAN
            Can0_TcvrEn: PortPinDirection=PORT_PIN_OUT, PortPinDirectionChangeable=1, PortPinId=9, PortPinModeChangeable=(unset), ArcPortPinPull=DISABLE_PULLUP, PortPinInitialMode=PORT_PIN_MODE_DIO, PortPinMode=
    PortGeneral: PortDevErrorDetect=1, PortSetPinDirectionApi=1, PortSetPinModeApi=0, PortVersionInfoApi=1
  module config Pwm: implementation-config-variant=VARIANT-PRE-COMPILE, module-description=Pwm
    PwmChannelConfigSet
      Channel_LED_3 (PwmChannel):
        PwmChannelId = 3
        PwmDutycycleDefault = 16384
        PwmIdleState = PWM_LOW
        PwmPeriodDefault = 0.001
        PwmPolarity = PWM_HIGH
        PwmChannelClass = PWM_FIXED_PERIOD
        PwmNotification = TestChannel1_Notification
        ArcPwmChannelPrescaler = 0
    PwmConfigurationOfOptApiServices: PwmDeInitApi=0, PwmGetOutputState=0, PwmSetDutyCycle=1, PwmSetOutputToIdle=0, PwmSetPeriodAndDuty=0, PwmVersionInfoApi=0
    PwmGeneral: PwmDevErrorDetect=1, PwmDutycycleUpdatedEndperiod=(unset), PwmIndex=(unset), PwmNotificationSupported=0, PwmPeriodUpdatedEndperiod=(unset)
  module config Crc: implementation-config-variant=VARIANT-PRE-COMPILE, module-description=Crc
    CrcGeneral: Crc32Mode=CRC_32_TABLE, Crc16Mode=CRC_16_TABLE, Crc8H2FMode=CRC_8H2F_TABLE, Crc8Mode=CRC_8_TABLE, Crc32P4Mode=CRC_32P4_TABLE
  module config Ea: implementation-config-variant=VARIANT-PRE-COMPILE, module-description=Ea
    SwcMem_Block2 (EaBlockConfiguration): EaBlockNumber=1, EaBlockSize=8, EaImmediateData=0, EaNumberOfWriteCycles=(unset), EaDeviceIndex=(unset)
    EaGeneral: EaDevErrorDetect=1, EaIndex=0, EaPollingMode=(unset), EaSetModeSupported=true, EaVersionInfoApi=0, EaVirtualPageSize=8
    EaPublishedInformation: EaBlockOverhead=(unset), EaMaximumBlockingTime=(unset), EaPageOverhead=(unset)
  module config Fee: implementation-config-variant=VARIANT-PRE-COMPILE, module-description=Fee
    SwcMem_Block1 (FeeBlockConfiguration): FeeBlockNumber=1, FeeBlockSize=256, FeeImmediateData=(unset), FeeNumberOfWriteCycles=1, FeeDeviceIndex=(unset)
    FeeGeneral:
      FeeDevErrorDetect = 1
      FeeIndex = 0
      FeePollingMode = 1
      FeeSetModeSupported = (unset)
      FeeVersionInfoApi = 0
      FeeVirtualPageSize = 256
      ArcUseJobNotifications = 1
      ArcFeeBank1Size = 65536
      ArcFeeBank2Size = 65536
      ArcFeeBank1Offset = 0
      ArcFeeBank2Offset = 65536
    FeePublishedInformation: FeeBlockOverhead=(unset), FeeMaximumBlockingTime=(unset), FeePageOverhead=(unset)
  module config MemIf: implementation-config-variant=VARIANT-PRE-COMPILE, module-description=MemIf
    MemIfGeneral: MemIfDevErrorDetect=1, MemIfNumberOfDevices=2, MemIfVersionInfoApi=0
  module config NvM: implementation-config-variant=VARIANT-PRE-COMPILE, module-description=NvM
    SwcMem_Block1 (NvMBlockDescriptor):
      NvMBlockJobPriority = (unset)
      NvMBlockManagementType = NVM_BLOCK_NATIVE
      NvMBlockUseCrc = 1
      NvMBlockUseSyncMechanism = 0
      NvMBlockWriteProt = 0
      NvMBswMBlockStatusInformation = 0
      NvMMaxNumOfReadRetries = 0
      NvMMaxNumOfWriteRetries = (unset)
      NvMNvBlockBaseNumber = 1
      NvMNvBlockLength = 4
      NvMNvBlockNum = 1
      NvMNvramBlockIdentifier = 
      NvMNvramDeviceId = 1
      NvMResistantToChangedSw = (unset)
      NvMRomBlockNum = 0
      NvMStaticBlockIDCheck = 0
      NvMWriteBlockOnce = (unset)
      NvMWriteVerification = 0
      NvMWriteVerificationDataSize = 1
      NvMBlockCrcType = NVM_CRC32
      NvMSelectBlockForReadAll = 1
      NvMCalcRamBlockCrc = 1
      NvMRamBlockDataAddress = Rte_Pim_SwcMemType_SwcMem_PIM1
      NvMTargetBlockReference
        NvMFeeRef: NvMNameOfFeeBlock=Fee/SwcMem_Block1
    NvMCommon:
      NvMApiConfigClass = NVM_API_CONFIG_CLASS_3
      NvMBswMMultiBlockJobStatusInformation = 1
      NvMCompiledConfigId = (unset)
      NvMCrcNumOfBytes = (unset)
      NvMDatasetSelectionBits = 0
      NvMDevErrorDetect = 1
      NvMDrvModeSwitch = (unset)
      NvMDynamicConfiguration = (unset)
      NvMJobPrioritization = 0
      NvMPollingMode = 0
      NvMRepeatMirrorOperations = 0
      NvMSetRamBlockStatusApi = 1
      NvMSizeStandardJobQueue = 5
      NvMVersionInfoApi = 0
    SwcMem_Block2 (NvMBlockDescriptor):
      NvMBlockJobPriority = (unset)
      NvMBlockManagementType = NVM_BLOCK_NATIVE
      NvMBlockUseCrc = 1
      NvMBlockUseSyncMechanism = 0
      NvMBlockWriteProt = 0
      NvMBswMBlockStatusInformation = 0
      NvMMaxNumOfReadRetries = 0
      NvMMaxNumOfWriteRetries = (unset)
      NvMNvBlockBaseNumber = 2
      NvMNvBlockLength = 4
      NvMNvBlockNum = 1
      NvMNvramBlockIdentifier = 
      NvMNvramDeviceId = 1
      NvMResistantToChangedSw = (unset)
      NvMRomBlockNum = 0
      NvMStaticBlockIDCheck = 0
      NvMWriteBlockOnce = (unset)
      NvMWriteVerification = 0
      NvMWriteVerificationDataSize = 1
      NvMBlockCrcType = NVM_CRC32
      NvMTargetBlockReference
        NvMEaRef: NvMNameOfEaBlock=Ea/SwcMem_Block2
  module config Spi: implementation-config-variant=VARIANT-PRE-COMPILE, module-description=Spi
    SpiDriver
      CH_ADDR (SpiChannel): SpiChannelId=(unset), SpiChannelType=EB, SpiDataWidth=16, SpiEbMaxLength=64, SpiIbNBuffers=(unset), SpiTransferStart=MSB, SpiDefaultData=0
      JOB_CMD (SpiJob): SpiJobId=(unset), SpiJobPriority=0, SpiDeviceAssignment=device_1
        cmd (SpiChannelList): SpiChannelIndex=0, SpiChannelAssignment=CH_CMD
      SEQ_CMD (SpiSequence): SpiInterruptibleSequence=(unset), SpiSequenceId=(unset), SpiJobAssignment=JOB_CMD
      3 x SpiChannel, all with SpiChannelId=(unset), SpiChannelType=EB, SpiDataWidth=8, SpiIbNBuffers=(unset), SpiTransferStart=MSB:
        CH_CMD: SpiEbMaxLength=64
        CH_DATA: SpiEbMaxLength=64
        CH_WREN: SpiEbMaxLength=1, SpiDefaultData=6
      3 x SpiJob, all with SpiJobId=(unset), SpiDeviceAssignment=device_1:
        JOB_CMD2: SpiJobPriority=0
          cmd (SpiChannelList): SpiChannelIndex=0, SpiChannelAssignment=CH_CMD
          data (SpiChannelList): SpiChannelIndex=1, SpiChannelAssignment=CH_DATA
        JOB_DATA: SpiJobPriority=2
          3 x SpiChannelList:
            addr: SpiChannelIndex=1, SpiChannelAssignment=CH_ADDR
            cmd: SpiChannelIndex=0, SpiChannelAssignment=CH_CMD
            data: SpiChannelIndex=2, SpiChannelAssignment=CH_DATA
        JOB_WREN: SpiJobPriority=3
          wren (SpiChannelList): SpiChannelIndex=0, SpiChannelAssignment=CH_WREN
      3 x SpiSequence, all with SpiInterruptibleSequence=(unset), SpiSequenceId=(unset):
        SEQ_CMD2: SpiJobAssignment=JOB_CMD2
        SEQ_READ: SpiJobAssignment=JOB_DATA
        SEQ_WRITE: SpiJobAssignment=JOB_WREN, SpiJobAssignment=JOB_DATA
      device_1 (SpiExternalDevice):
        SpiBaudrate = 434027
        SpiCsIdentifier = 0
        SpiCsPolarity = 
        SpiDataShiftEdge = TRAILING
        SpiEnableCs = (unset)
        SpiHwUnit = CSIB0
        SpiShiftClockIdleLevel = HIGH
        SpiTimeClk2Cs = 0
        ArcSpiClkPh = 
        ArcSpiClkPol = 
        ArcSpiDAfter = 0
        ArcSpiDBtwn = 0
        ArcSpiDNss = 0
    SpiGeneral:
      SpiCancelApi = (unset)
      SpiChannelBuffersAllowed = (unset)
      SpiDevErrorDetect = 1
      SpiHwStatusApi = 1
      SpiInterruptibleSeqAllowed = (unset)
      SpiLevelDelivered = 2
      SpiSupportConcurrentSyncTransmit = (unset)
      SpiVersionInfoApi = 1
      SpiMainFunctionPeriod = 0.01
    SpiPublishedInformation: SpiMaxHwUnit=(unset)
  module config Wdg: implementation-config-variant=VARIANT-PRE-COMPILE, module-description=Wdg
    WdgGeneral: WdgDevErrorDetect=true, WdgDisableAllowed=false, WdgIndex=, WdgInitialTimeout=, WdgMaxTimeout=, WdgRunArea=, WdgTriggerLocation=, WdgVersionInfoApi=false
    WdgPublishedInformation: WdgTriggerMode=
    WdgSettingsConfig: WdgDefaultMode=WDGIF_SLOW_MODE, ArcWdgResetEnable=1
      WdgSettingsFast: ArcWdgFastTimeout=0.01
      WdgSettingsOff
      WdgSettingsSlow: ArcWdgSlowTimeout=1.0
