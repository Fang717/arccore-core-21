AUTOSAR XML (schema 4-3-0)
package /HelloWorld_Generic
  module config CanIf: implementation-config-variant=VARIANT-PRE-COMPILE, module-description=CanIf
    CanIfCtrlDrvCfg: CanIfCtrlDrvTxCancellation=0, CanIfCtrlDrvInitHohConfigRef=CanIfInitHohCfg, CanIfCtrlDrvNameRef=(unset)
      CanIfCtrlCfg: CanIfCtrlId=(unset), CanIfCtrlWakeupSupport=false, CanIfCtrlCanCtrlRef=CanController0
    CanIfDispatchCfg:
      CanIfDispatchUserConfirmPnAvailabilityName = 
      CanIfDispatchUserConfirmPnAvailabilityUL = 
      CanIfDispatchUserCtrlBusOffUL = CAN_SM
      CanIfDispatchUserCtrlModeIndicationUL = CAN_SM
    CanIfInitCfg: CanIfInitCfgSet=
      Tester01 (CanIfRxPduCfg):
        CanIfRxPduCanIdType = STANDARD_CAN
        CanIfRxPduDlc = 8
        CanIfRxPduId = (unset)
        CanIfRxPduReadData = false
        CanIfRxPduReadNotifyStatus = false
        CanIfRxPduCanId = 2
        CanIfRxPduUserRxIndicationUL = PDUR
        CanIfRxPduBswSchExclAreaIdRef = (unset)
        CanIfRxPduHrhIdRef = CanIfHrhCfg
        CanIfRxPduRef = EcucPduCollection/Tester01
      CASINE01 (CanIfTxPduCfg):
        CanIfTxPduCanId = 1
        CanIfTxPduCanIdType = STANDARD_CAN
        CanIfTxPduDlc = 8
        CanIfTxPduId = (unset)
        CanIfTxPduReadNotifyStatus = false
        CanIfTxPduType = STATIC
        CanIfTxPduUserTxConfirmationUL = PDUR
        CanIfTxPduBswSchExclAreaIdRef = (unset)
        CanIfTxPduBufferRef = CanIfBufferCfg
        CanIfTxPduRef = EcucPduCollection/Ecu01
      CanIfInitHohCfg: CanIfInitRefCfgSet=(unset)
        CanIfHrhCfg: CanIfHrhSoftwareFilter=1, CanIfHrhCanCtrlIdRef=CanIfCtrlCfg, CanIfHrhIdSymRef=Ctrl_0_Rx_0
        CanIfHthCfg: CanIfHthCanCtrlIdRef=CanIfCtrlCfg, CanIfHthIdSymRef=Ctrl_0_Tx_0
      CanIfBufferCfg: CanIfBufferSize=0, CanIfBufferHthRef=CanIfHthCfg
      DiagFunctionalRx (CanIfRxPduCfg):
        CanIfRxPduCanIdType = STANDARD_CAN
        CanIfRxPduDlc = 8
        CanIfRxPduId = (unset)
        CanIfRxPduReadData = 0
        CanIfRxPduReadNotifyStatus = 0
        CanIfRxPduCanId = 2047
        CanIfRxPduUserRxIndicationUL = CAN_TP
        CanIfRxPduBswSchExclAreaIdRef = (unset)
        CanIfRxPduHrhIdRef = CanIfHrhCfg
        CanIfRxPduRef = EcucPduCollection/DiagFunctionalRx
      DiagPhysicalRx (CanIfRxPduCfg):
        CanIfRxPduCanIdType = STANDARD_CAN
        CanIfRxPduDlc = 8
        CanIfRxPduId = (unset)
        CanIfRxPduReadData = 0
        CanIfRxPduReadNotifyStatus = 0
        CanIfRxPduCanId = 1843
        CanIfRxPduUserRxIndicationUL = CAN_TP
        CanIfRxPduBswSchExclAreaIdRef = (unset)
        CanIfRxPduHrhIdRef = CanIfHrhCfg
        CanIfRxPduRef = EcucPduCollection/DiagPhysicalRx
      DiagPhysicalTx (CanIfTxPduCfg):
        CanIfTxPduCanId = 1587
        CanIfTxPduCanIdType = STANDARD_CAN
        CanIfTxPduDlc = 8
        CanIfTxPduId = (unset)
        CanIfTxPduReadNotifyStatus = 0
        CanIfTxPduType = STATIC
        CanIfTxPduUserTxConfirmationUL = CAN_TP
        CanIfTxPduBswSchExclAreaIdRef = (unset)
        CanIfTxPduBufferRef = CanIfBufferCfg
        CanIfTxPduRef = EcucPduCollection/DiagPhysicalTx
      UUDT (CanIfTxPduCfg):
        CanIfTxPduCanId = 1696
        CanIfTxPduCanIdType = STANDARD_CAN
        CanIfTxPduDlc = 8
        CanIfTxPduId = (unset)
        CanIfTxPduReadNotifyStatus = 0
        CanIfTxPduType = STATIC
        CanIfTxPduUserTxConfirmationUL = PDUR
        CanIfTxPduBswSchExclAreaIdRef = (unset)
        CanIfTxPduBufferRef = CanIfBufferCfg
        CanIfTxPduRef = EcucPduCollection/DiagUUDT
      XCP_RX_PDU_CFG (CanIfRxPduCfg):
        CanIfRxPduCanIdType = STANDARD_CAN
        CanIfRxPduDlc = 8
        CanIfRxPduId = (unset)
        CanIfRxPduReadData = 0
        CanIfRxPduReadNotifyStatus = 0
        CanIfRxPduCanId = 1000
        CanIfRxPduUserRxIndicationUL = XCP
        CanIfRxPduBswSchExclAreaIdRef = (unset)
        CanIfRxPduHrhIdRef = CanIfHrhCfg
        CanIfRxPduRef = XCP_RX_PDU
      XCP_TX_PDU_CFG (CanIfTxPduCfg):
        CanIfTxPduCanId = 1001
        CanIfTxPduCanIdType = STANDARD_CAN
        CanIfTxPduDlc = 8
        CanIfTxPduId = (unset)
        CanIfTxPduReadNotifyStatus = 0
        CanIfTxPduType = STATIC
        CanIfTxPduUserTxConfirmationUL = XCP
        CanIfTxPduBswSchExclAreaIdRef = (unset)
        CanIfTxPduBufferRef = CanIfBufferCfg
        CanIfTxPduRef = XCP_TX_PDU
      SwcMemRxPdu (CanIfRxPduCfg):
        CanIfRxPduCanIdType = STANDARD_CAN
        CanIfRxPduDlc = 8
        CanIfRxPduId = (unset)
        CanIfRxPduReadData = 0
        CanIfRxPduReadNotifyStatus = 0
        CanIfRxPduCanId = 17
        CanIfRxPduUserRxIndicationUL = PDUR
        CanIfRxPduBswSchExclAreaIdRef = (unset)
        CanIfRxPduHrhIdRef = CanIfHrhCfg
        CanIfRxPduRef = SwcMem_Rx_CanIf
      SwcMemTxPdu (CanIfTxPduCfg):
        CanIfTxPduCanId = 16
        CanIfTxPduCanIdType = STANDARD_CAN
        CanIfTxPduDlc = 8
        CanIfTxPduId = (unset)
        CanIfTxPduReadNotifyStatus = 0
        CanIfTxPduType = STATIC
        CanIfTxPduUserTxConfirmationUL = PDUR
        CanIfTxPduBswSchExclAreaIdRef = (unset)
        CanIfTxPduBufferRef = CanIfBufferCfg
        CanIfTxPduRef = SwcMem_Tx_CanIf
      T1_RX_PDU_CFG (CanIfRxPduCfg):
        CanIfRxPduCanIdType = STANDARD_CAN
        CanIfRxPduDlc = 8
        CanIfRxPduId = (unset)
        CanIfRxPduReadData = 0
        CanIfRxPduReadNotifyStatus = 0
        CanIfRxPduCanId = 2000
        CanIfRxPduUserRxIndicationUL = CDD
        CanIfRxPduUserRxIndicationName = Arc_T1_Rx_Cbk
        CanIfRxPduBswSchExclAreaIdRef = (unset)
        CanIfRxPduHrhIdRef = CanIfHrhCfg
        CanIfRxPduRef = T1_RX_PDU
      T1_TX_PDU_CFG (CanIfTxPduCfg):
        CanIfTxPduCanId = 2001
        CanIfTxPduCanIdType = STANDARD_CAN
        CanIfTxPduDlc = 8
        CanIfTxPduId = (unset)
        CanIfTxPduReadNotifyStatus = 0
        CanIfTxPduType = STATIC
        CanIfTxPduUserTxConfirmationUL = CDD
        CanIfTxPduUserTxConfirmationName = Arc_T1_Tx_Cbk
        CanIfTxPduBswSchExclAreaIdRef = (unset)
        CanIfTxPduBufferRef = CanIfBufferCfg
        CanIfTxPduRef = T1_TX_PDU
    CanIfPrivateCfg: CanIfPrivateDlcCheck=1, CanIfPrivateSoftwareFilterType=LINEAR, CanIfSupportTTCAN=false
    CanIfPublicCfg:
      CanIfPublicCancelTransmitSupport = (unset)
      CanIfPublicChangeBaudrateSupport = false
      CanIfPublicDevErrorDetect = 1
      CanIfPublicHandleTypeEnum = 
      CanIfPublicMultipleDrvSupport = true
      CanIfPublicNumberOfCanHwUnits = 1
      CanIfPublicPnSupport = false
      CanIfPublicReadRxPduDataApi = false
      CanIfPublicReadRxPduNotifyStatusApi = false
      CanIfPublicReadTxPduNotifyStatusApi = false
      CanIfPublicSetDynamicTxIdApi = false
      CanIfPublicTxBuffering = 0
      CanIfPublicTxConfirmPollingSupport = (unset)
      CanIfPublicVersionInfoApi = 0
      CanIfPublicWakeupCheckValidSupport = false
      ArcCanIfPublicMaxNumberOfTxBuffers = 1
      ArcCanIfPublicTxBufferSize = 1
      ArcCanIfOsekNmSupport = false
      ArcCanIfCanFDSupport = false
  module config CanSM: implementation-config-variant=VARIANT-PRE-COMPILE, module-description=CanSM
    CanSMConfiguration: CanSMModeRequestRepetitionMax=254, CanSMModeRequestRepetitionTime=0.2
      CanSMManagerNetwork:
        CanSMBorCounterL1ToL2 = 10
        CanSMBorTimeL1 = 0.1
        CanSMBorTimeL2 = 0.1
        CanSMBorTimeTxEnsured = 0.2
        CanSMBorTxConfirmationPolling = (unset)
        CanSMComMNetworkHandleRef = ComMChannel
        CanSMController: CanSMControllerId=CanIfCtrlCfg
    CanSMGeneral: CanSMDevErrorDetect=1, CanSMMainFunctionTimePeriod=0.01, CanSMVersionInfoApi=0, CanSmChangeBaudrateApi=false
  module config Com: implementation-config-variant=VARIANT-PRE-COMPILE, module-description=Com
    ComConfig: ComConfigurationId=(unset)
      ComTimeBase: ComRxTimeBase=0.01, ComTxTimeBase=0.01
      rxsignal01 (ComSignal):
        ComBitPosition = 0
        ComHandleId = (unset)
        ComSignalEndianness = LITTLE_ENDIAN
        ComSignalType = UINT32
        ComBitSize = 32
        ComSystemTemplateSystemSignalRef = Rx01data1Mapping
      Tester01 (ComIPdu):
        ComIPduDirection = RECEIVE
        ComIPduSignalProcessing = DEFERRED
        ComIPduTriggerTransmitCallout = NULL
        ComIPduType = 
        ComPduIdRef = EcucPduCollection/Tester01
        ComIPduSignalRef = rxsignal01
        ComIPduGroupRef = ComIPduGroupRx
        ComIPduSignalRef = rxCmdSignal
      txsignal01 (ComSignal):
        ComBitPosition = 0
        ComHandleId = (unset)
        ComSignalEndianness = LITTLE_ENDIAN
        ComSignalType = UINT32
        ComBitSize = 32
        ComTransferProperty = PENDING
        ComSystemTemplateSystemSignalRef = Tx01data1Mapping
      Ecu01 (ComIPdu):
        ComIPduDirection = SEND
        ComIPduSignalProcessing = DEFERRED
        ComIPduTriggerTransmitCallout = 
        ComIPduType = 
        ComPduIdRef = EcucPduCollection/Ecu01
        ComIPduSignalRef = txsignal01
        ComIPduGroupRef = ComIPduGroupTx
        ComIPduSignalRef = AdcValue
        ComTxIPdu: ComTxIPduUnusedAreasDefault=0
          ComTxModeTrue
            ComTxMode: ComTxModeMode=PERIODIC, ComTxModeTimePeriod=0.1
      ComIPduGroupRx (ComIPduGroup): ComIPduGroupHandleId=(unset)
      ComIPduGroupTx (ComIPduGroup): ComIPduGroupHandleId=(unset)
      AdcValue (ComSignal):
        ComBitPosition = 32
        ComHandleId = (unset)
        ComSignalEndianness = LITTLE_ENDIAN
        ComSignalType = SINT32
        ComBitSize = 32
        ComSignalInitValue = 52
        ComTransferProperty = PENDING
        ComSystemTemplateSystemSignalRef = TxAdcdata1Mapping
      SwcMemRx (ComIPdu):
        ComIPduDirection = RECEIVE
        ComIPduSignalProcessing = IMMEDIATE
        ComIPduTriggerTransmitCallout = NULL
        ComIPduType = 
        ComPduIdRef = SwcMem_Rx_Com
        ComIPduGroupRef = ComIPduGroupRx
        ComIPduSignalRef = SwcMemRx_Request
        ComIPduSignalRef = SwcMemRx_BlockId
        ComIPduSignalRef = SwcMemRx_Data
      SwcMemTx (ComIPdu):
        ComIPduDirection = SEND
        ComIPduSignalProcessing = IMMEDIATE
        ComIPduTriggerTransmitCallout = NULL
        ComIPduType = 
        ComPduIdRef = SwcMem_Tx_Com
        ComIPduGroupRef = ComIPduGroupTx
        ComIPduSignalRef = SwcMemTx_Result
        ComIPduSignalRef = SwcMemTx_BlockId
        ComIPduSignalRef = SwcMemTx_Data
        ComTxIPdu: ComTxIPduUnusedAreasDefault=0
          ComTxModeTrue
            ComTxMode: ComTxModeMode=DIRECT
      7 x ComSignal, all with ComSignalEndianness=BIG_ENDIAN:
        SwcMemRx_BlockId: ComBitPosition=8, ComHandleId=(unset), ComSignalType=UINT8, ComSignalInitValue=0, ComBitSize=8, ComSystemTemplateSystemSignalRef=MemRxBlockIdMapping
        SwcMemRx_Request: ComBitPosition=0, ComHandleId=(unset), ComSignalType=UINT8, ComSignalInitValue=0, ComBitSize=8, ComNotification=Rte_COMCbk_SwcMemRx_Request, ComSystemTemplateSystemSignalRef=MemRxCmdMapping
        SwcMemRx_Data: ComBitPosition=40, ComHandleId=(unset), ComSignalType=UINT32, ComSignalInitValue=0, ComBitSize=32, ComSystemTemplateSystemSignalRef=MemRxPayloadMapping
        SwcMemTx_BlockId: ComBitPosition=8, ComHandleId=(unset), ComSignalType=UINT8, ComTransferProperty=PENDING, ComBitSize=8, ComSignalInitValue=0, ComSystemTemplateSystemSignalRef=MemTxBlockIdMapping
        SwcMemTx_Result: ComBitPosition=0, ComHandleId=(unset), ComSignalType=UINT8, ComTransferProperty=TRIGGERED, ComBitSize=8, ComSignalInitValue=0, ComSystemTemplateSystemSignalRef=MemTxResMapping
        SwcMemTx_Data: ComBitPosition=40, ComHandleId=(unset), ComSignalType=UINT32, ComTransferProperty=PENDING, ComBitSize=32, ComSignalInitValue=0, ComSystemTemplateSystemSignalRef=MemTxPayloadMapping
        rxCmdSignal: ComBitPosition=32, ComHandleId=, ComSignalType=UINT8, ComBitSize=8, ComSystemTemplateSystemSignalRef=Rx01CmdMapping
    ComGeneral:
      ComSupportedIPduGroups = 2
      ComVersionInfoApi = 0
      ComSupportedIPdus = 10
      ComSupportedSignals = 20
      ComSupportedGroupSignals = 0
      ComRamBufferSize = 1024
      ComConfigurationUseDet = 1
      ArcMaxNumberOfSupportedIPduCounters = 0
      ArcComSupportedGatewaySourceDescriptions = 0
      ArcComOsekNmSupport = false
      ArcComSignalGatewayEnable = 0
  module config ComM: implementation-config-variant=VARIANT-PRE-COMPILE, module-description=ComM
    ComMConfigSet
      ComMChannel:
        ComMBusType = COMM_BUS_TYPE_CAN
        ComMChannelId = (unset)
        ComMFullCommRequestNotificationEnabled = false
        ComMGlobalNvmBlockDescriptor = (unset)
        ComMMainFunctionPeriod = 0.01
        ComMNoCom = 0
        ComMNoWakeup = false
        ComMNetworkManagement: ComMNmVariant=NONE, ComMPncNmRequest=false
        ComMUserPerChannel: ComMUserChannel=ComMUser
      ComMUser: ComMUserIdentifier=(unset)
    ComMGeneral:
      ComMNoCom = 0
      ComMEcuGroupClassification = 3
      ComMModeLimitationEnabled = 0
      ComMPncSupport = false
      ComMSynchronousWakeUp = True
      ComMTMinFullComModeDuration = 5.0
      ComMVersionInfoApi = 1
      ComMWakeupInhibitionEnabled = False
      ComMDevErrorDetect = 1
      ArcComMASRCompatibilityLessThan4_2 = true
  module config Det: implementation-config-variant=VARIANT-PRE-COMPILE, module-description=Det
    DetGeneral:
      DetVersionInfoApi = 0
      DetUseRamlog = 1
      DetEnableCallbacks = 0
      DetWrapRamlog = 1
      DetUseStdErr = 0
      DetDeInitAPI = 0
      DetNumberOfCallbacks = 5
      DetRamlogSize = 16
      DetForwardToDlt = 1
      DetUseSafetyMonitor = false
    DetConfigSet
      DetPortReader (DetModule): DetModuleId=4097
        Inst (DetModuleInstance): DetInstanceId=0
  module config EcuC: implementation-config-variant=VARIANT-PRE-COMPILE, module-description=EcuC
    EcucPduCollection: PduIdTypeEnum=UINT16, PduLengthTypeEnum=UINT16
      14 x Pdu:
        Tester01: PduLength=64
        Ecu01: PduLength=64
        DiagPhysicalTx: PduLength=8
        DiagPhysicalRx: PduLength=8
        DiagFunctionalRx: PduLength=8
        DiagUUDT: PduLength=8
        XCP_TX_PDU: PduLength=8
        XCP_RX_PDU: PduLength=8
        SwcMem_Rx_CanIf: PduLength=8
        SwcMem_Tx_CanIf: PduLength=8
        SwcMem_Tx_Com: PduLength=8
        SwcMem_Rx_Com: PduLength=8
        T1_RX_PDU: PduLength=8
        T1_TX_PDU: PduLength=8
  module config EcuM: implementation-config-variant=VARIANT-PRE-COMPILE, module-description=EcuM
    EcuMConfiguration
      EcuMCommonConfiguration: EcuMConfigConsistencyHash=(unset), EcuMDefaultAppMode=(unset), EcuMOSResource=(unset)
        EcuMDefaultShutdownTarget: EcuMDefaultState=EcuMStateOff, EcuMDefaultSleepModeRef=EcuMSleepMode
        EcuMSleepMode: EcuMSleepModeId=(unset), EcuMSleepModeSuspend=(unset), EcuMSleepModeMcuModeRef=SLEEP, EcuMWakeupSourceMask=EcuMWakeupSource
        EcuMWakeupSource: EcuMWakeupSourceId=(unset), EcuMWakeupSourcePolling=0, EcuMResetReasonRef=(unset)
      EcuMFixedConfiguration:
        EcuMNvramReadallTimeout = 10.0
        EcuMNvramWriteallTimeout = 10.0
        EcuMRunMinimumDuration = 10.0
        EcuMNvramWriteallTimeout = 10.0
        EcuMRunMinimumDuration = 10.0
        EcuMNormalMcuModeRef = NORMAL
        EcuMComMCommunicationAllowedList = ComMChannel
        EcuMNormalMcuModeRef = NORMAL
        HelloWorldUser (EcuMFixedUserConfig): EcuMFixedUser=(unset)
    EcuMGeneral: EcuMDevErrorDetect=0, EcuMIncludeDem=0, EcuMIncludeDet=0, EcuMMainFunctionPeriod=0.01, EcuMVersionInfoApi=0
    EcuMFixedGeneral: EcuMIncludeComM=(unset), EcuMIncludeNvM=(unset), EcuMIncludeNvramMgr=(unset), EcuMTTIIEnabled=(unset), EcuMTTIIWakeupSourceRef=(unset)
  module config Os: implementation-config-variant=VARIANT-PRE-COMPILE, module-description=Os
    OsAppMode
    OsOS:
      OsScalabilityClass = SC1
      OsStackMonitoring = 1
      OsStatus = EXTENDED
      OsUseGetServiceId = 1
      OsUseParameterAccess = 1
      OsUseResScheduler = 1
      ArcOsTickFrequency = 1000
      ArcOsInterruptStackSize = 2048
      ArcOsIdleStackSize = 512
      ArcOsMaxIsr = 30
      ArcSafetyPlatform = false
      OsHooks: OsErrorHook=1, OsPostTaskHook=0, OsPreTaskHook=0, OsShutdownHook=1, OsStartupHook=1
      ArcOsDebug: OsTaskDebug=0, OsAlarmDebug=0, OsResourceDebug=0, OsScheduleTableDebug=0, OsEventDebug=0, OsDebugActivated=0
    OsCounter: OsCounterMaxAllowedValue=255, OsCounterMinCycle=1, OsCounterTicksPerBase=(unset), OsCounterType=OS_TICK
    OsApplication:
      OsTrusted = 1
      OsAppAlarmRef = OsAlarmBswService
      OsAppCounterRef = OsCounter
      OsAppTaskRef = OsBswServiceTask
      OsAppTaskRef = OsRteTask
      OsAppTaskRef = OsStartupTask
      OsAppAlarmRef = OsAlarm1000ms
      OsAppAlarmRef = OsAlarm100ms
      OsAppAlarmRef = OsAlarmXcp
      OsAppTaskRef = OsXcpTask
      OsApplicationHooks: OsAppErrorHook=0, OsAppShutdownHook=0, OsAppStartupHook=0
    OsBswServiceTask (OsTask): OsTaskActivation=1, OsTaskPriority=2, OsTaskSchedule=FULL, ArcOsTaskStackSize=2048, OsTaskAccessingApplication=OsApplication
      OsTaskAutostart: OsTaskAppModeRef=OsAppMode
    OsAlarmBswService (OsAlarm): OsAlarmCounterRef=OsCounter, OsAlarmAccessingApplication=OsApplication
      OsAlarmAutostart: OsAlarmAlarmTime=5, OsAlarmAutostartType=RELATIVE, OsAlarmCycleTime=5, OsAlarmAppModeRef=(unset)
      OsAlarmAction
        OsAlarmActivateTask: OsAlarmActivateTaskRef=OsBswServiceTask
    OsEvent1 (OsEvent)
    OsEvent2 (OsEvent)
    OsRteTask (OsTask):
      OsTaskActivation = 2
      OsTaskPriority = 2
      OsTaskSchedule = FULL
      ArcOsTaskStackSize = 2048
      OsTaskAccessingApplication = OsApplication
      OsTaskEventRef = OsEvent1
      OsTaskEventRef = OsEvent2
      OsTaskEventRef = ModeSwitchOsEvent
      OsTaskEventRef = WatchdogModeSwitchEvent
      OsTaskEventRef = SwcMemCmdReceived
      OsTaskEventRef = ComMFullComOsEvent
      OsTaskAutostart: OsTaskAppModeRef=OsAppMode
    OsStartupTask (OsTask): OsTaskActivation=1, OsTaskPriority=1, OsTaskSchedule=FULL, ArcOsTaskStackSize=2048, OsTaskAccessingApplication=OsApplication
      OsTaskAutostart: OsTaskAppModeRef=OsAppMode
    OsAlarm1000ms (OsAlarm): OsAlarmCounterRef=OsCounter, OsAlarmAccessingApplication=OsApplication
      OsAlarmAction
        OsAlarmSetEvent: OsAlarmSetEventRef=OsEvent1, OsAlarmSetEventTaskRef=OsRteTask
      OsAlarmAutostart: OsAlarmAlarmTime=1000, OsAlarmAutostartType=RELATIVE, OsAlarmCycleTime=1000, OsAlarmAppModeRef=(unset)
    OsAlarm100ms (OsAlarm): OsAlarmCounterRef=OsCounter, OsAlarmAccessingApplication=OsApplication
      OsAlarmAction
        OsAlarmSetEvent: OsAlarmSetEventRef=OsEvent2, OsAlarmSetEventTaskRef=OsRteTask
      OsAlarmAutostart: OsAlarmAlarmTime=100, OsAlarmAutostartType=RELATIVE, OsAlarmCycleTime=100, OsAlarmAppModeRef=(unset)
    ModeSwitchOsEvent (OsEvent)
    OsXcpTask (OsTask): OsTaskActivation=1, OsTaskPriority=3, OsTaskSchedule=FULL, ArcOsTaskStackSize=2048, OsTaskAccessingApplication=OsApplication
      OsTaskAutostart: OsTaskAppModeRef=(unset)
    OsAlarmXcp (OsAlarm): OsAlarmCounterRef=OsCounter, OsAlarmAccessingApplication=OsApplication
      OsAlarmAction
        OsAlarmActivateTask: OsAlarmActivateTaskRef=OsXcpTask
      OsAlarmAutostart: OsAlarmAlarmTime=10, OsAlarmAutostartType=ABSOLUTE, OsAlarmCycleTime=10, OsAlarmAppModeRef=(unset)
    3 x OsEvent:
      WatchdogModeSwitchEvent
      SwcMemCmdReceived
      ComMFullComOsEvent
  module config PduR: implementation-config-variant=VARIANT-POST-BUILD, module-description=PduR
    PduRGeneral: PduRDevErrorDetect=1, PduRVersionInfoApi=0, PduRZeroCostOperation=0
    PduRRoutingTables: PduRConfigurationId=0, ArcPduRMaxRouteCount=50
      PduRRoutingTable: PduRIsMinimumRouting=(unset)
        8 x PduRRoutingPath:
          Tester01
            PduRDestPdu: ArcOverridenDestModule=Com, PduRDestPduRef=EcucPduCollection/Tester01
            PduRSrcPdu: PduRSourcePduHandleId=(unset), ArcOverridenSrcModule=CanIf, PduRSrcPduRef=EcucPduCollection/Tester01
          CASINE01
            PduRDestPdu: ArcOverridenDestModule=CanIf, PduRDestPduRef=EcucPduCollection/Ecu01
            PduRSrcPdu: PduRSourcePduHandleId=(unset), ArcOverridenSrcModule=Com, PduRSrcPduRef=EcucPduCollection/Ecu01
          DiagPhysicalRx
            PduRDestPdu: ArcOverridenDestModule=Dcm, PduRDestPduRef=EcucPduCollection/DiagPhysicalRx
            PduRSrcPdu: PduRSourcePduHandleId=(unset), ArcOverridenSrcModule=CanTp, PduRSrcPduRef=EcucPduCollection/DiagPhysicalRx
          DiagPhysicalTx
            PduRDestPdu: ArcOverridenDestModule=CanTp, PduRDestPduRef=EcucPduCollection/DiagPhysicalTx
            PduRSrcPdu: PduRSourcePduHandleId=(unset), ArcOverridenSrcModule=Dcm, PduRSrcPduRef=EcucPduCollection/DiagPhysicalTx
          DiagFunctionalRx
            PduRDestPdu: ArcOverridenDestModule=Dcm, PduRDestPduRef=EcucPduCollection/DiagFunctionalRx
            PduRSrcPdu: PduRSourcePduHandleId=(unset), ArcOverridenSrcModule=CanTp, PduRSrcPduRef=EcucPduCollection/DiagFunctionalRx
          DiagUUDT
            PduRDestPdu: ArcOverridenDestModule=CanIf, PduRDestPduRef=EcucPduCollection/DiagUUDT
            PduRSrcPdu: PduRSourcePduHandleId=(unset), ArcOverridenSrcModule=Dcm, PduRSrcPduRef=EcucPduCollection/DiagUUDT
          SwcMemTx
            PduRDestPdu: ArcOverridenDestModule=CanIf, PduRDestPduRef=SwcMem_Tx_CanIf
            PduRSrcPdu: PduRSourcePduHandleId=(unset), ArcOverridenSrcModule=Com, PduRSrcPduRef=SwcMem_Tx_Com
          SwcMemRx
            PduRDestPdu: ArcOverridenDestModule=Com, PduRDestPduRef=SwcMem_Rx_Com
            PduRSrcPdu: PduRSourcePduHandleId=(unset), ArcOverridenSrcModule=CanIf, PduRSrcPduRef=SwcMem_Rx_CanIf
    4 x PduRBswModules, all with PduRCancelTransmit=(unset), PduRChangeParameterRequestApi=(unset), PduRCommunicationInterface=(unset), PduRRetransmission=(unset), PduRTransportProtocol=(unset), PduRTriggertransmit=(unset), PduRTxConfirmation=(unset), PduRUseTag=(unset), PduRBswModuleRef=(unset):
      CanIf: PduRCancelReceive=(unset), PduRLowerModule=1, PduRUpperModule=0
      Com: PduRCancelReceive=(unset), PduRLowerModule=0, PduRUpperModule=1
      CanTp: PduRCancelReceive=0, PduRLowerModule=1, PduRUpperModule=0
      Dcm: PduRCancelReceive=0, PduRLowerModule=0, PduRUpperModule=1
  module config Rte: implementation-config-variant=VARIANT-PRE-COMPILE, module-description=Rte
    RteBswGeneral: RteSchMVersionInfoApi=0, RteUseComShadowSignalApi=0
    RteGeneration:
      RteCalibrationSupport = NONE
      RteCodeVendorId = (unset)
      RteDevErrorDetect = 1
      RteDevErrorDetectUninit = 0
      RteGenerationMode = VENDOR_MODE
      RteIocInteractionReturnValue = RTE_IOC
      RteMeasurementSupport = false
      RteOptimizationMode = MEMORY
      RteValueRangeCheckEnabled = false
      RteVfbTraceEnabled = false
    RteInitializationBehavior: RteInitializationStrategy=RTE_INITIALIZATION_STRATEGY_NONE, RteSectionInitializationPolicy=
    RteOsInteraction
      RteUsedOsActivation: RteExpectedActivationOffset=(unset), RteExpectedTickDuration=(unset), RteActivationOsTaskRef=OsRteTask
    RtePostBuildVariantConfiguration: RtePostBuildUsedPredefinedVariant=(unset)
    15 x RteSwComponentInstance:
      SwcReader: RteSoftwareComponentInstanceRef=SwcReader
        3 x RteEventToTaskMapping, all with RtePositionInTask=1, RteMappedToTaskRef=OsRteTask:
          InitEvent_OsRteTask: RteImmediateRestart=0, RteEventRef=InitEvent, RteUsedOsEventRef=ModeSwitchOsEvent
          localModeEvent_OsRteTask: RteImmediateRestart=false, RteEventRef=localModeEvent, RteUsedOsEventRef=WatchdogModeSwitchEvent
          SwcReaderRunnable_timingEvent_0_1_OsRteTask: RteImmediateRestart=false, RteEventRef=SwcReaderRunnable_timingEvent_0_1, RteUsedOsEventRef=OsEvent2
      SwcWriter: RteSoftwareComponentInstanceRef=SwcWriter
        3 x RteEventToTaskMapping, all with RteMappedToTaskRef=OsRteTask:
          InitEvent_OsBswServiceTask: RteImmediateRestart=0, RtePositionInTask=2, RteEventRef=InitEvent, RteUsedOsEventRef=ModeSwitchOsEvent
          SwcWriterRunnable_timingEvent_1_0_OsRteTask: RteImmediateRestart=false, RtePositionInTask=1, RteEventRef=SwcWriterRunnable_timingEvent_1_0, RteUsedOsEventRef=OsEvent1
          FullCommEvent_OsRteTask: RteImmediateRestart=false, RtePositionInTask=3, RteEventRef=FullCommEvent, RteUsedOsEventRef=ComMFullComOsEvent
      ioHwAb: RteSoftwareComponentInstanceRef=ioHwAb
      ecuM: RteSoftwareComponentInstanceRef=ecuM
      comM: RteSoftwareComponentInstanceRef=comM
      dcm: RteSoftwareComponentInstanceRef=dcm
      det: RteSoftwareComponentInstanceRef=det
      dem: RteSoftwareComponentInstanceRef=dem
      bswM: RteSoftwareComponentInstanceRef=bswm
      dlt: RteSoftwareComponentInstanceRef=dlt
      wdgm: RteSoftwareComponentInstanceRef=wdgm
      nvm: RteSoftwareComponentInstanceRef=nvm
      SwcMem: RteSoftwareComponentInstanceRef=SwcMem
        InitEvent_OsRteTask (RteEventToTaskMapping): RteImmediateRestart=false, RteEventRef=InitEvent, RteMappedToTaskRef=OsRteTask, RteUsedOsEventRef=ModeSwitchOsEvent
        SwcMemCmdEvent_OsRteTask (RteEventToTaskMapping): RteImmediateRestart=false, RteEventRef=SwcMemCmdEvent, RteMappedToTaskRef=OsRteTask, RteUsedOsEventRef=SwcMemCmdReceived
      os: RteSoftwareComponentInstanceRef=os
      fim: RteSoftwareComponentInstanceRef=fim
  module config IoHwAb: implementation-config-variant=VARIANT-PRE-COMPILE, module-description=IoHwAb
    ArcIoHwAbGeneral: ArcIoHwAbDevErrorDetect=1, ArcIoHwAbAnalogMaxVoltage=5.0, ArcIoHwAbUsePort=1, ArcIoHwCalibrationEnabled=0
    DigitalSignal_LED1 (ArcIoHwAbDigitalSignal):
      ArcIoHwAbDigitalDefaultValue = IOHWAB_HIGH
      ArcIoHwAbDigitalInverted = 0
      ArcIoHwAbDigitalMethod = IOHWAB_DIGITAL_WRITE
      ArcIoHwAbDigitalType = IOHWAB_DIO
      ArcIoHwAbDioChannelRef = LED1
    DigitalSignal_LED2 (ArcIoHwAbDigitalSignal):
      ArcIoHwAbDigitalDefaultValue = IOHWAB_HIGH
      ArcIoHwAbDigitalInverted = 0
      ArcIoHwAbDigitalMethod = IOHWAB_DIGITAL_WRITE
      ArcIoHwAbDigitalType = IOHWAB_DIO
      ArcIoHwAbDioChannelRef = LED2
    VoltScaling (ArcIoHwAbScaling): ArcIoHwAbScalingOffset=0.0, ArcIoHwAbScalingScale=1.0, ArcIoHwAbScalingType=Volt
    AnalogSignal (ArcIoHwAbAnalogSignal):
      ArcIoHwAbAnalogDefaultValue = 0.0
      ArcIoHwAbAnalogSignalResolution = 10_BIT_RESOLUTION
      ArcIoHwAbAnalogType = IOHWAB_ADC
      ArcIoHwAbScalingRef = VoltScaling
      ArcIoHwAbAdcChannel = AdcChannel1
      ArcIoHwAbAdcGroup = AdcGroup1
    PwmSignal_LED3 (ArcIoHwAbPwmSignal): ArcIoHwAbPwmType=IOHWAB_PWM_DUTY, ArcIoHwAbPwmDutyDefaultValue=0, ArcIoHwAbPwmChannel=Channel_LED_3
  module config BswM: implementation-config-variant=VARIANT-PRE-COMPILE, module-description=BswM
    BswMConfig
      BswMArbitration: ArcBswMMaxRuleCount=20
        BswComMIndication (BswMModeRequestPort): BswMRequestProcessing=BSWM_DEFERRED
          BswMModeRequestSource
            BswMComMIndication: BswMComMChannelRef=ComMChannel
        EnablePduGroupsRule (BswMRule):
          BswMNestedExecutionOnly = false
          BswMRuleInitState = BSWM_FALSE
          BswMRuleExpressionRef = ComMFullCommuncationlExpression
          BswMRuleTrueActionList = EnablePdusActions
        ComMFullCommunicationCondition (BswMModeCondition): BswMConditionType=BSWM_EQUALS, BswMConditionMode=BswComMIndication
          BswMConditionValue
            BswMBswMode: BswMBswRequestedMode=COMM_FULL_COMMUNICATION
        ComMFullCommuncationlExpression (BswMLogicalExpression): BswMArgumentRef=ComMFullCommunicationCondition
        SwcStartCommunication (BswMModeRequestPort): BswMRequestProcessing=BSWM_DEFERRED
          BswMModeRequestSource
            BswMSwcModeRequest: BswMSwcModeRequestModeDeclarationGroupPrototypeRef=currentMode
        StartCommunicationCondition (BswMModeCondition): BswMConditionType=BSWM_EQUALS_NOT, BswMConditionMode=SwcStartCommunication
          BswMConditionValue
            BswMBswMode: BswMBswRequestedMode=COMM_NO_COMMUNICATION
        StartCommunicationRule (BswMRule):
          BswMNestedExecutionOnly = false
          BswMRuleInitState = BSWM_FALSE
          BswMRuleExpressionRef = StartCommunicationExpression
          BswMRuleTrueActionList = StartCommuncationActions
        StartCommunicationExpression (BswMLogicalExpression): BswMArgumentRef=StartCommunicationCondition
        ComMNoCommunicationCondition (BswMModeCondition): BswMConditionType=BSWM_EQUALS, BswMConditionMode=BswComMIndication
          BswMConditionValue
            BswMBswMode: BswMBswRequestedMode=COMM_NO_COMMUNICATION
        ComMSilentCommunicationCondition (BswMModeCondition): BswMConditionType=BSWM_EQUALS, BswMConditionMode=BswComMIndication
          BswMConditionValue
            BswMBswMode: BswMBswRequestedMode=COMM_SILENT_COMMUNICATION
        ComMSilentCommuncationlExpression (BswMLogicalExpression): BswMArgumentRef=ComMSilentCommunicationCondition
        ComMNoCommuncationlExpression (BswMLogicalExpression): BswMArgumentRef=ComMNoCommunicationCondition
        DisablePduGroupsRule (BswMRule):
          BswMNestedExecutionOnly = false
          BswMRuleInitState = BSWM_FALSE
          BswMRuleExpressionRef = ComMNoCommuncationlExpression
          BswMRuleTrueActionList = DisablePdusActions
        ListenOnlyPduGroupsRule (BswMRule):
          BswMNestedExecutionOnly = false
          BswMRuleInitState = BSWM_FALSE
          BswMRuleExpressionRef = ComMSilentCommuncationlExpression
          BswMRuleTrueActionList = SilentPdusActions
        WdgMMode (BswMModeRequestPort): BswMRequestProcessing=BSWM_DEFERRED
          BswMModeRequestSource
            BswMSwcModeRequest: BswMSwcModeRequestModeDeclarationGroupPrototypeRef=currentMode
        WdgMRule (BswMRule):
          BswMNestedExecutionOnly = false
          BswMRuleInitState = BSWM_FALSE
          BswMRuleExpressionRef = WdgMModeExpression
          BswMRuleTrueActionList = WdgMEnableActions
          BswMRuleFalseActionList = WdgMDisableActions
        WdgMModeExpression (BswMLogicalExpression): BswMArgumentRef=WdgMCondition
        WdgMCondition (BswMModeCondition): BswMConditionType=BSWM_EQUALS, BswMConditionMode=WdgMMode
          BswMConditionValue
            BswMBswMode: BswMBswRequestedMode=SUPERVISION_OK
      BswMModeControl
        EnablePdusActions (BswMActionList): BswMActionListExecution=BSWM_TRIGGER
          EnableAllPdus (BswMActionListItem): BswMAbortOnFail=false, BswMActionListItemIndex=0, BswMActionListItemRef=IPduAllEnabled
        IPduAllEnabled (BswMAction)
          BswMAvailableActions
            BswMPduGroupSwitch: BswMPduGroupSwitchReinit=false, BswMEnabledPduGroupRef=ComIPduGroupRx, BswMEnabledPduGroupRef=ComIPduGroupTx
        StartCommuncationActions (BswMActionList): BswMActionListExecution=BSWM_TRIGGER
          BswMActionListItem: BswMAbortOnFail=false, BswMActionListItemIndex=0, BswMActionListItemRef=RequestFullCom
        3 x BswMAction:
          RequestFullCom
            BswMAvailableActions
              BswMComMModeSwitch: BswMComMRequestedMode=BSWM_FULL_COM, BswMComMUserRef=ComMUser
          IPduListenOnly
            BswMAvailableActions
              BswMPduGroupSwitch: BswMPduGroupSwitchReinit=true, BswMDisabledPduGroupRef=ComIPduGroupTx, BswMEnabledPduGroupRef=ComIPduGroupRx
          IPduAllDisabled
            BswMAvailableActions
              BswMPduGroupSwitch: BswMPduGroupSwitchReinit=true, BswMDisabledPduGroupRef=ComIPduGroupRx, BswMDisabledPduGroupRef=ComIPduGroupTx
        3 x BswMActionList, all with BswMActionListExecution=BSWM_TRIGGER:
          DisablePdusActions
            BswMActionListItem: BswMAbortOnFail=false, BswMActionListItemIndex=0, BswMActionListItemRef=IPduAllDisabled
          SilentPdusActions
            BswMActionListItem: BswMAbortOnFail=false, BswMActionListItemIndex=0, BswMActionListItemRef=IPduListenOnly
          WdgMEnableActions
            BswMActionListItem: BswMAbortOnFail=false, BswMActionListItemIndex=0, BswMActionListItemRef=WdgMEnableAction
        WdgMEnableAction (BswMAction)
          BswMAvailableActions
            BswMUserCallout: BswMUserCalloutFunction=(void)WdgM_SetMode(WdgMConf_WdgMMode_WatchdogOn)
              BswMUserCallout: BswMUserCalloutFunction=WdgM_SetMode
        WdgMDisableAction (BswMAction)
          BswMAvailableActions
            BswMUserCallout: BswMUserCalloutFunction=(void)WdgM_SetMode(WdgMConf_WdgMMode_WatchdogOff)
        WdgMDisableActions (BswMActionList): BswMActionListExecution=BSWM_TRIGGER
          BswMActionListItem: BswMAbortOnFail=false, BswMActionListItemIndex=0, BswMActionListItemRef=WdgMDisableAction
    BswMGeneral: BswMDevErrorDetect=true, BswMVersionInfoApi=true, BswMComMEnabled=1, BswMEcuMEnabled=1, BswMCanSMEnabled=1, BswMSdEnabled=false
  module config CanTp: implementation-config-variant=VARIANT-POST-BUILD, module-description=CanTp
    CanTpConfig: CanTpMainFunctionPeriod=0.005
      CanTpChannel: CanTpChannelMode=
        DiagPhysicalRx (CanTpRxNSdu):
          CanTpNbr = 0.02
          CanTpRxAddressingFormat = CANTP_STANDARD
          CanTpRxDl = 8
          CanTpRxNSduId = (unset)
          CanTpRxPaddingActivation = CANTP_ON
          CanTpRxTaType = CANTP_PHYSICAL
          CanTpBs = 0
          CanTpRxWftMax = 255
          CanTpNar = 1
          CanTpNcr = 1
          CanTpSTmin = 0.005
          CanTpRxNSduRef = EcucPduCollection/DiagPhysicalRx
          CanTpRxNPdu: CanTpRxNPduId=(unset), CanTpRxNPduRef=EcucPduCollection/DiagPhysicalRx
          CanTpTxFcNPdu: CanTpTxFcNPduConfirmationPduId=(unset), CanTpTxFcNPduRef=EcucPduCollection/DiagPhysicalTx
        DiagFunctionalRx (CanTpRxNSdu):
          CanTpNbr = 0.02
          CanTpRxAddressingFormat = CANTP_STANDARD
          CanTpRxDl = 0
          CanTpRxNSduId = (unset)
          CanTpRxPaddingActivation = CANTP_ON
          CanTpRxTaType = CANTP_FUNCTIONAL
          CanTpBs = 0
          CanTpRxWftMax = 255
          CanTpNar = 1.0
          CanTpNcr = 1
          CanTpSTmin = 0.005
          CanTpRxNSduRef = EcucPduCollection/DiagFunctionalRx
          CanTpRxNPdu: CanTpRxNPduId=(unset), CanTpRxNPduRef=EcucPduCollection/DiagFunctionalRx
        DiagPhysicalTx (CanTpTxNSdu):
          CanTpNas = 1
          CanTpTc = 0
          CanTpTxAddressingFormat = CANTP_STANDARD
          CanTpTxDl = 8
          CanTpTxNSduId = (unset)
          CanTpTxPaddingActivation = CANTP_ON
          CanTpTxTaType = CANTP_PHYSICAL
          CanTpNbs = 1
          CanTpNcs = 0.9
          CanTpTxNSduRef = EcucPduCollection/DiagPhysicalTx
          CanTpTxNPdu: CanTpTxNPduConfirmationPduId=(unset), CanTpTxNPduRef=EcucPduCollection/DiagPhysicalTx
          CanTpRxFcNPdu: CanTpRxFcNPduId=(unset), CanTpRxFcNPduRef=EcucPduCollection/DiagPhysicalRx
    CanTpGeneral:
      CanTpChangeParameterApi = 0
      CanTpDevErrorDetect = 1
      CanTpPaddingByte = 0
      CanTpReadParameterApi = 0
      CanTpVersionInfoApi = 0
      CanTpMaxSDUs = 3
      ArcCanTpCanFDSupport = false
  module config Dcm: implementation-config-variant=VARIANT-PRE-COMPILE, module-description=Dcm
    DcmConfigSet
      DcmDsd
        DcmDsdServiceTable_UDS (DcmDsdServiceTable): DcmDsdSidTabId=0
          5 x DcmDsdService:
            ReadDataByIdentifier_0x22: DcmDsdSidTabServiceId=34, DcmDsdSidTabSubfuncAvail=0, DcmDsdSidTabSessionLevelRef=Default_Session, DcmDsdSidTabSecurityLevelRef=SecurityLevel_0
            ReadDataByPeriodicIdentifier_0x2A: DcmDsdSidTabServiceId=42, DcmDsdSidTabSubfuncAvail=0, DcmDsdSidTabSecurityLevelRef=SecurityLevel_0, DcmDsdSidTabSessionLevelRef=Default_Session
            DynamicallyDefinedDataIdentifier_0x2C: DcmDsdSidTabServiceId=44, DcmDsdSidTabSubfuncAvail=0, DcmDsdSidTabSecurityLevelRef=SecurityLevel_0, DcmDsdSidTabSessionLevelRef=Default_Session
            InputOutputControlByIdentifier_0x2F: DcmDsdSidTabServiceId=47, DcmDsdSidTabSubfuncAvail=0
            WriteDataByIdentifier_0x2E: DcmDsdSidTabServiceId=46, DcmDsdSidTabSubfuncAvail=false
      DcmDsl
        DcmDslBuffer_Rx (DcmDslBuffer): DcmDslBufferSize=255
        DcmDslCallbackDCMRequestService
        DcmDslDiagResp: DcmDslDiagRespMaxNumRespPend=10, DcmDslDiagRespOnSecondDeclinedRequest=(unset)
        DcmDslProtocol
          DcmDslProtocolRow_UDS (DcmDslProtocolRow):
            DcmDslProtocolEndiannessConvEnabled = (unset)
            DcmDslProtocolID = DCM_UDS_ON_CAN
            DcmDslProtocolIsParallelExecutab = (unset)
            DcmDslProtocolPreemptTimeout = 1.0
            DcmDslProtocolPriority = 1
            DcmSendRespPendOnTransToBoot = 1
            DcmTimStrP2ServerAdjust = 0.02
            DcmTimStrP2StarServerAdjust = 1.0
            DcmDslProtocolTransType = TYPE2
            DcmDslProtocolRxBufferID = DcmDslBuffer_Rx
            DcmDslProtocolSIDTable = DcmDsdServiceTable_UDS
            DcmDslProtocolTxBufferID = DcmDslBuffer_Tx
            DcmDslConnection
              DcmDslMainConnection: DcmDslProtocolRxTesterSourceAddr=0, DcmDslPeriodicTranmissionConRef=PeriodicTransmission
                PhysicalRx (DcmDslProtocolRx):
                  DcmDslProtocolRxAddrType = DCM_PHYSICAL_TYPE
                  DcmDslProtocolRxChannelId = (unset)
                  DcmDslProtocolRxPduId = (unset)
                  DcmDslProtocolRxPduRef = EcucPduCollection/DiagPhysicalRx
                  DcmDslProtocolRxComMChannelRef = ComMChannel
                PhysicalTx (DcmDslProtocolTx): DcmDslTxConfirmationPduId=(unset), DcmDslProtocolTxPduRef=EcucPduCollection/DiagPhysicalTx
                FunctionalRx (DcmDslProtocolRx):
                  DcmDslProtocolRxAddrType = DCM_FUNCTIONAL_TYPE
                  DcmDslProtocolRxChannelId = (unset)
                  DcmDslProtocolRxPduId = (unset)
                  DcmDslProtocolRxPduRef = EcucPduCollection/DiagFunctionalRx
                  DcmDslProtocolRxComMChannelRef = ComMChannel
          DcmDslProtocolRow_UUDT (DcmDslProtocolRow):
            DcmDslProtocolEndiannessConvEnabled = (unset)
            DcmDslProtocolID = DCM_PERIODIC_ON_CAN
            DcmDslProtocolIsParallelExecutab = (unset)
            DcmDslProtocolPreemptTimeout = (unset)
            DcmDslProtocolPriority = (unset)
            DcmSendRespPendOnTransToBoot = 1
            DcmTimStrP2ServerAdjust = 
            DcmTimStrP2StarServerAdjust = 
            DcmDslProtocolRxBufferID = (unset)
            DcmDslProtocolSIDTable = (unset)
            DcmDslProtocolTxBufferID = DcmDslBuffer_Periodic
            DcmDslConnection
              PeriodicTransmission (DcmDslPeriodicTransmission)
                DcmDslPeriodicConnection: DcmDslPeriodicTxConfirmationPduId=(unset), DcmDslPeriodicTxPduRef=EcucPduCollection/DiagUUDT
        DcmDslBuffer_Tx (DcmDslBuffer): DcmDslBufferSize=255
        DcmDslBuffer_Periodic (DcmDslBuffer): DcmDslBufferSize=8
      DcmGeneral:
        DcmDevErrorDetect = 1
        DcmRequestManufacturerNotificationEnabled = 0
        DcmRequestSupplierNotificationEnabled = (unset)
        DcmRespondAllRequest = 1
        DcmTaskTime = 0.02
        DcmVersionInfoApi = 0
        ArcDcmMaxDynamicIdSources = 10
        ArcDcmSplitTaskConceptEnable = 0
        ArcDcmPeriodicTransmission:
          ArcDcmPeriodDataLimitNumber = 10
          ArcDcmPeriodicTransmissionFast = 0.1
          ArcDcmPeriodicTransmissionMedium = 10.0
          ArcDcmPeriodicTransmissionSlow = 30.0
          ArcDcmSynchPeriodicDidSampling = 0
      DcmPageBufferCfg: DcmPagedBufferEnabled=(unset)
      DcmDsp
        DcmDspSecurity
          SecurityLevel_0 (DcmDspSecurityRow):
            DcmDspSecurityDelayTime = 10
            DcmDspSecurityDelayTimeOnBoot = 0
            DcmDspSecurityKeySize = 4
            DcmDspSecurityLevel = 0
            DcmDspSecurityNumAttDelay = 5
            DcmDspSecuritySeedSize = 4
        DcmDspSession
          Default_Session (DcmDspSessionRow): DcmDspSessionForBoot=DCM_NO_BOOT, DcmDspSessionLevel=1, DcmDspSessionP2ServerMax=0.05, DcmDspSessionP2StarServerMax=5.0
        DID_0x0100_Data (DcmDspData):
          DcmDspDataSize = 160
          DcmDspDataUsePort = USE_DATA_SYNCH_FNC
          DcmDspDataConditionCheckReadFnc = DID_0x0100_ConditionCheck
          DcmDspDataReadFnc = DID_0x0100_Read
          DcmDspDataInfoRef = DataInfo_FixedLength
        DID_0x0100 (DcmDspDid): DcmDspDidIdentifier=256, DcmDspDidUsed=1, DcmDspDidInfoRef=DcmDspDidInfoStaticReadOnly
          DcmDspDidSignal: DcmDspDidDataPos=0, DcmDspDidDataRef=DID_0x0100_Data
        DataInfo_FixedLength (DcmDspDataInfo): DcmDspDataFixedLength=1
        DcmDspDidInfoStaticReadOnly (DcmDspDidInfo): DcmDspDidDynamicallyDefined=0
          DcmDspDidAccess
            DcmDspDidRead: DcmDspDidReadSecurityLevelRef=SecurityLevel_0, DcmDspDidReadSessionRef=Default_Session
        3 x DcmDspData, all with DcmDspDataUsePort=USE_DATA_SYNCH_FNC, DcmDspDataConditionCheckReadFnc=DID_0x0100_ConditionCheck, DcmDspDataInfoRef=DataInfo_FixedLength:
          DID_0xF200_PeriodicDid: DcmDspDataSize=32, DcmDspDataReadFnc=DID_0xF200_Read
          DID_0x0101_Data: DcmDspDataSize=16, DcmDspDataReadFnc=DID_0x0101_Read
          DID_0x0102_Data: DcmDspDataSize=16, DcmDspDataReadFnc=DID_0x0102_Read
        DcmDspDidInfoDynamic (DcmDspDidInfo): DcmDspDidDynamicallyDefined=1
          DcmDspDidAccess
            DcmDspDidWrite
            DcmDspDidRead
        5 x DcmDspDid, all with DcmDspDidUsed=1:
          DID_0x0101: DcmDspDidIdentifier=257, DcmDspDidInfoRef=DcmDspDidInfoStaticReadOnly
            DcmDspDidSignal: DcmDspDidDataPos=0, DcmDspDidDataRef=DID_0x0101_Data
          DID_0x0102: DcmDspDidIdentifier=258, DcmDspDidInfoRef=DcmDspDidInfoStaticReadOnly
            DcmDspDidSignal: DcmDspDidDataPos=0, DcmDspDidDataRef=DID_0x0102_Data
          DID_0xF200: DcmDspDidIdentifier=61952, DcmDspDidInfoRef=DcmDspDidInfoStaticReadOnly
            DcmDspDidSignal: DcmDspDidDataPos=0, DcmDspDidDataRef=DID_0xF200_PeriodicDid
          DID_0xF201: DcmDspDidIdentifier=61953, DcmDspDidInfoRef=DcmDspDidInfoDynamic
          DID_0x0200: DcmDspDidIdentifier=512, DcmDspDidInfoRef=DcmDspDidInfoControl
            DcmDspDidSignal: DcmDspDidDataPos=0, DcmDspDidDataRef=DID_0x0200_Data
        DID_0x0200_Data (DcmDspData): DcmDspDataSize=32, DcmDspDataUsePort=USE_ECU_SIGNAL, DcmDspDataInfoRef=DataInfo_FixedLength
          ArcDcmDspDataEcuSignalChoice
            ArcDcmDspIoHwAbPwm: ArcDcmDspIoHwAbPwmSignalReference=PwmSignal_LED3
        DcmDspDidInfoControl (DcmDspDidInfo): DcmDspDidDynamicallyDefined=0
          DcmDspDidAccess
            DcmDspDidRead
            DcmDspDidControl: DcmDspDidFreezeCurrentState=1, DcmDspDidResetToDefault=1, DcmDspDidReturnControlToEcu=1, DcmDspDidShortTermAdjustment=1
        DID_0x0300 (DcmDspDid): DcmDspDidIdentifier=768, DcmDspDidUsed=true, DcmDspDidInfoRef=DcmDspDidInfoStaticWriteOnly
          SRWrite1 (DcmDspDidSignal): DcmDspDidDataPos=3, DcmDspDidDataRef=SRWrite1_Data
          SRWrite2 (DcmDspDidSignal): DcmDspDidDataPos=24, DcmDspDidDataRef=SRWrite2_Data
        DcmDspDidInfoStaticWriteOnly (DcmDspDidInfo): DcmDspDidDynamicallyDefined=false
          DcmDspDidAccess
            DcmDspDidWrite
        DID_0x0301 (DcmDspDid): DcmDspDidIdentifier=769, DcmDspDidUsed=true, DcmDspDidInfoRef=DcmDspDidInfoStaticReadOnly
          SRRead1 (DcmDspDidSignal): DcmDspDidDataPos=6, DcmDspDidDataRef=SRRead1_Data
          SRRead2 (DcmDspDidSignal): DcmDspDidDataPos=26, DcmDspDidDataRef=SRRead2_Data
        4 x DcmDspData, all with DcmDspDataSize=16, DcmDspDataUsePort=USE_DATA_SENDER_RECEIVER, DcmDspDataType=UINT16, DcmDspDataInfoRef=DataInfo_FixedLength:
          SRWrite1_Data: ArcDcmDspDataEndianness=DCM_LITTLE_ENDIAN
          SRWrite2_Data: ArcDcmDspDataEndianness=DCM_BIG_ENDIAN
            ArcDcmDspSRScaling: ArcDcmDspDataOffset=0, ArcDcmDspDataResolution=1
          SRRead1_Data: ArcDcmDspDataEndianness=DCM_BIG_ENDIAN
            ArcDcmDspSRScaling: ArcDcmDspDataOffset=0, ArcDcmDspDataResolution=1
          SRRead2_Data: ArcDcmDspDataEndianness=DCM_LITTLE_ENDIAN
        DcmDspDid_Pwm (DcmDspDid): DcmDspDidIdentifier=288, DcmDspDidUsed=true, DcmDspDidInfoRef=DcmDspDidInfoControl
          DcmDspDidSignal: DcmDspDidDataPos=0, DcmDspDidDataRef=DcmDspData_Pwm
        DcmDspData_Pwm (DcmDspData): DcmDspDataSize=32, DcmDspDataUsePort=USE_ECU_SIGNAL, DcmDspDataInfoRef=DataInfo_FixedLength
          ArcDcmDspDataEcuSignalChoice
            ArcDcmDspIoHwAbPwm: ArcDcmDspIoHwAbPwmSignalReference=PwmSignal_LED3
        DcmDspData_Adc (DcmDspData): DcmDspDataSize=32, DcmDspDataUsePort=USE_ECU_SIGNAL, DcmDspDataInfoRef=DataInfo_FixedLength
          ArcDcmDspDataEcuSignalChoice
            ArcDcmDspIoHwAbAdc: ArcDcmDspIoHwAbAnalogSignalReference=AnalogSignal
        DcmDspDid_Adc (DcmDspDid): DcmDspDidIdentifier=273, DcmDspDidUsed=true, DcmDspDidInfoRef=DcmDspDidInfoControl
          DcmDspDidSignal: DcmDspDidDataPos=0, DcmDspDidDataRef=DcmDspData_Adc
        SRRead3_Data (DcmDspData):
          DcmDspDataSize = 1
          DcmDspDataUsePort = USE_DATA_SENDER_RECEIVER
          ArcDcmDspDataEndianness = DCM_BIG_ENDIAN
          DcmDspDataType = BOOLEAN
          DcmDspDataInfoRef = DataInfo_FixedLength
        DID_0x0302 (DcmDspDid): DcmDspDidIdentifier=770, DcmDspDidUsed=true, DcmDspDidInfoRef=DcmDspDidInfoStaticReadOnly
          DcmDspDidSignal: DcmDspDidDataPos=0, DcmDspDidDataRef=SRRead3_Data
  module config Dem: implementation-config-variant=VARIANT-PRE-COMPILE, module-description=Dem
    DemConfigSet
      6 x DemEventParameter, all with DemEventId=(unset), DemMaxNumberFreezeFrameRecords=1, DemFreezeFrameRecNumClassRef=(unset):
        CAN_E_TIMEOUT: DemEventKind=DEM_EVENT_KIND_BSW
          DemEventClass:
            DemAgingAllowed = 0
            DemConsiderPtoStatus = (unset)
            DemEventOBDReadinessGroup = 
            DemEventPriority = 1
            DemFFPrestorageSupported = (unset)
            DemOperationCycleRef = DemOperationCycle
            DemDebounceAlgorithmClass
        TestEvent: DemEventKind=DEM_EVENT_KIND_SWC, DemDTCClassRef=TestEvent_DTC
          DemEventClass:
            DemAgingAllowed = 0
            DemConsiderPtoStatus = (unset)
            DemEventOBDReadinessGroup = 
            DemEventPriority = 1
            DemFFPrestorageSupported = (unset)
            DemEventDestination = DEM_DTC_ORIGIN_PRIMARY_MEMORY
            DemOperationCycleRef = OpCycleDemStarted
            DemDebounceAlgorithmClass
          DemCallbackInitMForE
        FLS_E_WRITE_FAILED: DemEventKind=DEM_EVENT_KIND_BSW
          DemEventClass:
            DemAgingAllowed = 0
            DemConsiderPtoStatus = (unset)
            DemEventOBDReadinessGroup = 
            DemEventPriority = 1
            DemFFPrestorageSupported = (unset)
            DemOperationCycleRef = OpCycleDemStarted
            DemDebounceAlgorithmClass
        FLS_E_READ_FAILED: DemEventKind=DEM_EVENT_KIND_BSW
          DemEventClass:
            DemAgingAllowed = 0
            DemConsiderPtoStatus = (unset)
            DemEventOBDReadinessGroup = 
            DemEventPriority = 1
            DemFFPrestorageSupported = (unset)
            DemOperationCycleRef = OpCycleDemStarted
            DemDebounceAlgorithmClass
        FLS_E_ERASE_FAILED: DemEventKind=DEM_EVENT_KIND_BSW
          DemEventClass:
            DemAgingAllowed = 0
            DemConsiderPtoStatus = (unset)
            DemEventOBDReadinessGroup = 
            DemEventPriority = 1
            DemFFPrestorageSupported = (unset)
            DemOperationCycleRef = OpCycleDemStarted
            DemDebounceAlgorithmClass
        FLS_E_COMPARE_FAILED: DemEventKind=DEM_EVENT_KIND_BSW
          DemEventClass:
            DemAgingAllowed = 0
            DemConsiderPtoStatus = (unset)
            DemEventOBDReadinessGroup = 
            DemEventPriority = 1
            DemFFPrestorageSupported = (unset)
            DemOperationCycleRef = OpCycleDemStarted
            DemDebounceAlgorithmClass
      TestEvent_DTC (DemDTCClass): DemDTCFunctionalUnit=, DemImmediateNvStorage=0, DemDTCSeverity=DEM_DTC_SEV_NO_SEVERITY, DemUdsDTC=3
    DemGeneral:
      DemAgingCycleCounterProcessing = 
      DemBswErrorBufferSize = (unset)
      DemClearDTCBehavior = 
      DemDTCSuppressionSupport = 0
      DemDebounceCounterBasedSupport = (unset)
      DemDebounceTimeBasedSupport = (unset)
      DemDevErrorDetect = 1
      DemDtcStatusAvailabilityMask = 127
      DemEnableConditionSupport = 0
      DemEventCombinationSupport = 
      DemEventDisplacementSupport = 0
      DemMaxNumberEventEntryMirror = (unset)
      DemMaxNumberEventEntryPermanent = 0
      DemMaxNumberEventEntryPrimary = 5
      DemMaxNumberEventEntrySecondary = 1
      DemMaxNumberPrestoredFF = (unset)
      DemOBDSupport = (unset)
      DemOccurrenceCounterProcessing = 
      DemOperationCycleProcessing = 
      DemOperationCycleStatusStorage = (unset)
      DemPTOSupport = (unset)
      DemStatusBitHandlingTestFailedSinceLastClear = 
      DemStatusBitStorageTestFailed = 0
      DemStorageConditionSupport = (unset)
      DemTaskTime = 0.1
      DemTriggerDcmReports = (unset)
      DemTriggerDltReports = 1
      DemTriggerFiMReports = 1
      DemTriggerMonitorInitBeforeClearOk = (unset)
      DemTypeOfDTCSupported = DEM_DTC_TRANSLATION_ISO14229_1
      DemTypeOfFreezeFrameRecordNumeration = DEM_FF_RECNUM_CONFIGURED
      DemVersionInfoApi = 0
      ArcMaxNumberFreezeFrameEntryPrimary = 1
      ArcMaxNumberExtendedDataEntryPrimary = 5
      ArcMaxNumberExtendedDataEntrySecondary = 1
      ArcMaxNumberFreezeFrameEntrySecondary = 1
      DemHeaderFileInclusion = Dem_Callbacks.h
      ArcDemAgingProcessing = DEM_INTERNAL
      ArcDemFailureProcessing = DEM_INTERNAL
      ArcDemDisplacementProcessing = DEM_INTERNAL
      ArcDemUseExtension = 0
      ArcDemAgingCounterClearBehavior = FAIL_DURING_FAILURE_CYCLE
      ArcDemHealingCounterClearBehavior = FAIL_DURING_FAILURE_CYCLE
      ArcDemStoreUDSStatusBitSubsetForAll = true
      ArcDemObdEventDisplacement = false
      DemHeaderFileInclusion = IoHwAb_Dcm.h
      DemOperationCycle: DemOperationCycleType=DEM_OPCYC_IGNITION
      DemFreezeFrameClass: DemDidClassRef=DemDidClass, DemDidClassRef=DemDidClass_Adc
      DemDidClass: DemDidIdentifier=1, DemDidDataElementClassRef=Test
      DemDataElementClass
        Test (DemExternalCSDataElementClass): DemDataElementDataSize=1, DemDataElementUsePort=0, DemDataElementReadFnc=ReadTest
      DemExtendedDataClass: DemExtendedDataRecordClassRef=DemExtendedDataRecordClass
      DemExtendedDataRecordClass: DemExtendedDataRecordNumber=1, DemExtendedDataRecordUpdate=DEM_UPDATE_RECORD_YES, DemDataElementClassRef=Test
      OpCycleDemStarted (DemOperationCycle): DemOperationCycleType=DEM_OPCYC_ACTIVE
      DemDidClass_Adc (DemDidClass): DemDidIdentifier=273, DemDidDataElementClassRef=Adc
      DemDataElementClass_Adc (DemDataElementClass)
        Adc (DemExternalCSDataElementClass): DemDataElementDataSize=32, DemDataElementUsePort=false, DemDataElementReadFnc=IoHwAb_Dcm_Read_AnalogSignal
  module config Xcp: implementation-config-variant=VARIANT-PRE-COMPILE, module-description=Xcp
    XcpConfig
      XcpEventChannel:
        XcpEventChannelConsistency = ODT
        XcpEventChannelMaxDaqList = 4
        XcpEventChannelNumber = 0
        XcpEventChannelPriority = (unset)
        XcpEventChannelTimeCycle = 1
        XcpEventChannelType = DAQ_STIM
        XcpEventChannelTimeUnit = TIMESTAMP_UNIT_10MS
      XcpPdu0 (XcpPdu)
        XcpRxPdu: XcpRxPduId=(unset), XcpRxPduRef=XCP_RX_PDU
      XcpPdu1 (XcpPdu)
        XcpTxPdu: XcpTxPduId=(unset), XcpTxPduRef=XCP_TX_PDU
    XcpGeneral:
      XcpDaqConfigType = DAQ_DYNAMIC
      XcpDaqCount = 4
      ArcXcpMaxRxTxQueue = 10
      ArcXcpFeatureStim = 1
      ArcXcpFeatureGetSlaveId = 0
      ArcXcpFeatureProtection = 1
      ArcXcpFeatureDio = 0
      ArcXcpFeatureBlockMode = 1
      ArcXcpFeatureCalibrationPage = 0
      XcpDevErrorDetect = 1
      XcpIdentificationFieldType = ABSOLUTE
      XcpMainFunctionPeriod = (unset)
      XcpMaxCto = 8
      XcpMaxDto = 8
      XcpMaxEventChannel = (unset)
      XcpMinDaq = 0
      XcpOdtCount = 4
      XcpOdtEntriesCount = 4
      XcpOdtEntrySizeDaq = (unset)
      XcpOdtEntrySizeStim = (unset)
      XcpOnCanEnabled = 1
      XcpOnCddEnabled = 0
      XcpOnEthernetEnabled = 0
      XcpOnFlexRayEnabled = 0
      XcpPrescalerSupported = (unset)
      XcpSuppressTxSupport = (unset)
      XcpTimestampTicks = 0
      XcpTimestampType = NO_TIME_STAMP
      XcpTimestampUnit = TIMESTAMP_UNIT_1MS
      XcpVersionInfoApi = 0
      ArcXcpFeatureProgram = false
      XcpCounterRef = OsCounter
  module config Dlt: implementation-config-variant=VARIANT-PRE-COMPILE, module-description=Dlt
    DltGeneral:
      DltDevErrorDetect = 1
      DltImplementAppIdContextIdQuery = 1
      DltImplementExtendedHeader = 
      DltImplementFilterMessages = 1
      DltImplementNVRamStorage = 
      DltImplementSWCInjection = 
      DltImplementTimestamp = 0
      DltImplementVerboseMode = 1
      DltImplementVfbTrace = 
      DltVfbTraceLogLevel = 
      DltGptChannel = (unset)
    DltMemory: DltInitBufferSize=, DltMaxCountAppIds=, DltMaxCountContextIds=, DltMaxCountContextIdsPerAppId=, DltMessageBufferSize=5200
    DltMultipleConfigurationContainer: DltNvRamBlockRef=(unset)
      DltBandwidth: DltBandwidthForComModule=, DltBandwidthForDiagChannel=, DltTimePeriodTrafficShaping=
      DltMessageFiltering: DltDefaultMaxLogLevel=6, DltDefaultTraceStatus=, DltFactoryDefaultMaxLogLevel=, DltFilterMessages=1
      DltProtocol:
        DltEcuId = DLTT
        DltHeaderPayloadEndianes = BigEndian
        DltHeaderUseEcuId = 1
        DltHeaderUseExtendedHeader = 1
        DltHeaderUseSessionID = 1
        DltHeaderUseTimestamp = 0
        DltMaxMessageLength = 520
        DltUseVerboseMode = 1
  module config WdgIf: implementation-config-variant=VARIANT-PRE-COMPILE, module-description=WdgIf
    Wdg (WdgIfDevice): WdgIfDeviceIndex=0, WdgIfDriverRef=(unset)
    WdgIfGeneral: WdgIfDevErrorDetect=1, WdgIfVersionInfoApi=1
  module config WdgM: implementation-config-variant=VARIANT-PRE-COMPILE, module-description=WdgM
    WdgMConfigSet: WdgMInitialMode=WatchdogOff
      WatchdogOn (WdgMMode): WdgMExpiredSupervisionCycleTol=1, WdgMModeId=1, WdgMSupervisionCycle=0.01
        WdgMAliveSupervision1 (WdgMAliveSupervision):
          WdgMExpectedAliveIndications = 4
          WdgMMaxMargin = 1
          WdgMMinMargin = 1
          WdgMSupervisionReferenceCycle = 40
          WdgMAliveSupervisionCheckpointRef = Supervised100msCheckpoint
        WdgMTrigger: WdgMTriggerConditionValue=150, WdgMWatchdogMode=WDGIF_SLOW_MODE, WdgMTriggerWatchdogRef=WdgMWatchdog
      WatchdogOff (WdgMMode): WdgMExpiredSupervisionCycleTol=0, WdgMModeId=(unset), WdgMSupervisionCycle=0.01
        WdgMTrigger: WdgMTriggerConditionValue=1, WdgMWatchdogMode=WDGIF_OFF_MODE, WdgMTriggerWatchdogRef=WdgMWatchdog
    WdgMGeneral: WdgMDefensiveBehavior=0, WdgMDemStoppedSupervisionReport=0, WdgMDevErrorDetect=1, WdgMImmediateReset=0, WdgMOffModeEnabled=1, WdgMVersionInfoApi=1
      Supervised100msTask (WdgMSupervisedEntity): WdgMSupervisedEntityId=(unset), WdgMInternalCheckpointInitialRef=Supervised100msCheckpoint, WdgMInternallCheckpointFinalRef=(unset)
        Supervised100msCheckpoint (WdgMCheckpoint): WdgMCheckpointId=1
      WdgMWatchdog: WdgMWatchdogName=TheDog, WdgMWatchdogDeviceRef=Wdg
      WdgMCallerIds: WdgMCallerId=1
  module config NvM: implementation-config-variant=VARIANT-PRE-COMPILE, module-description=NvM
    SwcMem_Block1 (NvMBlockDescriptor):
      NvMBlockJobPriority = (unset)
      NvMBlockManagementType = NVM_BLOCK_NATIVE
      NvMBlockUseCrc = 1
      NvMBlockUseSyncMechanism = 0
      NvMBlockWriteProt = 0
      NvMBswMBlockStatusInformation = 0
      NvMMaxNumOfReadRetries = 0
      NvMMaxNumOfWriteRetries = (unset)
      NvMNvBlockBaseNumber = 1
      NvMNvBlockLength = 4
      NvMNvBlockNum = 1
      NvMNvramBlockIdentifier = 
      NvMNvramDeviceId = 1
      NvMResistantToChangedSw = (unset)
      NvMRomBlockNum = 0
      NvMStaticBlockIDCheck = 0
      NvMWriteBlockOnce = (unset)
      NvMWriteVerification = 0
      NvMWriteVerificationDataSize = 1
      NvMBlockCrcType = NVM_CRC32
      NvMRamBlockDataAddress = Rte_Pim_SwcMemType_SwcMem_PIM1
      NvMSelectBlockForReadAll = 1
      NvMCalcRamBlockCrc = 1
      NvMTargetBlockReference
        NvMFeeRef: NvMNameOfFeeBlock=SwcMem_Block1
    NvMCommon:
      NvMApiConfigClass = NVM_API_CONFIG_CLASS_3
      NvMBswMMultiBlockJobStatusInformation = 1
      NvMCompiledConfigId = (unset)
      NvMCrcNumOfBytes = (unset)
      NvMDatasetSelectionBits = 0
      NvMDevErrorDetect = 1
      NvMDrvModeSwitch = (unset)
      NvMDynamicConfiguration = (unset)
      NvMJobPrioritization = 0
      NvMPollingMode = 0
      NvMRepeatMirrorOperations = 0
      NvMSetRamBlockStatusApi = 1
      NvMSizeStandardJobQueue = 5
      NvMVersionInfoApi = 0
    SwcMem_Block2 (NvMBlockDescriptor):
      NvMBlockJobPriority = (unset)
      NvMBlockManagementType = NVM_BLOCK_NATIVE
      NvMBlockUseCrc = 1
      NvMBlockUseSyncMechanism = 0
      NvMBlockWriteProt = 0
      NvMBswMBlockStatusInformation = 0
      NvMMaxNumOfReadRetries = 0
      NvMMaxNumOfWriteRetries = (unset)
      NvMNvBlockBaseNumber = 2
      NvMNvBlockLength = 4
      NvMNvBlockNum = 1
      NvMNvramBlockIdentifier = 
      NvMNvramDeviceId = 1
      NvMResistantToChangedSw = (unset)
      NvMRomBlockNum = 0
      NvMStaticBlockIDCheck = 0
      NvMWriteBlockOnce = (unset)
      NvMWriteVerification = 0
      NvMWriteVerificationDataSize = 1
      NvMBlockCrcType = NVM_CRC32
      NvMTargetBlockReference
        NvMEaRef: NvMNameOfEaBlock=SwcMem_Block2
  module config FiM: implementation-config-variant=VARIANT-PRE-COMPILE, module-description=FiM
    FiMConfigSet
      FiMFID1 (FiMFID): FiMFunctionId=
      FiMInhibitionConfiguration:
        FiMInhInhibitionMask = FIM_TESTED_AND_FAILED
        FiMInhFunctionIdRef = FiMFID1
        FiMInhEventRef = CAN_E_TIMEOUT
        FiMInhSumRef = FiMSummaryEvent
        FiMInhEventRef = TestEvent
      FiMSummaryEvent:
        FiMInputEventRef = FLS_E_COMPARE_FAILED
        FiMInputEventRef = FLS_E_ERASE_FAILED
        FiMInputEventRef = FLS_E_READ_FAILED
        FiMInputEventRef = FLS_E_WRITE_FAILED
    FiMGeneral:
      FiMAvailabilitySupport = true
      FiMDevErrorDetect = true
      FiMEventUpdateTriggeredByDem = true
      FiMMainFunctionPeriod = 
      FiMMaxEventsPerFidInhibitionConfiguration = 5
      FiMMaxInputEventsPerSummaryEvents = 5
      FiMMaxSumEventsPerFidInhibitionConfiguration = 5
      FiMMaxSummaryEvents = 
      FiMVersionInfoApi = false
